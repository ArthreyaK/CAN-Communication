VERSION "PMZ_HSCAN"

NS_ :

BS_:

BU_: BCM_Gp BECM CCF_Server EPICD EPICD_E GWM HVAC PCM SGCM TSTR Virtual_Node

BO_ 1024 VEHCONFIG_400PMZ_AutoSAR: 8 CCF_Server
 SG_ SF_VEHCONFIG_400PMZ_AutoSAR_PDU M : 0|8@1+ (1,0) [0|255] ""  BECM,EPICD_E,HVAC,SGCM
 SG_ CcfLaneKeepAssistLDW m102 : 17|2@0+ (1,0) [0|3] "" Vector__XXX
 SG_ CcfManoeuvLightConfig m102 : 13|2@0+ (1,0) [0|3] "" Vector__XXX
 SG_ CcfParkPawlLocation m102 : 55|4@0+ (1,0) [0|15] "" Vector__XXX
 SG_ CcfPassHeatedCalfRest m102 : 47|2@0+ (1,0) [0|3] ""  HVAC
 SG_ CcfPSMFitment m102 : 25|2@0+ (1,0) [0|3] "" Vector__XXX
 SG_ CcfR2SMFitment m102 : 31|2@0+ (1,0) [0|3] "" Vector__XXX
 SG_ CcfR3SMFitment m102 : 33|2@0+ (1,0) [0|3] "" Vector__XXX
 SG_ CcfRghtManoeuvringLgt m102 : 15|2@0+ (1,0) [0|3] "" Vector__XXX
 SG_ CcfRLSMFitment m102 : 27|2@0+ (1,0) [0|3] "" Vector__XXX
 SG_ CcfRRSMFitment m102 : 29|2@0+ (1,0) [0|3] "" Vector__XXX
 SG_ CcfSeatMassHanded m102 : 49|2@0+ (1,0) [0|3] "" Vector__XXX
 SG_ CcfABsPartc m108 : 63|2@0+ (1,0) [0|3] "" Vector__XXX
 SG_ CcfActvDampingPartc m108 : 55|2@0+ (1,0) [0|3] "" Vector__XXX
 SG_ CcfAdaptiveProgMode m108 : 39|2@0+ (1,0) [0|3] "" Vector__XXX
 SG_ CcfAHBSystemStatus m108 : 15|2@0+ (1,0) [0|3] "" Vector__XXX
 SG_ CcfAutoTRProgMode m108 : 47|2@0+ (1,0) [0|3] "" Vector__XXX
 SG_ CcfConfigTRMode m108 : 53|3@0+ (1,0) [0|7] "" Vector__XXX
 SG_ CcfCorneringLampFunc m108 : 9|2@0+ (1,0) [0|3] "" Vector__XXX
 SG_ CcfDrvlinePartc m108 : 57|2@0+ (1,0) [0|3] "" Vector__XXX
 SG_ CcfEDiffPartc m108 : 61|2@0+ (1,0) [0|3] "" Vector__XXX
 SG_ CcfEmergencyBrakeIndic m108 : 11|2@0+ (1,0) [0|3] "" Vector__XXX
 SG_ CcfEnhancedFiltration m108 : 29|3@0+ (1,0) [0|7] ""  HVAC
 SG_ CcfEPasPartc m108 : 59|2@0+ (1,0) [0|3] "" Vector__XXX
 SG_ CcfHighBeamLights m108 : 13|2@0+ (1,0) [0|3] "" Vector__XXX
 SG_ CcfNFSVariant m108 : 26|3@0+ (1,0) [0|7] "" Vector__XXX
 SG_ CcfProgrammableCar m108 : 37|3@0+ (1,0) [0|7] "" Vector__XXX
 SG_ CcfReplay m108 : 21|2@0+ (1,0) [0|3] "" Vector__XXX
 SG_ CcfSlcEVChargeAlerts m108 : 19|2@0+ (1,0) [0|3] "" Vector__XXX
 SG_ CcfSplitServiceMessaging m108 : 17|2@0+ (1,0) [0|3] "" Vector__XXX
 SG_ CcfTrackProgMode m108 : 45|3@0+ (1,0) [0|7] "" Vector__XXX
 SG_ CcfTRFitment m108 : 31|2@0+ (1,0) [0|3] "" Vector__XXX
 SG_ CcfTRSwitchType m108 : 34|3@0+ (1,0) [0|7] "" Vector__XXX
 SG_ CcfULPMProgMode m108 : 42|3@0+ (1,0) [0|7] "" Vector__XXX
 SG_ CcfWadeProgMode m108 : 50|3@0+ (1,0) [0|7] "" Vector__XXX
 SG_ CcfWakeupShutDownSeqMenu m108 : 23|2@0+ (1,0) [0|3] "" Vector__XXX
 SG_ Ccf3DrAccessRearFeature m110 : 13|2@0+ (1,0) [0|3] "" Vector__XXX
 SG_ CcfAHBSensitivtyMenu m110 : 23|2@0+ (1,0) [0|3] "" Vector__XXX
 SG_ CcfAuxDrivingLamps m110 : 15|2@0+ (1,0) [0|3] "" Vector__XXX
 SG_ CcfBattery1Type m110 : 52|5@0+ (1,0) [0|31] ""  BECM,EPICD_E,HVAC
 SG_ CcfBattery2BMS m110 : 25|2@0+ (1,0) [0|3] "" Vector__XXX
 SG_ CcfBrakePadWearIndication m110 : 21|2@0+ (1,0) [0|3] "" Vector__XXX
 SG_ CcfImmobiliserChannels m110 : 47|8@0+ (1,0) [0|255] "" Vector__XXX
 SG_ CcfInteriorReleaseTailgate m110 : 61|2@0+ (1,0) [0|3] "" Vector__XXX
 SG_ CcfLightsOnWhenWipers m110 : 19|2@0+ (1,0) [0|3] "" Vector__XXX
 SG_ CcfPixelTouristMode m110 : 29|2@0+ (1,0) [0|3] "" Vector__XXX
 SG_ CcfPSDBFitted m110 : 31|2@0+ (1,0) [0|3] "" Vector__XXX
 SG_ CcfRearFoldFlat m110 : 11|2@0+ (1,0) [0|3] "" Vector__XXX
 SG_ CcfRemoteReleaseTailgate m110 : 59|2@0+ (1,0) [0|3] "" Vector__XXX
 SG_ CcfTailgateHingeType m110 : 63|2@0+ (1,0) [0|3] "" Vector__XXX
 SG_ CcfVIAutoIllumination m110 : 39|3@0+ (1,0) [0|7] "" Vector__XXX
 SG_ CcfVICustomisableShortcut m110 : 55|3@0+ (1,0) [0|7] "" Vector__XXX
 SG_ CcfVisionInteraction m110 : 57|2@0+ (1,0) [0|3] "" Vector__XXX
 SG_ CcfVQMFitted m110 : 36|2@0+ (1,0) [0|3] "" Vector__XXX
 SG_ CcfVSMLVehicleHealthWarn m110 : 9|2@0+ (1,0) [0|3] "" Vector__XXX
 SG_ CcfVSMOilLevelUnit m110 : 27|2@0+ (1,0) [0|3] "" Vector__XXX
 SG_ CcfWirelessDeviceCharger m110 : 34|3@0+ (1,0) [0|7] "" Vector__XXX
 SG_ CcfXenonLamps m110 : 17|2@0+ (1,0) [0|3] "" Vector__XXX
 SG_ CcfA2BConfigurationNo m111 : 15|8@0+ (1,0) [0|255] "" Vector__XXX
 SG_ CcfAutoSSSelectInFCPB m111 : 42|3@0+ (1,0) [0|7] ""  HVAC
 SG_ CcfDSCSelectInFCPB m111 : 45|3@0+ (1,0) [0|7] ""  HVAC
 SG_ CcfHDCSelectInFCPB m111 : 50|3@0+ (1,0) [0|7] ""  HVAC
 SG_ CcfIVIType m111 : 31|8@0+ (1,0) [0|255] "" Vector__XXX
 SG_ CcfManovLightFadeTime m111 : 39|4@0+ (1,0) [0|15] "" Vector__XXX
 SG_ CcfManovLightRevTime m111 : 35|4@0+ (1,0) [0|15] "" Vector__XXX
 SG_ CcfOdoLeadingZero m111 : 55|2@0+ (1,0) [0|3] "" Vector__XXX
 SG_ CcfPreCrashSeatBltPretent m111 : 63|2@0+ (1,0) [0|3] "" Vector__XXX
 SG_ CcfRemoteWingMirrorFold m111 : 47|2@0+ (1,0) [0|3] "" Vector__XXX
 SG_ CcfSpeedoMainScaleUnits m111 : 18|3@0+ (1,0) [0|7] "" Vector__XXX
 SG_ CcfSpeedoSecondDisplay m111 : 21|3@0+ (1,0) [0|7] "" Vector__XXX
 SG_ CcfTerComSelectInFCPB m111 : 58|3@0+ (1,0) [0|7] ""  HVAC
 SG_ CcfTerDynSelectInFCPB m111 : 61|3@0+ (1,0) [0|7] ""  HVAC
 SG_ CcfTerECOSelectInFCPB m111 : 53|3@0+ (1,0) [0|7] ""  HVAC
 SG_ CcfTripCompInitialUnits m111 : 23|2@0+ (1,0) [0|3] "" Vector__XXX
 SG_ CcfAllWheelSteer m112 : 55|2@0+ (1,0) [0|3] "" Vector__XXX
 SG_ CcfATPCSelectInFCPB m112 : 10|3@0+ (1,0) [0|7] ""  HVAC
 SG_ CcfClimateHardKey m112 : 63|2@0+ (1,0) [0|3] "" Vector__XXX
 SG_ CcfFrontFogFuntionality m112 : 61|3@0+ (1,0) [0|7] "" Vector__XXX
 SG_ CcfInstrumentSkin m112 : 47|5@0+ (1,0) [0|31] "" Vector__XXX
 SG_ CcfOdometerUnits m112 : 37|3@0+ (1,0) [0|7] "" Vector__XXX
 SG_ CcfParkAid m112 : 23|2@0+ (1,0) [0|3] "" Vector__XXX
 SG_ CcfPreCrashSeatSquab m112 : 39|2@0+ (1,0) [0|3] "" Vector__XXX
 SG_ CcfSpdoSecondDisplayUnit m112 : 34|3@0+ (1,0) [0|7] "" Vector__XXX
 SG_ CcfSpeedoRange m112 : 31|5@0+ (1,0) [0|31] "" Vector__XXX
 SG_ CcfTachoGaugeVariant m112 : 42|3@0+ (1,0) [0|7] "" Vector__XXX
 SG_ CcfTerAutoSelectInFCPB m112 : 13|3@0+ (1,0) [0|7] ""  HVAC
 SG_ CcfTerGGSSelectInFCPB m112 : 18|3@0+ (1,0) [0|7] ""  HVAC
 SG_ CcfTerMudSelectInFCPB m112 : 21|3@0+ (1,0) [0|7] ""  HVAC
 SG_ CcfTerSandSelectInFCPB m112 : 26|3@0+ (1,0) [0|7] ""  HVAC
 SG_ CcfTripCompFuelEconomy m112 : 53|6@0+ (1,0) [0|63] "" Vector__XXX
 SG_ CcfTripCompMetFulEcoUnt m112 : 15|2@0+ (1,0) [0|3] "" Vector__XXX
 SG_ CcfVTGlazingRoof m112 : 58|3@0+ (1,0) [0|7] "" Vector__XXX
 SG_ CcfBattery2Type m113 : 12|5@0+ (1,0) [0|31] "" Vector__XXX
 SG_ CcfBSCMFitted m113 : 25|2@0+ (1,0) [0|3] "" Vector__XXX
 SG_ CcfConventionalCharging m113 : 35|2@0+ (1,0) [0|3] "" Vector__XXX
 SG_ CcfDriveModeDiscStrat m113 : 39|4@0+ (1,0) [0|15] "" Vector__XXX
 SG_ CcfDriveModeOrder m113 : 45|6@0+ (1,0) [0|63] "" Vector__XXX
 SG_ CcfDriveModeSigSchema m113 : 53|6@0+ (1,0) [0|63] "" Vector__XXX
 SG_ CcfEVRangeInfoWithPMZ m113 : 55|2@0+ (1,0) [0|3] "" Vector__XXX
 SG_ CcfEVSelectInBlade m113 : 15|3@0+ (1,0) [0|7] "" Vector__XXX
 SG_ CcfEVSelectInFCPB m113 : 58|3@0+ (1,0) [0|7] ""  HVAC
 SG_ CcfFLCVariant m113 : 63|3@0+ (1,0) [0|7] "" Vector__XXX
 SG_ CcfLeisureBatt m113 : 47|2@0+ (1,0) [0|3] "" Vector__XXX
 SG_ CcfOverspeedSaudi m113 : 60|2@0+ (1,0) [0|3] "" Vector__XXX
 SG_ CcfParkAssist m113 : 19|4@0+ (1,0) [0|15] "" Vector__XXX
 SG_ CcfSpdoScndDispEnblMenu m113 : 27|2@0+ (1,0) [0|3] "" Vector__XXX
 SG_ CcfSpdoScndDispUnitMenu m113 : 31|2@0+ (1,0) [0|3] "" Vector__XXX
 SG_ CcfSpecialClock m113 : 23|4@0+ (1,0) [0|15] "" Vector__XXX
 SG_ CcfSpeedoMinorScale m113 : 29|2@0+ (1,0) [0|3] "" Vector__XXX
 SG_ CcfVIAutoStart m113 : 33|2@0+ (1,0) [0|3] "" Vector__XXX
 SG_ CcfAirSusSelectInFCPB m114 : 42|3@0+ (1,0) [0|7] ""  HVAC
 SG_ CcfBacklightDimStratSel m114 : 31|2@0+ (1,0) [0|3] "" Vector__XXX
 SG_ CcfCCMVariant m114 : 19|4@0+ (1,0) [0|15] "" Vector__XXX
 SG_ CcfCityDrivingPwrSteer m114 : 39|2@0+ (1,0) [0|3] "" Vector__XXX
 SG_ CcfDADCModule m114 : 15|4@0+ (1,0) [0|15] "" Vector__XXX
 SG_ CcfDynSuspensionType m114 : 63|5@0+ (1,0) [0|31] "" Vector__XXX
 SG_ CcfFrontCornerRadars m114 : 29|3@0+ (1,0) [0|7] "" Vector__XXX
 SG_ CcfGuidanceBeamCCF m114 : 55|2@0+ (1,0) [0|3] "" Vector__XXX
 SG_ CcfHandsOnDetection m114 : 9|2@0+ (1,0) [0|3] "" Vector__XXX
 SG_ CcfLoRngSelectInFCPB m114 : 50|3@0+ (1,0) [0|7] ""  HVAC
 SG_ CcfPredictableAFS m114 : 47|2@0+ (1,0) [0|3] "" Vector__XXX
 SG_ CcfRearCornerRadars m114 : 26|3@0+ (1,0) [0|7] "" Vector__XXX
 SG_ CcfTA2InputControl m114 : 23|4@0+ (1,0) [0|15] "" Vector__XXX
 SG_ CcfTA2SelectInFCPB m114 : 34|3@0+ (1,0) [0|7] ""  HVAC
 SG_ CcfTelematicsSignIn m114 : 11|2@0+ (1,0) [0|3] "" Vector__XXX
 SG_ CcfTerCPSelectInFCPB m114 : 58|3@0+ (1,0) [0|7] ""  HVAC
 SG_ CcfTerCTSelectInFCPB m114 : 53|3@0+ (1,0) [0|7] ""  HVAC
 SG_ CcfTerRockSelectInFCPB m114 : 37|3@0+ (1,0) [0|7] ""  HVAC
 SG_ CcfTerWadeSelectInFCPB m114 : 45|3@0+ (1,0) [0|7] ""  HVAC
 SG_ CcfADASCBV m115 : 39|3@0+ (1,0) [0|7] "" Vector__XXX
 SG_ CcfApproachOpenDoors m115 : 61|3@0+ (1,0) [0|7] "" Vector__XXX
 SG_ CcfATPCPRO m115 : 26|3@0+ (1,0) [0|7] "" Vector__XXX
 SG_ CcfCamWashType m115 : 50|3@0+ (1,0) [0|7] "" Vector__XXX
 SG_ CcfeHorizonVariant m115 : 18|3@0+ (1,0) [0|7] "" Vector__XXX
 SG_ CcfEngCoolantHotWarn m115 : 36|5@0+ (1,0) [0|31] "" Vector__XXX
 SG_ CcfEngCoolantVryHotWarn m115 : 44|5@0+ (1,0) [0|31] "" Vector__XXX
 SG_ CcfEVSDCalNo m115 : 15|8@0+ (1,0) [0|255] "" Vector__XXX
 SG_ CcfGestureBonnet m115 : 63|2@0+ (1,0) [0|3] "" Vector__XXX
 SG_ CcfGestureDoorHandles m115 : 55|2@0+ (1,0) [0|3] "" Vector__XXX
 SG_ CcfPowerSideDoors m115 : 53|3@0+ (1,0) [0|7] "" Vector__XXX
 SG_ CcfRefrigerantType m115 : 21|3@0+ (1,0) [0|7] ""  HVAC
 SG_ CcfReverseLightActStra m115 : 29|3@0+ (1,0) [0|7] "" Vector__XXX
 SG_ CcfSeeThroughTrailer m115 : 31|2@0+ (1,0) [0|3] "" Vector__XXX
 SG_ CcfSideDoorObjectDet m115 : 58|3@0+ (1,0) [0|7] "" Vector__XXX
 SG_ CcfVehClearGuidance m115 : 23|2@0+ (1,0) [0|3] "" Vector__XXX
 SG_ CcfVertAccelSource m115 : 47|3@0+ (1,0) [0|7] "" Vector__XXX
 SG_ CcfActiveBrakeDuctVanes m117 : 63|2@0+ (1,0) [0|3] "" Vector__XXX
 SG_ CcfDADLInhibitOff m117 : 23|2@0+ (1,0) [0|3] "" Vector__XXX
 SG_ CcfEDUDriveline m117 : 58|3@0+ (1,0) [0|7] "" Vector__XXX
 SG_ CcfFrntUpperDispMargin m117 : 27|4@0+ (1,0) [0|15] "" Vector__XXX
 SG_ CcfFrtAnmSeqWkUpShutDn m117 : 61|3@0+ (1,0) [0|7] "" Vector__XXX
 SG_ CcfIVIAPIXClusterComms m117 : 31|4@0+ (1,0) [0|15] "" Vector__XXX
 SG_ CcfIVIeSIMProfileType m117 : 47|8@0+ (1,0) [0|255] "" Vector__XXX
 SG_ CcfIVIWiFiHotspot m117 : 17|2@0+ (1,0) [0|3] "" Vector__XXX
 SG_ CcfLHSWSFvClusterView m117 : 21|2@0+ (1,0) [0|3] "" Vector__XXX
 SG_ CcfPM25Market m117 : 15|8@0+ (1,0) [0|255] ""  HVAC
 SG_ CcfPwrTgateHMIControl m117 : 39|8@0+ (1,0) [0|255] "" Vector__XXX
 SG_ CcfRoofControlStrategy m117 : 55|8@0+ (1,0) [0|255] "" Vector__XXX
 SG_ CcfUserEEBReserveMgmt m117 : 19|2@0+ (1,0) [0|3] "" Vector__XXX
 SG_ CcfAnmProjWakeUpShutDn m118 : 15|3@0+ (1,0) [0|7] "" Vector__XXX
 SG_ CcfBrakeWarnings m118 : 31|2@0+ (1,0) [0|3] "" Vector__XXX
 SG_ CcfHVBatteryCapacity m118 : 39|5@0+ (1,0) [0|31] "" Vector__XXX
 SG_ CcfIndirectVentsFitted m118 : 47|3@0+ (1,0) [0|7] ""  HVAC
 SG_ CcfPreEmpSuspBowWvDmp m118 : 63|2@0+ (1,0) [0|3] "" Vector__XXX
 SG_ CcfPreEmpSusPitchDamp m118 : 57|2@0+ (1,0) [0|3] "" Vector__XXX
 SG_ CcfPreEmptSusCnrRdEnh m118 : 55|2@0+ (1,0) [0|3] "" Vector__XXX
 SG_ CcfPreEmptSusCollMtgn m118 : 51|2@0+ (1,0) [0|3] "" Vector__XXX
 SG_ CcfPreEmptSusCrPkAccHt m118 : 61|2@0+ (1,0) [0|3] "" Vector__XXX
 SG_ CcfPreEmptSusKrbStrkDt m118 : 59|2@0+ (1,0) [0|3] "" Vector__XXX
 SG_ CcfPreEmptSusSpeedLwr m118 : 53|2@0+ (1,0) [0|3] "" Vector__XXX
 SG_ CcfRow1SeatBolster m118 : 25|2@0+ (1,0) [0|3] "" Vector__XXX
 SG_ CcfRow1SeatCushExt m118 : 17|2@0+ (1,0) [0|3] "" Vector__XXX
 SG_ CcfRow1SeatHeadrest m118 : 20|3@0+ (1,0) [0|7] "" Vector__XXX
 SG_ CcfRow1SeatLumbar m118 : 23|3@0+ (1,0) [0|7] "" Vector__XXX
 SG_ CcfRow1SeatShoulder m118 : 27|2@0+ (1,0) [0|3] "" Vector__XXX
 SG_ CcfRow2SeatBolster m118 : 29|2@0+ (1,0) [0|3] "" Vector__XXX
 SG_ CcfRow2SeatHeadrest m118 : 34|3@0+ (1,0) [0|7] "" Vector__XXX
 SG_ CcfRow2SeatLumbar m118 : 42|3@0+ (1,0) [0|7] "" Vector__XXX
 SG_ CcfRow2SeatShoulder m118 : 44|2@0+ (1,0) [0|3] "" Vector__XXX
 SG_ CcfRrAnmSeqWkUpShutDn m118 : 10|3@0+ (1,0) [0|7] "" Vector__XXX
 SG_ CcfTailgateEventExperience m118 : 12|2@0+ (1,0) [0|3] "" Vector__XXX
 SG_ CcfTailgateEventLight m118 : 49|2@0+ (1,0) [0|3] "" Vector__XXX
 SG_ Ccf4x4iD8Driveline m119 : 55|3@0+ (1,0) [0|7] "" Vector__XXX
 SG_ CcfAirSuspUIType m119 : 12|3@0+ (1,0) [0|7] "" Vector__XXX
 SG_ CcfAutoStpStrtButtonType m119 : 28|3@0+ (1,0) [0|7] "" Vector__XXX
 SG_ CcfCentrSideAirbag m119 : 19|2@0+ (1,0) [0|3] "" Vector__XXX
 SG_ CcfDSCSwitchSource m119 : 50|3@0+ (1,0) [0|7] "" Vector__XXX
 SG_ CcfIMSCalNo1 m119 : 39|8@0+ (1,0) [1|254] "Calibration" Vector__XXX
 SG_ CcfIMSCalNo2 m119 : 47|8@0+ (1,0) [1|254] "Calibration" Vector__XXX
 SG_ CcfIMSType m119 : 15|3@0+ (1,0) [0|7] "" Vector__XXX
 SG_ CcfLSPFitment m119 : 52|2@0+ (1,0) [0|3] "" Vector__XXX
 SG_ CcfPNLeisureBattstatus m119 : 25|2@0+ (1,0) [0|3] "" Vector__XXX
 SG_ CcfPoliceLightsFuncReq m119 : 60|5@0+ (1,0) [0|31] "" Vector__XXX
 SG_ CcfPreEmptSusPkgKrbAvd m119 : 9|2@0+ (1,0) [0|3] "" Vector__XXX
 SG_ CcfPyroBrake m119 : 17|2@0+ (1,0) [0|3] "" Vector__XXX
 SG_ CcfSeatPeripheralCtrl m119 : 63|3@0+ (1,0) [0|7] ""  HVAC
 SG_ CcfTaskLightingTLMB m119 : 21|2@0+ (1,0) [0|3] "" Vector__XXX
 SG_ CcfTaskLightingTLMC m119 : 23|2@0+ (1,0) [0|3] "" Vector__XXX
 SG_ CcfTracDSCFitted m119 : 31|3@0+ (1,0) [0|7] "" Vector__XXX
 SG_ CcfAGMcActrFitment m120 : 43|2@0+ (1,0) [0|3] "" Vector__XXX
 SG_ CcfAGMdActrFitment m120 : 45|2@0+ (1,0) [0|3] "" Vector__XXX
 SG_ CcfCabinSnapshot m120 : 28|3@0+ (1,0) [0|7] "" Vector__XXX
 SG_ CcfCDMHandlingPartc m120 : 47|2@0+ (1,0) [0|3] "" Vector__XXX
 SG_ CcfCDMISCSPartc m120 : 53|2@0+ (1,0) [0|3] "" Vector__XXX
 SG_ CcfCTRBCSPartc m120 : 55|2@0+ (1,0) [0|3] "" Vector__XXX
 SG_ CcfEVBattUsablekWh m120 : 63|8@0+ (1,0) [0|255] "" Vector__XXX
 SG_ CcfExpDateFormatSigs m120 : 39|2@0+ (1,0) [0|3] "" Vector__XXX
 SG_ CcfFntClimateSeatsSZM m120 : 13|4@0+ (1,0) [0|15] ""  HVAC
 SG_ CcfHDAdaptDrvBeam m120 : 9|2@0+ (1,0) [0|3] "" Vector__XXX
 SG_ CcfItemReminder m120 : 34|3@0+ (1,0) [0|7] "" Vector__XXX
 SG_ CcfOCSPFitment m120 : 25|2@0+ (1,0) [0|3] "" Vector__XXX
 SG_ CcfPassSeatHeelCatcher m120 : 15|2@0+ (1,0) [0|3] "" Vector__XXX
 SG_ CcfPetrolEmissionsHW m120 : 51|4@0+ (1,0) [0|15] "" Vector__XXX
 SG_ CcfRemoteDeviceReminder m120 : 31|3@0+ (1,0) [0|7] "" Vector__XXX
 SG_ CcfRrClimateSeatsSZM m120 : 20|5@0+ (1,0) [0|31] ""  HVAC
 SG_ CcfSpecialVehicles m120 : 23|3@0+ (1,0) [0|7] ""  HVAC
 SG_ CcfSpeedoMarket m120 : 41|2@0+ (1,0) [0|3] "" Vector__XXX
 SG_ CcfTEETailgateActuation m120 : 37|3@0+ (1,0) [0|7] "" Vector__XXX
 SG_ CcfATPCButtonType m122 : 53|3@0+ (1,0) [0|7] "" Vector__XXX
 SG_ CcfAutoBlowerIntensityLvlConfig m122 : 61|3@0+ (1,0) [0|7] ""  HVAC
 SG_ CcfDDMCalibration m122 : 21|3@0+ (1,0) [0|7] "" Vector__XXX
 SG_ CcfDepDoorHandShowMode m122 : 13|3@0+ (1,0) [0|7] "" Vector__XXX
 SG_ CcfFntLowerDispHaptic m122 : 15|2@0+ (1,0) [0|3] "" Vector__XXX
 SG_ CcfFntUpperDispHaptic m122 : 23|2@0+ (1,0) [0|3] "" Vector__XXX
 SG_ CcfPhoneSignalBooster m122 : 63|2@0+ (1,0) [0|3] "" Vector__XXX
 SG_ CcfPM25SensorType m122 : 50|3@0+ (1,0) [0|7] ""  HVAC
 SG_ CcfRearChillerUserControl m122 : 58|3@0+ (1,0) [0|7] ""  HVAC
 SG_ CcfRSESubscriptionVer m122 : 31|16@0+ (1,0) [0|65535] "" Vector__XXX
 SG_ CcfSeatSpec m122 : 10|3@0+ (1,0) [0|7] ""  HVAC
 SG_ CcfSensorSlopeType m122 : 47|8@0+ (1,0) [0|255] "" Vector__XXX
 SG_ CcfTailgateCloseLockSwitch m122 : 18|3@0+ (1,0) [0|7] "" Vector__XXX
 SG_ CcfTSSecSeatMovement m122 : 55|2@0+ (1,0) [0|3] "" Vector__XXX
 SG_ CcfADASAlertSensitivity m123 : 29|3@0+ (1,0) [0|7] "" Vector__XXX
 SG_ CcfADASSpdLimOffset m123 : 10|3@0+ (1,0) [0|7] "" Vector__XXX
 SG_ CcfAutoHoldType m123 : 63|2@0+ (1,0) [0|3] "" Vector__XXX
 SG_ CcfDeployableRSEType m123 : 58|3@0+ (1,0) [0|7] "" Vector__XXX
 SG_ CcfEcoDrivingCoachVar m123 : 55|4@0+ (1,0) [0|15] "" Vector__XXX
 SG_ CcfEVInletLidSecure m123 : 23|2@0+ (1,0) [0|3] "" Vector__XXX
 SG_ CcfFirstRowFridge m123 : 61|3@0+ (1,0) [0|7] ""  HVAC
 SG_ CcfFogLampLocation m123 : 39|4@0+ (1,0) [0|15] "" Vector__XXX
 SG_ CcfFrntLoadSpaceLight m123 : 15|2@0+ (1,0) [0|3] "" Vector__XXX
 SG_ CcfPersonalisationStorage m123 : 13|3@0+ (1,0) [0|7] "" Vector__XXX
 SG_ CcfPwrSideDrBrakePedalClose m123 : 26|3@0+ (1,0) [0|7] "" Vector__XXX
 SG_ CcfRevLampLocation m123 : 35|4@0+ (1,0) [0|15] "" Vector__XXX
 SG_ CcfRrClimateAutoSigs m123 : 31|2@0+ (1,0) [0|3] "" Vector__XXX
 SG_ CcfRrDILampLocation m123 : 47|4@0+ (1,0) [0|15] "" Vector__XXX
 SG_ CcfRrPosLampLocation m123 : 51|4@0+ (1,0) [0|15] "" Vector__XXX
 SG_ CcfRrSideDrTwoStgRel m123 : 18|3@0+ (1,0) [0|7] "" Vector__XXX
 SG_ CcfStopLampLocation m123 : 43|4@0+ (1,0) [0|15] "" Vector__XXX
 SG_ CcfTRDriAdvAirSusRcmndRse m123 : 21|3@0+ (1,0) [0|7] "" Vector__XXX
 SG_ CcfASDProgMode m124 : 58|3@0+ (1,0) [0|7] "" Vector__XXX
 SG_ CcfAutoBlrIntenstySet m124 : 31|2@0+ (1,0) [0|3] "" Vector__XXX
 SG_ CcfBrakeSystemTypeCRB m124 : 23|2@0+ (1,0) [0|3] "" Vector__XXX
 SG_ CcfClimateHMIControlStrategy m124 : 61|3@0+ (1,0) [0|7] "" Vector__XXX
 SG_ CcfDADLSpeedOptions m124 : 53|3@0+ (1,0) [0|7] "" Vector__XXX
 SG_ CcfEVInletLidPosition m124 : 50|3@0+ (1,0) [0|7] "" Vector__XXX
 SG_ CcfEVInletLidType m124 : 42|3@0+ (1,0) [0|7] "" Vector__XXX
 SG_ CcfEVInletUnlockType m124 : 45|3@0+ (1,0) [0|7] "" Vector__XXX
 SG_ CcfGearboxFltWarStrat m124 : 55|2@0+ (1,0) [0|3] "" Vector__XXX
 SG_ CcfGSMSOption m124 : 15|2@0+ (1,0) [0|3] "" Vector__XXX
 SG_ CcfHealthWellnessActiv m124 : 10|3@0+ (1,0) [0|7] "" Vector__XXX
 SG_ CcfINCARTempSensorTyp m124 : 13|3@0+ (1,0) [0|7] ""  HVAC
 SG_ CcfIPMAWSVarCal m124 : 29|6@0+ (1,0) [0|63] "" Vector__XXX
 SG_ CcfMLASoftSwitches m124 : 21|2@0+ (1,0) [0|3] "" Vector__XXX
 SG_ CcfPredictvEnrgyOptm m124 : 19|4@0+ (1,0) [0|15] "" Vector__XXX
 SG_ CcfSeatbuckleLED m124 : 63|2@0+ (1,0) [0|3] "" Vector__XXX
 SG_ CcfSpeechSesDuckBehav m124 : 47|2@0+ (1,0) [0|3] "" Vector__XXX
 SG_ CcfTemperatureUnits m124 : 34|3@0+ (1,0) [0|7] "" Vector__XXX
 SG_ CcfTRClusterRibbonDir m124 : 37|3@0+ (1,0) [0|7] "" Vector__XXX
 SG_ CcfUsrEEBReserveMgmt m124 : 39|2@0+ (1,0) [0|3] "" Vector__XXX
 SG_ CcfBrakeDuctType m125 : 18|3@0+ (1,0) [0|7] "" Vector__XXX
 SG_ CcfCabinCleaning m125 : 39|3@0+ (1,0) [0|7] ""  HVAC
 SG_ CcfCamVideoResolution m125 : 47|8@0+ (1,0) [0|255] "" Vector__XXX
 SG_ CcfHapticSeatPowertrain m125 : 52|5@0+ (1,0) [0|31] "" Vector__XXX
 SG_ CcfHapticSeatsAudio m125 : 36|5@0+ (1,0) [0|31] "" Vector__XXX
 SG_ CcfInfoEmerChargePnC m125 : 15|2@0+ (1,0) [0|3] "" Vector__XXX
 SG_ CcfInfotainEmerParm20 m125 : 23|2@0+ (1,0) [0|3] "" Vector__XXX
 SG_ CcfInfotainEmerParm21 m125 : 31|2@0+ (1,0) [0|3] "" Vector__XXX
 SG_ CcfMILActtDrivingCycl m125 : 29|3@0+ (1,0) [0|7] "" Vector__XXX
 SG_ CcfOffRoadRideHeight m125 : 26|3@0+ (1,0) [0|7] "" Vector__XXX
 SG_ CcfPwrDoorCrankOp m125 : 13|2@0+ (1,0) [0|3] "" Vector__XXX
 SG_ CcfRainSensorType m125 : 55|3@0+ (1,0) [0|7] ""  HVAC
 SG_ CcfRefrigerantLoop m125 : 11|4@0+ (1,0) [0|15] ""  HVAC
 SG_ CcfSmartProgramWiping m125 : 21|3@0+ (1,0) [0|7] "" Vector__XXX
 SG_ CcfSVDynamicMode m125 : 63|3@0+ (1,0) [0|7] "" Vector__XXX
 SG_ CcfVibroAcousticTherapy m125 : 60|5@0+ (1,0) [0|31] "" Vector__XXX
 SG_ CcfAlcoholIntLKDevice m126 : 31|2@0+ (1,0) [0|3] "" Vector__XXX
 SG_ CcfCabinCleanCyclTime m126 : 39|8@0+ (1,0) [1|253] ""  HVAC
 SG_ CcfCornerSpeedAdapt m126 : 29|2@0+ (1,0) [0|3] "" Vector__XXX
 SG_ CcfEnhFiltrationAQI m126 : 19|4@0+ (1,0) [0|15] "" Vector__XXX
 SG_ CcfHapticPwrTrnCalNo m126 : 15|8@0+ (1,0) [0|255] "" Vector__XXX
 SG_ CcfInfotainEmerParm22 m126 : 23|4@0+ (1,0) [0|15] "" Vector__XXX
 SG_ CcfInfotainEmerParm23 m126 : 47|8@0+ (1,0) [0|255] "" Vector__XXX
 SG_ CcfInfotainEmerParm24 m126 : 55|8@0+ (1,0) [0|255] "" Vector__XXX
 SG_ CcfRefrigerantSnsHVAC m126 : 59|4@0+ (1,0) [0|15] ""  HVAC
 SG_ CcfSidebarControls m126 : 63|4@0+ (1,0) [0|15] "" Vector__XXX
 SG_ CcfSpeedLimitAdapt m126 : 27|2@0+ (1,0) [0|3] "" Vector__XXX
 SG_ CcfAEBMenu m128 : 23|3@0+ (1,0) [0|7] "" Vector__XXX
 SG_ CcfDriverCondMonMenu m128 : 42|3@0+ (1,0) [0|7] "" Vector__XXX
 SG_ CcfDrvModeSwitchMsg m128 : 47|2@0+ (1,0) [0|3] "" Vector__XXX
 SG_ CcfeTSRFaultInd m128 : 63|3@0+ (1,0) [0|7] "" Vector__XXX
 SG_ CcfFLCHeating m128 : 60|2@0+ (1,0) [0|3] ""  HVAC
 SG_ CcfHDCButtonType m128 : 50|3@0+ (1,0) [0|7] "" Vector__XXX
 SG_ CcfHibernatedNav m128 : 55|2@0+ (1,0) [0|3] "" Vector__XXX
 SG_ CcfIVILoRngSwitchFit m128 : 15|2@0+ (1,0) [0|3] "" Vector__XXX
 SG_ CcfLaneAssistMenu m128 : 31|3@0+ (1,0) [0|7] "" Vector__XXX
 SG_ CcfNewSpdLimAudioAlrt m128 : 37|3@0+ (1,0) [0|7] "" Vector__XXX
 SG_ CcfOverSpdLimWarnSel m128 : 34|3@0+ (1,0) [0|7] "" Vector__XXX
 SG_ CcfReCircSoftBtn m128 : 58|3@0+ (1,0) [0|7] "" Vector__XXX
 SG_ CcfSideBarClimate m128 : 28|5@0+ (1,0) [0|31] ""  HVAC
 SG_ CcfStartupLogo m128 : 13|6@0+ (1,0) [0|63] "" Vector__XXX
 SG_ CcfSVShiftLightHysteresis m128 : 20|5@0+ (5,-5) [5|100] "" Vector__XXX
 SG_ CcfTSRSpdLimDispConv m128 : 53|3@0+ (1,0) [0|7] "" Vector__XXX
 SG_ CcfVehicleClassific m128 : 39|2@0+ (1,0) [0|3] "" Vector__XXX
 SG_ CcfVolumeSoftKeys m128 : 45|3@0+ (1,0) [0|7] "" Vector__XXX
 SG_ CcfACOnOffSoftBtn m129 : 13|2@0+ (1,0) [0|3] "" Vector__XXX
 SG_ CcfAEBFaultInd m129 : 35|2@0+ (1,0) [0|3] "" Vector__XXX
 SG_ CcfAirSUISignalSet m129 : 31|2@0+ (1,0) [0|3] "" Vector__XXX
 SG_ CcfAutoClimateSoftBtn m129 : 15|2@0+ (1,0) [0|3] "" Vector__XXX
 SG_ CcfChildLckdInCarMiti m129 : 29|3@0+ (1,0) [0|7] "" Vector__XXX
 SG_ CcfCTRAirSusPartc m129 : 61|2@0+ (1,0) [0|3] "" Vector__XXX
 SG_ CcfDCMFaultInd m129 : 37|2@0+ (1,0) [0|3] "" Vector__XXX
 SG_ CcfFrntHtdScrnSoftBtn m129 : 17|2@0+ (1,0) [0|3] "" Vector__XXX
 SG_ CcfFrontConnectSocket m129 : 47|5@0+ (1,0) [0|31] "" Vector__XXX
 SG_ CcfIFMVoltThreshold m129 : 23|4@0+ (1,0) [0|15] "" Vector__XXX
 SG_ CcfInfotainEmerParm29 m129 : 51|4@0+ (1,0) [0|15] "" Vector__XXX
 SG_ CcfInfotainEmerParm30 m129 : 55|4@0+ (1,0) [0|15] "" Vector__XXX
 SG_ CcfInstClusterLayMenu m129 : 63|2@0+ (1,0) [0|3] "" Vector__XXX
 SG_ CcfLaneAssistEmrgMenu m129 : 42|3@0+ (1,0) [0|7] "" Vector__XXX
 SG_ CcfLSSFaultInd m129 : 39|2@0+ (1,0) [0|3] "" Vector__XXX
 SG_ CcfMaxACSoftBtn m129 : 9|2@0+ (1,0) [0|3] "" Vector__XXX
 SG_ CcfMaxDefrostSoftBtn m129 : 11|2@0+ (1,0) [0|3] "" Vector__XXX
 SG_ CcfRearHtdScrnSoftBtn m129 : 19|2@0+ (1,0) [0|3] "" Vector__XXX
 SG_ CcfRemClimIndication m129 : 26|3@0+ (1,0) [0|7] ""  HVAC
 SG_ CcfSlopeInfoMode m129 : 33|2@0+ (1,0) [0|3] "" Vector__XXX
 SG_ CcfSVDynModeRideHght m129 : 57|2@0+ (1,0) [0|3] "" Vector__XXX
 SG_ CcfSVRoofLoadAdvice m129 : 59|2@0+ (1,0) [0|3] "" Vector__XXX
 SG_ CcfAdasDrvFatigue m130 : 31|2@0+ (1,0) [0|3] "" Vector__XXX
 SG_ CcfAdasDrvFatigueMenu m130 : 37|2@0+ (1,0) [0|3] "" Vector__XXX
 SG_ CcfAdasDrvMon m130 : 39|2@0+ (1,0) [0|3] "" Vector__XXX
 SG_ CcfAndroidPluginBox m130 : 26|3@0+ (1,0) [0|7] "" Vector__XXX
 SG_ CcfCabFragBoostSftBtn m130 : 63|2@0+ (1,0) [0|3] "" Vector__XXX
 SG_ CcfCabFragCartridges m130 : 15|3@0+ (1,0) [0|7] "" Vector__XXX
 SG_ CcfCabFragLockSftBtn m130 : 61|2@0+ (1,0) [0|3] "" Vector__XXX
 SG_ CcfCabFragPwrSftBtn m130 : 57|2@0+ (1,0) [0|3] "" Vector__XXX
 SG_ CcfCabFragTraySoftBtn m130 : 59|2@0+ (1,0) [0|3] "" Vector__XXX
 SG_ CcfFragranceDiffuser m130 : 12|2@0+ (1,0) [0|3] ""  HVAC
 SG_ CcfFrtWinOneShotUpDn m130 : 19|4@0+ (1,0) [0|15] "" Vector__XXX
 SG_ CcfLeftChargingInlet m130 : 47|8@0+ (1,0) [0|255] "" Vector__XXX
 SG_ CcfRemClimInhibStrat m130 : 10|3@0+ (1,0) [0|7] "" Vector__XXX
 SG_ CcfRightChargingInlet m130 : 55|8@0+ (1,0) [0|255] "" Vector__XXX
 SG_ CcfRrWinOneShotUpDn m130 : 23|4@0+ (1,0) [0|15] "" Vector__XXX
 SG_ CcfRSEMediaStreaming m130 : 35|4@0+ (1,0) [0|15] "" Vector__XXX
 SG_ CcfTerSDSelectInFCPB m130 : 29|3@0+ (1,0) [0|7] ""  HVAC
 SG_ CcfAdasDrvMonMenu m131 : 15|2@0+ (1,0) [0|3] "" Vector__XXX
 SG_ CcfAdasRmm m131 : 23|2@0+ (1,0) [0|3] "" Vector__XXX
 SG_ CcfAQSSoftButton m131 : 31|2@0+ (1,0) [0|3] "" Vector__XXX
 SG_ CcfCabFragBoostTime m131 : 21|6@0+ (1,0) [0|63] ""  HVAC
 SG_ CcfCabFragIntnstyHMI m131 : 10|3@0+ (1,0) [0|7] "" Vector__XXX
 SG_ CcfClimPreconSoftBtn m131 : 37|2@0+ (1,0) [0|3] "" Vector__XXX
 SG_ CcfClimRecircSoftBtn m131 : 25|2@0+ (1,0) [0|3] "" Vector__XXX
 SG_ CcfCO2SoftButton m131 : 29|2@0+ (1,0) [0|3] "" Vector__XXX
 SG_ CcfFrontAutoSoftBtn m131 : 60|3@0+ (1,0) [0|7] "" Vector__XXX
 SG_ CcfFrontClimPwrSftBtn m131 : 45|2@0+ (1,0) [0|3] "" Vector__XXX
 SG_ CcfFrontElecVentsCtrl m131 : 53|2@0+ (1,0) [0|3] "" Vector__XXX
 SG_ CcfFstChgPreCon m131 : 13|3@0+ (1,0) [0|7] "" Vector__XXX
 SG_ CcfHeatNowSoftBtn m131 : 39|2@0+ (1,0) [0|3] "" Vector__XXX
 SG_ CcfIoniserSoftButton m131 : 49|2@0+ (1,0) [0|3] "" Vector__XXX
 SG_ CcfRearAutoSoftBtn m131 : 63|3@0+ (1,0) [0|7] "" Vector__XXX
 SG_ CcfRearClimPwrSoftBtn m131 : 43|2@0+ (1,0) [0|3] "" Vector__XXX
 SG_ CcfRearComfortLckBtn m131 : 41|2@0+ (1,0) [0|3] "" Vector__XXX
 SG_ CcfRearElecVentsCtrl m131 : 55|2@0+ (1,0) [0|3] "" Vector__XXX
 SG_ CcfRow2ChillBlowCtrl m131 : 33|2@0+ (1,0) [0|3] "" Vector__XXX
 SG_ CcfRow3ChillBlowCtrl m131 : 35|2@0+ (1,0) [0|3] "" Vector__XXX
 SG_ CcfRow3ChillerLockBtn m131 : 57|2@0+ (1,0) [0|3] "" Vector__XXX
 SG_ CcfRow3chillerPowrBtn m131 : 51|2@0+ (1,0) [0|3] "" Vector__XXX
 SG_ CcfSyncSoftBtn m131 : 27|2@0+ (1,0) [0|3] "" Vector__XXX
 SG_ CcfVentNowSoftBtn m131 : 47|2@0+ (1,0) [0|3] "" Vector__XXX
 SG_ CcfACChrgCurrConfig m133 : 37|3@0+ (1,0) [0|7] "" Vector__XXX
 SG_ CcfBattery3Type m133 : 20|5@0+ (1,0) [0|31] "" Vector__XXX
 SG_ CcfChargingStatusHMI m133 : 15|3@0+ (1,0) [0|7] "" Vector__XXX
 SG_ CcfChargingTrblShootr m133 : 29|3@0+ (1,0) [0|7] "" Vector__XXX
 SG_ CcfEPDUType m133 : 12|5@0+ (1,0) [0|31] "" Vector__XXX
 SG_ CcfEVAppType m133 : 34|3@0+ (1,0) [0|7] "" Vector__XXX
 SG_ CcfInletLEDConfig m133 : 42|3@0+ (1,0) [0|7] "" Vector__XXX
 SG_ CcfLongLaneChngMrg m133 : 47|2@0+ (1,0) [0|3] "" Vector__XXX
 SG_ CcfManoeuvreGuidance m133 : 45|3@0+ (1,0) [0|7] "" Vector__XXX
 SG_ CcfMax3PhaseACPwrLmt m133 : 55|4@0+ (1,0) [0|15] "" Vector__XXX
 SG_ CcfMaxACCurrLmt m133 : 59|4@0+ (1,0) [0|15] "" Vector__XXX
 SG_ CcfPrdctTimeChrgDisp m133 : 26|3@0+ (1,0) [0|7] "" Vector__XXX
 SG_ CcfTRMCPartc m133 : 39|2@0+ (1,0) [0|3] "" Vector__XXX
 SG_ CcfV1GChrgFeature m133 : 23|3@0+ (1,0) [0|7] "" Vector__XXX
 SG_ CcfV2LDisChrgFeature m133 : 51|4@0+ (1,0) [0|15] "" Vector__XXX
 SG_ CcfWELMSVariant m133 : 31|2@0+ (1,0) [0|3] "" Vector__XXX
 SG_ CcfWiperDisplayTime m133 : 63|4@0+ (1,0) [0|15] "" Vector__XXX
 SG_ CcfAdasDrvDistraction m137 : 21|2@0+ (1,0) [0|3] "" Vector__XXX
 SG_ CcfAdasDrvDstrctnMnu m137 : 23|2@0+ (1,0) [0|3] "" Vector__XXX
 SG_ CcfAdasHazardsControl m137 : 26|3@0+ (1,0) [0|7] "" Vector__XXX
 SG_ CcfAdasHornControl m137 : 29|3@0+ (1,0) [0|7] "" Vector__XXX
 SG_ CcfChargePnC m137 : 34|3@0+ (1,0) [0|7] "" Vector__XXX
 SG_ CcfChildLckSoftButton m137 : 37|3@0+ (1,0) [0|7] "" Vector__XXX
 SG_ CcfClimAutoDeselect m137 : 42|3@0+ (1,0) [0|7] "" Vector__XXX
 SG_ CcfClimDistDeselect m137 : 45|3@0+ (1,0) [0|7] "" Vector__XXX
 SG_ CcfEfficientCabWarmup m137 : 50|3@0+ (1,0) [0|7] "" Vector__XXX
 SG_ CcfHFEfitment m137 : 39|2@0+ (1,0) [0|3] "" Vector__XXX
 SG_ CcfPreCrashSeatMovmnt m137 : 47|2@0+ (1,0) [0|3] "" Vector__XXX
 SG_ CcfRearMemoryFitted m137 : 31|2@0+ (1,0) [0|3] "" Vector__XXX
 SG_ CcfSeatThrmCntrlrRow1 m137 : 11|4@0+ (1,0) [0|15] "" Vector__XXX
 SG_ CcfSeatThrmCntrlrRow2 m137 : 15|4@0+ (1,0) [0|15] "" Vector__XXX
 SG_ CcfSeatThrmCntrlrRow3 m137 : 19|4@0+ (1,0) [0|15] "" Vector__XXX
 SG_ CcfSlimVents m137 : 53|3@0+ (1,0) [0|7] "" Vector__XXX
 SG_ CcfSlimVentsSoftCntrl m137 : 55|2@0+ (1,0) [0|3] "" Vector__XXX
 SG_ CcfSSRDataRecorder m137 : 63|2@0+ (1,0) [0|3] "" Vector__XXX
 SG_ CcfTSDriverMemory m137 : 58|3@0+ (1,0) [0|7] "" Vector__XXX
 SG_ CcfTSPassMemory m137 : 61|3@0+ (1,0) [0|7] "" Vector__XXX
 SG_ CcfDD00GlobalRealTime m176 : 15|32@0+ (1,0) [0|4294967295] ""  BECM,EPICD_E,HVAC,SGCM
 SG_ CcfDD02MainECUSupVolts m176 : 47|8@0+ (0.25,0) [0|63.75] "Volts"  BECM,EPICD_E,HVAC,SGCM
 SG_ CcfDD06PowerModePKT m176 : 52|5@0+ (1,0) [0|31] ""  BECM,EPICD_E,HVAC,SGCM
 SG_ CcfDD01TotalDistance m177 : 15|24@0+ (1,0) [0|16777215] ""  BECM,EPICD_E,HVAC,SGCM
 SG_ CcfDD04InCarTemp m177 : 39|8@0+ (1,-40) [-40|215] "Deg C"  BECM,EPICD_E,HVAC,SGCM
 SG_ CcfDD05OutdoorTemp m177 : 47|8@0+ (1,-40) [-40|215] "Deg C"  BECM,EPICD_E,HVAC,SGCM

BO_ 1029 VIP_405PMZ: 8 GWM
 SG_ VehicleInfoParametersPMZ : 7|64@0+ (1,0) [0|1.84467440737096E+019] ""  BCM_Gp,BECM,EPICD

BO_ 759 VkmsGWMtoBMCM1: 8 GWM
 SG_ VkmsGWMtoBMCM1_Pdu : 7|64@0+ (1,0) [0|0] "" Vector__XXX

BO_ 764 VkmsGWMtoBMCM2: 8 GWM
 SG_ VkmsGWMtoBMCM2_Pdu : 7|64@0+ (1,0) [0|0] "" Vector__XXX

BO_ 1622 XCP_1_BECM_PMZCAN: 8 BECM

BO_ 1623 XCP_2_BECM_PMZCAN: 8 BECM

BO_ 1621 XCP_REQ_BECM_PMZCAN: 8 TSTR

BO_ 1626 XCP_REQ_EPIC_PMZCAN: 8 TSTR

CM_ SG_ 1024 CcfLaneKeepAssistLDW "CCF Parameter - LaneKeepAssistLDW

MDF - 0x6631";
CM_ SG_ 1024 CcfManoeuvLightConfig "CCF Parameter - ManoeuvLightConfig

MDF - 0x6625";
CM_ SG_ 1024 CcfParkPawlLocation "CCF Parameter - ParkPawlLocation

MDF - 0x6677";
CM_ SG_ 1024 CcfPassHeatedCalfRest "CCF Parameter - PassHeatedCalfRest

MDF - 0x6667";
CM_ SG_ 1024 CcfPSMFitment "CCF Parameter - PSMFitment

MDF - 0x6641";
CM_ SG_ 1024 CcfR2SMFitment "CCF Parameter - R2SMFitment

MDF - 0x6647";
CM_ SG_ 1024 CcfR3SMFitment "CCF Parameter - R3SMFitment

MDF - 0x6651";
CM_ SG_ 1024 CcfRghtManoeuvringLgt "CCF Parameter - RghtManoeuvringLgt

MDF - 0x6627";
CM_ SG_ 1024 CcfRLSMFitment "CCF Parameter - RLSMFitment

MDF - 0x6643";
CM_ SG_ 1024 CcfRRSMFitment "CCF Parameter - RRSMFitment

MDF - 0x6645";
CM_ SG_ 1024 CcfSeatMassHanded "CCF Parameter - SeatMassHanded

MDF - 0x6671";
CM_ SG_ 1024 CcfABsPartc "CCF Parameter - ABsPartc

MDF - 0x6C87";
CM_ SG_ 1024 CcfActvDampingPartc "CCF Parameter - ActvDampingPartc

MDF - 0x6C77";
CM_ SG_ 1024 CcfAdaptiveProgMode "CCF Parameter - AdaptiveProgMode

MDF - 0x6C57";
CM_ SG_ 1024 CcfAHBSystemStatus "CCF Parameter - AHBSystemStatus

MDF - 0x6C27";
CM_ SG_ 1024 CcfAutoTRProgMode "CCF Parameter - AutoTRProgMode

MDF - 0x6C67";
CM_ SG_ 1024 CcfConfigTRMode "CCF Parameter - ConfigTRMode

MDF - 0x6C75";
CM_ SG_ 1024 CcfCorneringLampFunc "CCF Parameter - CorneringLampFunc

MDF - 0x6C21
";
CM_ SG_ 1024 CcfDrvlinePartc "CCF Parameter - DrvlinePartc

MDF - 0x6C81";
CM_ SG_ 1024 CcfEDiffPartc "CCF Parameter - EDiffPartc

MDF - 0x6C85";
CM_ SG_ 1024 CcfEmergencyBrakeIndic "CCF Parameter - EmergencyBrakeIndic

MDF - 0x6C23";
CM_ SG_ 1024 CcfEnhancedFiltration "CCF Parameter - EnhancedFiltration

MDF - 0x6C45";
CM_ SG_ 1024 CcfEPasPartc "CCF Parameter - EPasPartc

MDF - 0x6C83";
CM_ SG_ 1024 CcfHighBeamLights "CCF Parameter - HighBeamLights

MDF - 0x6C25";
CM_ SG_ 1024 CcfNFSVariant "CCF Parameter - NFSVariant

MDF - 0x6C42";
CM_ SG_ 1024 CcfProgrammableCar "CCF Parameter - ProgrammableCar

MDF - 0x6C55";
CM_ SG_ 1024 CcfReplay "CCF Parameter - Replay

MDF - 0x6C35";
CM_ SG_ 1024 CcfSlcEVChargeAlerts "CCF Parameter - SEAT BELT WARNING

MDF - 0x6C";
CM_ SG_ 1024 CcfSplitServiceMessaging "CCF Parameter - SplitServiceMessaging

MDF - 0x6C31";
CM_ SG_ 1024 CcfTrackProgMode "CCF Parameter - TrackProgMode

MDF - 0x6C65";
CM_ SG_ 1024 CcfTRFitment "CCF Parameter - TRFitment

MDF - 0x6C47";
CM_ SG_ 1024 CcfTRSwitchType "CCF Parameter - TRSwitchType

MDF - 0x6C52";
CM_ SG_ 1024 CcfULPMProgMode "CCF Parameter - ULPMProgMode

MDF - 0x6C62";
CM_ SG_ 1024 CcfWadeProgMode "CCF Parameter - WadeProgMode

MDF - 0x6C72";
CM_ SG_ 1024 CcfWakeupShutDownSeqMenu "CCF Parameter - WakeupShutDownSeqMenu 

MDF - 0x6C37";
CM_ SG_ 1024 Ccf3DrAccessRearFeature "CCF Parameter - 3DrAccessRearFeature

MDF - 0x6E25";
CM_ SG_ 1024 CcfAHBSensitivtyMenu "CCF Parameter - AHBSensitivtyMenu

MDF - 0x6E37";
CM_ SG_ 1024 CcfAuxDrivingLamps "CCF Parameter - AuxDrivingLamps

MDF - 0x6E27";
CM_ SG_ 1024 CcfBattery1Type "CCF Parameter - Battery1Type

MDF - 0x6E74";
CM_ SG_ 1024 CcfBattery2BMS "CCF Parameter - Battery2BMS

MDF - 0x6E41";
CM_ SG_ 1024 CcfBrakePadWearIndication "CCF Parameter - BrakePadWearIndication

MDF - 0x6E35";
CM_ SG_ 1024 CcfImmobiliserChannels "CCF Parameter - ImmobiliserChannels

MDF - 0x6E67";
CM_ SG_ 1024 CcfInteriorReleaseTailgate "CCF Parameter - InteriorReleaseTailgate

MDF - 0x6E85";
CM_ SG_ 1024 CcfLightsOnWhenWipers "CCF Parameter - LightsOnWhenWipers

MDF - 0x6E33";
CM_ SG_ 1024 CcfPixelTouristMode "CCF Parameter - PixelTouristMode

MDF - 0x6E45";
CM_ SG_ 1024 CcfPSDBFitted "CCF Parameter - PSDBFitted

MDF - 0x6E47";
CM_ SG_ 1024 CcfRearFoldFlat "CCF Parameter - RearFoldFlat

MDF - 0x6E23";
CM_ SG_ 1024 CcfRemoteReleaseTailgate "CCF Parameter - RemoteReleaseTailgate

MDF - 0x6E83";
CM_ SG_ 1024 CcfTailgateHingeType "CCF Parameter - TailgateHingeType

MDF - 0x6E87";
CM_ SG_ 1024 CcfVIAutoIllumination "CCF Parameter - VIAutoIllumination

MDF - 0x6E57";
CM_ SG_ 1024 CcfVICustomisableShortcut "CCF Parameter - VICustomisableShortcut

MDF - 0x6E77";
CM_ SG_ 1024 CcfVisionInteraction "CCF Parameter - VisionInteraction

MDF - 0x6E81";
CM_ SG_ 1024 CcfVQMFitted "CCF Parameter - VQMFitted

MDF - 0x6E54";
CM_ SG_ 1024 CcfVSMLVehicleHealthWarn "CCF Parameter - VSMLVehicleHealthWarn

MDF - 0x6E21";
CM_ SG_ 1024 CcfVSMOilLevelUnit "CCF Parameter - VSMOilLevelUnit

MDF - 0x6E43";
CM_ SG_ 1024 CcfWirelessDeviceCharger "CCF Parameter - WirelessDeviceCharger

MDF - 0x6E52";
CM_ SG_ 1024 CcfXenonLamps "CCF Parameter - XenonLamps

MDF - 0x6E31";
CM_ SG_ 1024 CcfA2BConfigurationNo "CCF Parameter - A2BConfigurationNo

MDF - 0x6F27";
CM_ SG_ 1024 CcfAutoSSSelectInFCPB "CCF Parameter - AutoSSSelectInFCPB

MDF - 0x6F62";
CM_ SG_ 1024 CcfDSCSelectInFCPB "CCF Parameter - DSCSelectInFCPB

MDF - 0x6F65";
CM_ SG_ 1024 CcfHDCSelectInFCPB "CCF Parameter - HDCSelectInFCPB

MDF - 0x6F72";
CM_ SG_ 1024 CcfIVIType "CCF Parameter - IVIType

MDF - 0x6F47";
CM_ SG_ 1024 CcfManovLightFadeTime "CCF Parameter - ManovLightFadeTime

MDF - 0c6F57";
CM_ SG_ 1024 CcfManovLightRevTime "CCF Parameter - ManovLightRevTime

MDF - 0c6F53";
CM_ SG_ 1024 CcfOdoLeadingZero "CCF Parameter - OdoLeadingZero

MDF - 0c6F77";
CM_ SG_ 1024 CcfPreCrashSeatBltPretent "CCF Parameter - PreCrashSeatBltPretent

MDF - 0c6F87";
CM_ SG_ 1024 CcfRemoteWingMirrorFold "CCF Parameter - RemoteWingMirrorFold

MDF - 0x6F67";
CM_ SG_ 1024 CcfSpeedoMainScaleUnits "CCF Parameter - SpeedoMainScaleUnits

MDF - 0x6F32";
CM_ SG_ 1024 CcfSpeedoSecondDisplay "CCF Parameter - SpeedoSecondDisplay

MDF - 0c6F35";
CM_ SG_ 1024 CcfTerComSelectInFCPB "CCF Parameter - TerComSelectInFCPB

MDF - 0x6F82";
CM_ SG_ 1024 CcfTerDynSelectInFCPB "CCF Parameter - TerDynSelectInFCPB

MDF - 0x6F85";
CM_ SG_ 1024 CcfTerECOSelectInFCPB "CCF Parameter - TerECOSelectInFCPB

MDF - 0x6F75";
CM_ SG_ 1024 CcfTripCompInitialUnits "CCF Parameter - TripCompInitialUnits

MDF - 0x6F37";
CM_ SG_ 1024 CcfAllWheelSteer "CCF Parameter - AllWheelSteer

MDF - 0x7077";
CM_ SG_ 1024 CcfATPCSelectInFCPB "CCF Parameter - ATPCSelectInFCPB

MDF - 0x7022";
CM_ SG_ 1024 CcfClimateHardKey "CCF Parameter - ClimateHardKey

MDF - 0x7087";
CM_ SG_ 1024 CcfFrontFogFuntionality "CCF Parameter - FrontFogFuntionality

MDF - 0x7085";
CM_ SG_ 1024 CcfInstrumentSkin "CCF Parameter - InstrumentSkin

MDF - 0x7067";
CM_ SG_ 1024 CcfOdometerUnits "CCF Parameter - OdometerUnits

MDF - 0x7055";
CM_ SG_ 1024 CcfParkAid "CCF Parameter - ParkAid

MDF - 0x7037";
CM_ SG_ 1024 CcfPreCrashSeatSquab "CCF Parameter - PreCrashSeatSquab

MDF - 0x7057";
CM_ SG_ 1024 CcfSpdoSecondDisplayUnit "CCF Parameter - SpdoSecondDisplayUnit

MDF - 0x7052";
CM_ SG_ 1024 CcfSpeedoRange "CCF Parameter - SpeedoRange

MDF - 0x7047";
CM_ SG_ 1024 CcfTachoGaugeVariant "CCF Parameter - TachoGaugeVariant

MDF - 0x7062";
CM_ SG_ 1024 CcfTerAutoSelectInFCPB "CCF Parameter - AutoSelectInFCPB

MDF - 0x7025";
CM_ SG_ 1024 CcfTerGGSSelectInFCPB "CCF Parameter - TerGGSSelectInFCPB

MDF - 0x7032";
CM_ SG_ 1024 CcfTerMudSelectInFCPB "CCF Parameter - TerMudSelectInFCPB

MDF - 0x7035";
CM_ SG_ 1024 CcfTerSandSelectInFCPB "CCF Parameter - TerSandSelectInFCPB

MDF - 0x7042";
CM_ SG_ 1024 CcfTripCompFuelEconomy "CCF Parameter - TripCompFuelEconomy

MDF - 0x7075";
CM_ SG_ 1024 CcfTripCompMetFulEcoUnt "CCF Parameter - TripCompMetFulEcoUnt

MDF - 0x7027";
CM_ SG_ 1024 CcfVTGlazingRoof "CCF Parameter - VTGlazingRoof

MDF - 0x7082";
CM_ SG_ 1024 CcfBattery2Type "CCF Parameter - Battery2Type

MDF - 0x7124";
CM_ SG_ 1024 CcfBSCMFitted "CCF Parameter - BSCMFitted

MDF - 0x7141";
CM_ SG_ 1024 CcfConventionalCharging "CCF Parameter - ConventionalCharging

MDF - 0x7153";
CM_ SG_ 1024 CcfDriveModeDiscStrat "CCF Parameter - DriveModeDiscStrat

MDF - 0x7157";
CM_ SG_ 1024 CcfDriveModeOrder "CCF Parameter - DriveModeOrder

MDF - 0x7165";
CM_ SG_ 1024 CcfDriveModeSigSchema "CCF Parameter - DriveModeSigSchema

MDF - 0x7175";
CM_ SG_ 1024 CcfEVRangeInfoWithPMZ "CCF Parameter - EVRangeInfoWithPMZ

MDF - 0x7177";
CM_ SG_ 1024 CcfEVSelectInBlade "CCF Parameter - EVSelectInBlade

MDF - 0x7127";
CM_ SG_ 1024 CcfEVSelectInFCPB "CCF Parameter - EVSelectInFCPB

MDF - 0x7182";
CM_ SG_ 1024 CcfFLCVariant "CCF Parameter - FLCVariant

MDF - 0x7187";
CM_ SG_ 1024 CcfLeisureBatt "CCF Parameter - LeisureBatt

MDF - 0x7167";
CM_ SG_ 1024 CcfOverspeedSaudi "CCF Parameter - OverspeedSaudi

MDF - 0x7184";
CM_ SG_ 1024 CcfParkAssist "CCF Parameter - ParkAssist

MDF - 0x7133";
CM_ SG_ 1024 CcfSpdoScndDispEnblMenu "CCF Parameter - SpdoScndDispEnblMenu

MDF - 0x7143";
CM_ SG_ 1024 CcfSpdoScndDispUnitMenu "CCF Parameter - SpdoScndDispUnitMenu

MDF - 0x7147";
CM_ SG_ 1024 CcfSpecialClock "CCF Parameter - SpecialClock

MDF - 0x7137";
CM_ SG_ 1024 CcfSpeedoMinorScale "CCF Parameter - SpeedoMinorScale

MDF - 0x7145";
CM_ SG_ 1024 CcfVIAutoStart "CCF Parameter - VIAutoStart

MDF - 0x7151";
CM_ SG_ 1024 CcfAirSusSelectInFCPB "CCF Parameter - AirSusSelectInFCPB

MDF - 0x7262";
CM_ SG_ 1024 CcfBacklightDimStratSel "CCF Parameter - BacklightDimStratSel

MDF - 0x7247";
CM_ SG_ 1024 CcfCCMVariant "CCF Parameter - CCMVariant

MDF - 0x7233";
CM_ SG_ 1024 CcfCityDrivingPwrSteer "CCF Parameter - CityDrivingPwrSteer

MDF - 0x7257";
CM_ SG_ 1024 CcfDADCModule "CCF Parameter - DADCModule

MDF - 0x7227";
CM_ SG_ 1024 CcfDynSuspensionType "CCF Parameter - DynSuspensionType

MDF - 0x7287";
CM_ SG_ 1024 CcfFrontCornerRadars "CCF Parameter - FrontCornerRadars

MDF - 0x7245";
CM_ SG_ 1024 CcfGuidanceBeamCCF "CCF Parameter - GuidanceBeamCCF

MDF - 0x7277";
CM_ SG_ 1024 CcfHandsOnDetection "CCF Parameter - HandsOnDetection

MDF - 0x7221";
CM_ SG_ 1024 CcfLoRngSelectInFCPB "CCF Parameter - LoRngSelectInFCPB

MDF - 0x7272";
CM_ SG_ 1024 CcfPredictableAFS "CCF Parameter - PredictableAFS

MDF - 0x7267";
CM_ SG_ 1024 CcfRearCornerRadars "CCF Parameter - RearCornerRadars

MDF - 0x7242";
CM_ SG_ 1024 CcfTA2InputControl "CCF Parameter - TA2InputControl

MDF - 0x7237";
CM_ SG_ 1024 CcfTA2SelectInFCPB "CCF Parameter - TA2SelectInFCPB

MDF - 0x7252";
CM_ SG_ 1024 CcfTelematicsSignIn "CCF Parameter - TelematicsSignIn

MDF - 0x7223";
CM_ SG_ 1024 CcfTerCPSelectInFCPB "CCF Parameter - TerCPSelectInFCPB

MDF - 0x7282";
CM_ SG_ 1024 CcfTerCTSelectInFCPB "CCF Parameter - TerCTSelectInFCPB

MDF - 0x7275";
CM_ SG_ 1024 CcfTerRockSelectInFCPB "CCF Parameter - TerRockSelectInFCPB

MDF - 0x7255";
CM_ SG_ 1024 CcfTerWadeSelectInFCPB "CCF Parameter - TerWadeSelectInFCPB

MDF - 0x7265";
CM_ SG_ 1024 CcfADASCBV "CCF Parameter - ADASCBV

MDF - 0x7357";
CM_ SG_ 1024 CcfApproachOpenDoors "CCF Parameter - ApproachOpenDoors

MDF - 0x7385";
CM_ SG_ 1024 CcfATPCPRO "CCF Parameter - ATPCPRO

MDF - 0x7342";
CM_ SG_ 1024 CcfCamWashType "CCF Parameter - CamWashType

MDF - 0x7372";
CM_ SG_ 1024 CcfeHorizonVariant "CCF Parameter - eHorizonVariant

MDF - 0x7332";
CM_ SG_ 1024 CcfEngCoolantHotWarn "CCF Parameter - EngCoolantHotWarn

MDF - 0x7354";
CM_ SG_ 1024 CcfEngCoolantVryHotWarn "CCF Parameter - EngCoolantVryHotWarn

MDF - 0x7364";
CM_ SG_ 1024 CcfEVSDCalNo "CCF Parameter - EVSDCalNo

MDF - 0x7327";
CM_ SG_ 1024 CcfGestureBonnet "CCF Parameter - GestureBonnet

MDF - 0x7387";
CM_ SG_ 1024 CcfGestureDoorHandles "CCF Parameter - GestureDoorHandles

MDF - 0x7377";
CM_ SG_ 1024 CcfPowerSideDoors "CCF Parameter - PowerSideDoors

MDF - 0x7375";
CM_ SG_ 1024 CcfRefrigerantType "CCF Parameter - RefrigerantType

MDF - 0x7335";
CM_ SG_ 1024 CcfReverseLightActStra "CCF Parameter - ReverseLightActStra

MDF - 0x7345";
CM_ SG_ 1024 CcfSeeThroughTrailer "CCF Parameter - SeeThroughTrailer

MDF - 0x7347";
CM_ SG_ 1024 CcfSideDoorObjectDet "CCF Parameter - SideDoorObjectDet

MDF - 0x7382";
CM_ SG_ 1024 CcfVehClearGuidance "CCF Parameter - VehClearGuidance

MDF - 0x7337";
CM_ SG_ 1024 CcfVertAccelSource "CCF Parameter - VertAccelSource

MDF - 0x7367";
CM_ SG_ 1024 CcfActiveBrakeDuctVanes "CCF Parameter - ActiveBrakeDuctVanes

MDF - 0x7587";
CM_ SG_ 1024 CcfDADLInhibitOff "CCF Parameter - DADLInhibitOff 
(was InfotainEmerParam4)

MDF - 0x7537";
CM_ SG_ 1024 CcfEDUDriveline "CCF Parameter - EDUDriveline

MDF - 0x7582";
CM_ SG_ 1024 CcfFrntUpperDispMargin "CCF Parameter - FrntUpperDispMargin

MDF - 0x7543";
CM_ SG_ 1024 CcfFrtAnmSeqWkUpShutDn "CCF parameter - FrtAnmSeqWkUpShutDn

MDF - 0x7585";
CM_ SG_ 1024 CcfIVIAPIXClusterComms "CCF Parameter -IVIAPIXClusterComms

MDF - 0x7547";
CM_ SG_ 1024 CcfIVIeSIMProfileType "CCF Parameter - IVIeSIMProfileType

MDF - 0x7567";
CM_ SG_ 1024 CcfIVIWiFiHotspot "CCF Parameter - IVIWiFiHotspot

MDF - 0x7531";
CM_ SG_ 1024 CcfLHSWSFvClusterView "CCF Parameter - LHSWSFvClusterView (was InfotainEmerParam3)

MDF - 0x7535";
CM_ SG_ 1024 CcfPM25Market "CCF Parameter - PM25Market

MDF - 0x7527";
CM_ SG_ 1024 CcfPwrTgateHMIControl "CCF Parameter - PwrTgateHMIControl
(was InfotainEmerParam7)
MDF - 0x7557";
CM_ SG_ 1024 CcfRoofControlStrategy "CCF Parameter - RoofControlStrategy

MDF - 0x7577";
CM_ SG_ 1024 CcfUserEEBReserveMgmt "CCF Parameter -UserEEBReserveMgmt  (was LaserHighBeamMenu)

MDF - 0x7533";
CM_ SG_ 1024 CcfAnmProjWakeUpShutDn "CCF Parameter - AnmProjWakeUpShutDn

MDF - 0x7627";
CM_ SG_ 1024 CcfBrakeWarnings "CCF Parameter - BrakeWarnings

MDF - 0x7647";
CM_ SG_ 1024 CcfHVBatteryCapacity "CCF Parameter - HVBatteryCapacity

MDF - 0x7657";
CM_ SG_ 1024 CcfIndirectVentsFitted "CCF Parameter - IndirectVentsFitted

MDF - 0x7667";
CM_ SG_ 1024 CcfPreEmpSuspBowWvDmp "CCF Parameter - PreEmpSuspBowWvDmp

MDF - 0x7687";
CM_ SG_ 1024 CcfPreEmpSusPitchDamp "CCF Parameter - PreEmpSusPitchDamp

MDF - 0x7681";
CM_ SG_ 1024 CcfPreEmptSusCnrRdEnh "CCF Parameter - PreEmptSusCnrRdEnh

MDF - 0x7677";
CM_ SG_ 1024 CcfPreEmptSusCollMtgn "CCF Parameter - PreEmptSusCollMtgn

MDF - 0x7673";
CM_ SG_ 1024 CcfPreEmptSusCrPkAccHt "CCF Parameter - PreEmptSusCrPkAccHt

MDF - 0x7685";
CM_ SG_ 1024 CcfPreEmptSusKrbStrkDt "CCF Parameter - PreEmptSusKrbStrkDt

MDF - 0x7683";
CM_ SG_ 1024 CcfPreEmptSusSpeedLwr "CCF Parameter - PreEmptSusSpeedLwr

MDF - 0x7675";
CM_ SG_ 1024 CcfRow1SeatBolster "CCF Parameter - Row1SeatBolster

MDF - 0x7641";
CM_ SG_ 1024 CcfRow1SeatCushExt "CCF Parameter - Row1SeatCushExt

MDF - 0x7631";
CM_ SG_ 1024 CcfRow1SeatHeadrest "CCF Parameter - Row1SeatHeadrest

MDF - 0x7634";
CM_ SG_ 1024 CcfRow1SeatLumbar "CCF Parameter - Row1SeatLumbar

MDF - 0x7637";
CM_ SG_ 1024 CcfRow1SeatShoulder "CCF Parameter - Row1SeatShoulder

MDF - 0x7643";
CM_ SG_ 1024 CcfRow2SeatBolster "CCF Parameter - Row2SeatBolster

MDF - 0x7645";
CM_ SG_ 1024 CcfRow2SeatHeadrest "CCF Parameter - Row2SeatHeadrest

MDF - 0x7652";
CM_ SG_ 1024 CcfRow2SeatLumbar "CCF Parameter - Row2SeatLumbar

MDF - 0x7662";
CM_ SG_ 1024 CcfRow2SeatShoulder "CCF Parameter - Row2SeatShoulder

MDF - 0x7664";
CM_ SG_ 1024 CcfRrAnmSeqWkUpShutDn "CCF Parameter - RrAnmSeqWkUpShutDn

MDF - 0x7622";
CM_ SG_ 1024 CcfTailgateEventExperience "CCF Parameter - TailgateEventExperience

MDF - 0x7624";
CM_ SG_ 1024 CcfTailgateEventLight "CCF Parameter - TailgateEventLight

MDF - 0x7671";
CM_ SG_ 1024 Ccf4x4iD8Driveline "CCF Parameter - 4x4iD8Driveline

MDF - 0x7777";
CM_ SG_ 1024 CcfAirSuspUIType "CCF Parameter - AirSuspUIType

MDF - 0x7724";
CM_ SG_ 1024 CcfAutoStpStrtButtonType "CCF Parameter - AutoStpStrtButtonType

MDF - 0x7744";
CM_ SG_ 1024 CcfCentrSideAirbag "CCF Parameter - CentrSideAirbag

MDF - 0x7733";
CM_ SG_ 1024 CcfDSCSwitchSource "CCF Parameter - DSCSwitchSource

MDF - 0c7772";
CM_ SG_ 1024 CcfIMSCalNo1 "CCF Parameter - IMSCalNo1

MDF - 0x7757";
CM_ SG_ 1024 CcfIMSCalNo2 "CCF Parameter - IMSCalNo2

MDF - 0x7767";
CM_ SG_ 1024 CcfIMSType "CCF Parameter - IMSType

MDF - 0x7727";
CM_ SG_ 1024 CcfLSPFitment "CCF Parameter - LSPFitment

MDF - 0c7774";
CM_ SG_ 1024 CcfPNLeisureBattstatus "CCF Parameter - PNLeisureBattstatus

MDF - 0x7741";
CM_ SG_ 1024 CcfPoliceLightsFuncReq "CCF Parameter - PoliceLightsFuncReq

MDF - 0x7784";
CM_ SG_ 1024 CcfPreEmptSusPkgKrbAvd "CCF Parameter - PreEmptSusPkgKrbAvd

MDF - 0x7721";
CM_ SG_ 1024 CcfPyroBrake "CCF Parameter - PyroBrake

MDF - 0x7731";
CM_ SG_ 1024 CcfSeatPeripheralCtrl "CCF Parameter - SeatPeripheralCtrl

MDF - 0x7787";
CM_ SG_ 1024 CcfTaskLightingTLMB "CCF Parameter - TaskLightingTLMB

MDF - 0x7735";
CM_ SG_ 1024 CcfTaskLightingTLMC "CCF Parameter - TaskLightingTLMC

MDF - 0x7737";
CM_ SG_ 1024 CcfTracDSCFitted "CCF Parameter - TracDSCFitted

MDF - 0x7747";
CM_ SG_ 1024 CcfAGMcActrFitment "CCF Parameter - AGMcActrFitment

MDF - 0x7863";
CM_ SG_ 1024 CcfAGMdActrFitment "CCF Parameter - AGMdActrFitment

MDF - 0x7865";
CM_ SG_ 1024 CcfCabinSnapshot "CCF Parameter - CabinSnapshot

MDF - 0x7844";
CM_ SG_ 1024 CcfCDMHandlingPartc "CCF Parameter - CDMHandlingPartc

MDF - 0x7867";
CM_ SG_ 1024 CcfCDMISCSPartc "CCF Parameter - CDMISCSPartc

MDF - 0x7875";
CM_ SG_ 1024 CcfCTRBCSPartc "CCF Parameter - CTRBCSPartc

MDF - 0x7877";
CM_ SG_ 1024 CcfEVBattUsablekWh "CCF Parameter - EVBattUsablekWh

MDF - 0x7887";
CM_ SG_ 1024 CcfExpDateFormatSigs "CCF Parameter - ExpDateFormatSigs

MDF - 0x7857";
CM_ SG_ 1024 CcfFntClimateSeatsSZM "CCF Parameter - FntClimateSeatsSZM

MDF - 0x7825";
CM_ SG_ 1024 CcfHDAdaptDrvBeam "CCF Parameter - HDAdaptDrvBeam

MDF - 0x7821";
CM_ SG_ 1024 CcfItemReminder "CCF Parameter - ItemReminder

MDF - 0x7852";
CM_ SG_ 1024 CcfOCSPFitment "CCF Parameter - OCSPFitment

MDF - 0x7841";
CM_ SG_ 1024 CcfPassSeatHeelCatcher "CCF Parameter - PassSeatHeelCatcher

MDF - 0x7827";
CM_ SG_ 1024 CcfPetrolEmissionsHW "CCF Parameter - PetrolEmissionsHW

MDF - 0x7873";
CM_ SG_ 1024 CcfRemoteDeviceReminder "CCF Parameter - RemoteDeviceReminder

MDF - 0x7847";
CM_ SG_ 1024 CcfRrClimateSeatsSZM "CCF Parameter - RrClimateSeatsSZM

MDF - 0x7834";
CM_ SG_ 1024 CcfSpecialVehicles "CCF Parameter - SpecialVehicles

MDF - 0x7837";
CM_ SG_ 1024 CcfSpeedoMarket "CCF Parameter - SpeedoMarket

MDF - 0x7861";
CM_ SG_ 1024 CcfTEETailgateActuation "CCF Parameter - TEETailgateActuation

MDF - 0x7855";
CM_ SG_ 1024 CcfATPCButtonType "CCF Parameter - ATPCButtonType

MDF - 0x7A75";
CM_ SG_ 1024 CcfAutoBlowerIntensityLvlConfig "CCF Parameter - AutoBlowerIntensityLvlConfig

MDF - 0x7A85";
CM_ SG_ 1024 CcfDDMCalibration "CCF Parameter Name: DDMCalibration

MDF: 0x7A35";
CM_ SG_ 1024 CcfDepDoorHandShowMode "CCF Parameter - DepDoorHandShowMode

MDF - 0x7A25";
CM_ SG_ 1024 CcfFntLowerDispHaptic "CCF Parameter - FntLowerDispHaptic

MDF - 0x7A27";
CM_ SG_ 1024 CcfFntUpperDispHaptic "CCF Parameter - FntUpperDispHaptic

MDF - 0x7A37";
CM_ SG_ 1024 CcfPhoneSignalBooster "CCF Parameter - PhoneSignalBooster

MDF - 0x7A87";
CM_ SG_ 1024 CcfPM25SensorType "CCF Parameter - PM25SensorType

MDF - 0x7A72";
CM_ SG_ 1024 CcfRearChillerUserControl "CCF Parameter - RearChillerUserControl

MDF - 0x7A82";
CM_ SG_ 1024 CcfRSESubscriptionVer "CCF Parameter - RSESubscriptionVerMSB / RSESubscriptionVerLSB

MDF - 0x7A47 / 0x7A57";
CM_ SG_ 1024 CcfSeatSpec "CCF Parameter - SeatSpec

MDF - 0x7A22";
CM_ SG_ 1024 CcfSensorSlopeType "CCF Parameter - SensorSlopeType 

MDF - 0x7A67";
CM_ SG_ 1024 CcfTailgateCloseLockSwitch "CCF Parameter - TailgateCloseLockSwitch

MDF - 0x7A32";
CM_ SG_ 1024 CcfTSSecSeatMovement "CCF Parameter - TSSecSeatMovement

MDF - 0x7A77";
CM_ SG_ 1024 CcfADASAlertSensitivity "CCF Parameter - ADASAlertSensitivity

MDF - 0x7B45";
CM_ SG_ 1024 CcfADASSpdLimOffset "CCF Parameter - ADASSpdLimOffset

MDF - 0x7B22";
CM_ SG_ 1024 CcfAutoHoldType "CCF Parameter - AutoHoldType (was InfotainEmerParm11)

MDF - 0x7B87";
CM_ SG_ 1024 CcfDeployableRSEType "CCF Parameter - DeployableRSEType

MDF - 0x7B82";
CM_ SG_ 1024 CcfEcoDrivingCoachVar "CCF Parameter - EcoDrivingCoachVar
(Was InfotainEmerParam8)
MDF - 0x7B77";
CM_ SG_ 1024 CcfEVInletLidSecure "CCF Parameter - EVInletLidSecure

MDF - 0x7B37";
CM_ SG_ 1024 CcfFirstRowFridge "CCF Parameter - FirstRowFridge

MDF - 0x7B85";
CM_ SG_ 1024 CcfFogLampLocation "CCF Parameter - FogLampLocation

MDF - 0x7B57";
CM_ SG_ 1024 CcfFrntLoadSpaceLight "CCF Parameter - FrntLoadSpaceLight

MDF - 0x7B27";
CM_ SG_ 1024 CcfPersonalisationStorage "CCF Parameter - PersonalisationStorage

MDF - 0x7B25";
CM_ SG_ 1024 CcfPwrSideDrBrakePedalClose "CCF Parameter - PwrSideDrBrakePedalClose

MDF - 0x7B42";
CM_ SG_ 1024 CcfRevLampLocation "CCF Parameter - RevLampLocation

MDF - 0x7B53";
CM_ SG_ 1024 CcfRrClimateAutoSigs "CCF Parameter - RrClimateAutoSigs
(was InfotainEmerParm10)

MDF - 0x7B47";
CM_ SG_ 1024 CcfRrDILampLocation "CCF Parameter - RrDILampLocation

MDF - 0x7B67";
CM_ SG_ 1024 CcfRrPosLampLocation "CCF Parameter - RrPosLampLocation

MDF - 0x7B73";
CM_ SG_ 1024 CcfRrSideDrTwoStgRel "CCF Parameter - RrSideDrTwoStgRel

MDF - 0x7B32";
CM_ SG_ 1024 CcfStopLampLocation "CCF Parameter - StopLampLocation

MDF - 0x7B63";
CM_ SG_ 1024 CcfTRDriAdvAirSusRcmndRse "CCF Parameter - TRDriAdvAirSusRcmndRse

MDF - 0x7B35";
CM_ SG_ 1024 CcfASDProgMode "CCF Parameter - ASDProgMode

MDF - 0x7C82";
CM_ SG_ 1024 CcfAutoBlrIntenstySet "CCF Parameter - AutoBlrIntenstySet

MDF - 0x7C47";
CM_ SG_ 1024 CcfBrakeSystemTypeCRB "CCF Parameter - BrakeSystemTypeCRB

MDF - 0x7C37";
CM_ SG_ 1024 CcfClimateHMIControlStrategy "CCF Parameter - ClimateHMIControlStrategy

MDF - 0x7C85";
CM_ SG_ 1024 CcfDADLSpeedOptions "CCF Parameter - DADLSpeedOptions

MDF - 0c7C75";
CM_ SG_ 1024 CcfEVInletLidPosition "CCF Parameter - EVInletLidPosition

MDF - 0x7C72";
CM_ SG_ 1024 CcfEVInletLidType "CCF Parameter - EVInletLidType

MDF - 0x7C62";
CM_ SG_ 1024 CcfEVInletUnlockType "CCF Parameter - EVInletUnlockType

MDF - 0x7C65";
CM_ SG_ 1024 CcfGearboxFltWarStrat "CCF Parameter - GearboxFltWarStrat

MDF - 0x7C77";
CM_ SG_ 1024 CcfGSMSOption "CCF Parameter - GSMSOption (was InfotainEmerParm12)

MDF - 0x7C27";
CM_ SG_ 1024 CcfHealthWellnessActiv "CCF Parameter - HealthWellnessActiv

MDF - 0x7C22";
CM_ SG_ 1024 CcfINCARTempSensorTyp "CCF Parameter - INCARTempSensorTyp

MDF - 0x7C25";
CM_ SG_ 1024 CcfIPMAWSVarCal "CCF Parameter - IPMAWSVarCal

MDF - 0x7C45";
CM_ SG_ 1024 CcfMLASoftSwitches "CCF Parameter - MLASoftSwitches
(was InfotainEmerParm13)

MDF - 0x7C35";
CM_ SG_ 1024 CcfPredictvEnrgyOptm "CCF Parameter -PredictvEnrgyOptm
(was InfotainEmerParam9)

MDF - 0x7C33";
CM_ SG_ 1024 CcfSeatbuckleLED "CCF Parameter - SeatbuckleLED

MDF - 0x7C87";
CM_ SG_ 1024 CcfSpeechSesDuckBehav "CCF Parameter - SpeechSesDuckBehav
(Was InfotainEmerParm15)
MDF - 0x7C67";
CM_ SG_ 1024 CcfTemperatureUnits "CCF Parameter - TemperatureUnits

MDF - 0x7C52";
CM_ SG_ 1024 CcfTRClusterRibbonDir "CCF Parameter - TRClusterRibbonDir

MDF - 0x7C55";
CM_ SG_ 1024 CcfUsrEEBReserveMgmt "CCF Parameter - UsrEEBReserveMgmt
(was InfotainEmerParm14)

MDF - 0x7C57";
CM_ SG_ 1024 CcfBrakeDuctType "CCF Parameter - BrakeDuctType

MDF - 0x7D32";
CM_ SG_ 1024 CcfCamVideoResolution "CCF Parameter - CcfCamVideoResolution (Was InfotainEmerParm16)

MDF - 0x7D67";
CM_ SG_ 1024 CcfHapticSeatPowertrain "CCF -HapticSeatPowertrain

MDF-0x7D74";
CM_ SG_ 1024 CcfHapticSeatsAudio "CCF Parameter - HapticSeatsAudio

MDF - 0x7D54";
CM_ SG_ 1024 CcfInfoEmerChargePnC "CCF Parameter - InfoEmerChargePnC

MDF - 0x7D27";
CM_ SG_ 1024 CcfInfotainEmerParm20 "CCF Parameter - InfotainEmerParm20

MDF - 0x7D37";
CM_ SG_ 1024 CcfInfotainEmerParm21 "CCF Parameter - InfotainEmerParm21

MDF - 0x7D47";
CM_ SG_ 1024 CcfMILActtDrivingCycl "CCF Parameter - MILActtDrivingCycl

MDF - 0x7D45";
CM_ SG_ 1024 CcfOffRoadRideHeight "CCF Parameter - OffRoadRideHeight

MDF - 0x7D42";
CM_ SG_ 1024 CcfPwrDoorCrankOp "CCF-PwrDoorCrankOp

MDF-0x7D25";
CM_ SG_ 1024 CcfRainSensorType "CCF Parameter - RainSensorType

MDF - 0x7D77";
CM_ SG_ 1024 CcfRefrigerantLoop "CCF Parameter - RefrigerantLoop

MDF - 0x7D23";
CM_ SG_ 1024 CcfSmartProgramWiping "CCF Parameter - SmartProgramWiping

MDF - 0x7D35";
CM_ SG_ 1024 CcfSVDynamicMode "CCF Parameter - SVDynamicMode

MDF - 0x7D87";
CM_ SG_ 1024 CcfVibroAcousticTherapy "CCF -VibroAcousticTherapy

MDF-0x7D84";
CM_ SG_ 1024 CcfAlcoholIntLKDevice "CCF Parameter - AlcoholIntLKDevice

MDF - 0x7E47";
CM_ SG_ 1024 CcfCabinCleanCyclTime "CCF Parameter - CabinCleanCyclTime

MDF - 0x7E57";
CM_ SG_ 1024 CcfCornerSpeedAdapt "CCF Parameter - CornerSpeedAdapt

MDF - 0x7E45";
CM_ SG_ 1024 CcfEnhFiltrationAQI "CCF Parameter -EnhFiltrationAQI
(was InfotainEmerParm19)

MDF - 0x7E33";
CM_ SG_ 1024 CcfHapticPwrTrnCalNo "CCF Parameter - HapticPwrTrnCalNo

MDF - 0x7E27";
CM_ SG_ 1024 CcfInfotainEmerParm22 "CCF Parameter - InfotainEmerParm22

MDF - 0x7E37";
CM_ SG_ 1024 CcfInfotainEmerParm23 "CCF Parameter - InfotainEmerParm23

MDF - 0x7E67";
CM_ SG_ 1024 CcfInfotainEmerParm24 "CCF Parameter - InfotainEmerParm24

MDF - 0x7E77";
CM_ SG_ 1024 CcfRefrigerantSnsHVAC "CCF Parameter - RefrigerantSnsHVAC

MDF - 0x7E83";
CM_ SG_ 1024 CcfSidebarControls "CCF Parameter - SidebarControls 
(Was-InfotainEmerParm25)

MDF - 0x7E87";
CM_ SG_ 1024 CcfSpeedLimitAdapt "CCF Parameter - SpeedLimitAdapt

MDF - 0x7E43";
CM_ SG_ 1024 CcfAEBMenu "CCF Parameter - AEBMenu

MDF - 0x8037";
CM_ SG_ 1024 CcfDriverCondMonMenu "CCF Parameter - DriverCondMonMenu

MDF - 0x8062";
CM_ SG_ 1024 CcfDrvModeSwitchMsg "CCF Parameter - DrvModeSwitchMsg

MDF - 0x8067";
CM_ SG_ 1024 CcfeTSRFaultInd "CCF Parameter - eTSRFaultInd

MDF - 0x8087";
CM_ SG_ 1024 CcfFLCHeating "CCF Parameter - FLCHeating

MDF - 0x8084";
CM_ SG_ 1024 CcfHDCButtonType "CCF Parameter - HDCButtonType

MDF - 0x8072";
CM_ SG_ 1024 CcfHibernatedNav "CCF Parameter - HibernatedNav

MDF - 0x8077";
CM_ SG_ 1024 CcfIVILoRngSwitchFit "CCF Parameter - IVILoRngSwitchFit

MDF - 0x8027";
CM_ SG_ 1024 CcfLaneAssistMenu "CCF Parameter - LaneAssistMenu

MDF - 0x8047";
CM_ SG_ 1024 CcfNewSpdLimAudioAlrt "CCF Parameter - NewSpdLimAudioAlrt

MDF - 0x8055";
CM_ SG_ 1024 CcfOverSpdLimWarnSel "CCF Parameter - OverSpdLimWarnSel

MDF - 0x8052";
CM_ SG_ 1024 CcfReCircSoftBtn "CCF Parameter - ReCircSoftBtn

MDF - 0x8082";
CM_ SG_ 1024 CcfSideBarClimate "CCF Parameter - SideBarClimate

MDF - 0x8044";
CM_ SG_ 1024 CcfStartupLogo "CCF Parameter - StartupLogo

MDF - 0x8025";
CM_ SG_ 1024 CcfSVShiftLightHysteresis "CCF Parameter - SVShftightHysteres

MDF - 0x8034";
CM_ SG_ 1024 CcfTSRSpdLimDispConv "CCF Parameter - TSRSpdLimDispConv

MDF - 0x8075";
CM_ SG_ 1024 CcfVehicleClassific "CCF Parameter - VehicleClassific

MDF - 0x8057";
CM_ SG_ 1024 CcfVolumeSoftKeys "CCF Parameter - VolumeSoftKeys

MDF - 0x8065";
CM_ SG_ 1024 CcfACOnOffSoftBtn "CCF Parameter - ACOnOffSoftBtn

MDF - 0x8125";
CM_ SG_ 1024 CcfAEBFaultInd "CCF Parameter - AEBFaultInd

MDF - 0x8153";
CM_ SG_ 1024 CcfAirSUISignalSet "Car Configuration - AirSUISignalSet

Payload MDF = 0x8147";
CM_ SG_ 1024 CcfAutoClimateSoftBtn "CCF Parameter - AutoClimateSoftBtn

MDF - 0x8127";
CM_ SG_ 1024 CcfChildLckdInCarMiti "CCF Parameter - ChildLckdInCarMiti

MDF - 0x8145";
CM_ SG_ 1024 CcfCTRAirSusPartc "CCF Parameter - CTRAirSusPartc

MDF - 0x8185";
CM_ SG_ 1024 CcfDCMFaultInd "CCF Parameter - DCMFaultInd

MDF - 0x8155";
CM_ SG_ 1024 CcfFrntHtdScrnSoftBtn "CCF Parameter - FrntHtdScrnSoftBtn

MDF - 0x8131";
CM_ SG_ 1024 CcfFrontConnectSocket "CCF Parameter - Front Connect Socket

MDF - 0x8167";
CM_ SG_ 1024 CcfIFMVoltThreshold "CCF Parameter - IFMVoltThreshold

MDF - 0x8137";
CM_ SG_ 1024 CcfInfotainEmerParm29 "CCF Parameter - InfotainEmerParm29

MDF - 0x8173";
CM_ SG_ 1024 CcfInfotainEmerParm30 "CCF Parameter - InfotainEmerParm30

MDF - 0x8177";
CM_ SG_ 1024 CcfInstClusterLayMenu "CCF Parameter - InstClusterLayMenu

MDF - 0x8187";
CM_ SG_ 1024 CcfLaneAssistEmrgMenu "CCF Parameter - LaneAssistEmrgMenu

MDF - 0x8162";
CM_ SG_ 1024 CcfLSSFaultInd "CCF Parameter - LSSFaultInd

MDF - 0x8157";
CM_ SG_ 1024 CcfMaxACSoftBtn "CCF Parameter - MaxACSoftBtn

MDF - 0x8121";
CM_ SG_ 1024 CcfMaxDefrostSoftBtn "CCF Parameter - MaxDefrostSoftBtn

MDF - 0x8123";
CM_ SG_ 1024 CcfRearHtdScrnSoftBtn "CCF Parameter - RearHtdScrnSoftBtn

MDF - 0x8133";
CM_ SG_ 1024 CcfRemClimIndication "CCF Parameter - RemClimIndication

MDF - 0x8142";
CM_ SG_ 1024 CcfSlopeInfoMode "CCF Parameter -SlopeInfoMode

MDF - 0x8151";
CM_ SG_ 1024 CcfSVDynModeRideHght "CCF Parameter - SVDynModeRideHght

MDF - 0x8181";
CM_ SG_ 1024 CcfSVRoofLoadAdvice "CCF Parameter -SVRoofLoadAdvice

MDF - 0x8183";
CM_ SG_ 1024 CcfAdasDrvFatigue "CCF Parameter - AdasDrvFatigue
MDF - 0x8247";
CM_ SG_ 1024 CcfAdasDrvFatigueMenu "CCF Parameter - AdasDrvFatigueMenu
MDF - 0x8255";
CM_ SG_ 1024 CcfAdasDrvMon "CCF Parameter - AdasDrvMon
MDF - 0x8257";
CM_ SG_ 1024 CcfAndroidPluginBox "CCF Parameter - Android Plugin Box

MDF - 0x8242";
CM_ SG_ 1024 CcfCabFragBoostSftBtn "CCF Parameter - CabFragBoostSftBtn

MDF - 0x8287";
CM_ SG_ 1024 CcfCabFragCartridges "CCF Parameter - CabFragCartridges

MDF - 0x8227";
CM_ SG_ 1024 CcfCabFragLockSftBtn "CCF Parameter - CabFragLockSftBtn

MDF - 0x8285";
CM_ SG_ 1024 CcfCabFragPwrSftBtn "CCF Parameter - CabFragPwrSftBtn

MDF - 0x8281";
CM_ SG_ 1024 CcfCabFragTraySoftBtn "CCF Parameter - CabFragTraySoftBtn

MDF - 0x8283";
CM_ SG_ 1024 CcfFragranceDiffuser "CCF Parameter - FragranceDiffuser

MDF - 0x8224";
CM_ SG_ 1024 CcfFrtWinOneShotUpDn "CCF Parameter - FrtWinOneShotUpDn

MDF - 0x8233";
CM_ SG_ 1024 CcfLeftChargingInlet "Car Configuraton Parameter - LeftChargingInlet
MDF = 0x8267";
CM_ SG_ 1024 CcfRemClimInhibStrat "CCF Parameter - RemClimInhibStrat

MDF - 0x8222";
CM_ SG_ 1024 CcfRightChargingInlet "Car Configuraton Parameter - RightChargingInlet
MDF = 0x8277";
CM_ SG_ 1024 CcfRrWinOneShotUpDn "CCF Parameter - RrWinOneShotUpDn

MDF - 0x8237";
CM_ SG_ 1024 CcfRSEMediaStreaming "CCF Parameter - RSEMediaStreaming

MDF - 0x8253";
CM_ SG_ 1024 CcfTerSDSelectInFCPB "CCF Parameter - TerSDSelectInFCPB

MDF - 0x8245";
CM_ SG_ 1024 CcfAdasDrvMonMenu "CCF Parameter - AdasDrvMonMenu
MDF - 0x8327";
CM_ SG_ 1024 CcfAdasRmm "CCF Parameter - AdasRmm
MDF - 0x8337";
CM_ SG_ 1024 CcfAQSSoftButton "Car Configuration AQSSoftButton
Payload 0x8347";
CM_ SG_ 1024 CcfCabFragBoostTime "CCF Parameter - CabFragBoostTime

MDF - 0x8335";
CM_ SG_ 1024 CcfCabFragIntnstyHMI "CCF Parameter - CabFragIntnstyHMI

MDF - 0x8322";
CM_ SG_ 1024 CcfClimPreconSoftBtn "Car Configuration ClimPreconSoftBtn
Payload 0x8355";
CM_ SG_ 1024 CcfClimRecircSoftBtn "Car Configuration ClimRecircSoftBtn
Payload 0x8341";
CM_ SG_ 1024 CcfCO2SoftButton "Car Configuration C02SoftButton
Payload 0x8345";
CM_ SG_ 1024 CcfFrontAutoSoftBtn "Car Configuration FrontAutoSoftBtn
Payload 0x8384";
CM_ SG_ 1024 CcfFrontClimPwrSftBtn "Car Configuration FrontClimPwrSftBtn
Payload 0x8365";
CM_ SG_ 1024 CcfFrontElecVentsCtrl "Car Configuration FrontElecVentsCtrl
Payload 0x8375";
CM_ SG_ 1024 CcfFstChgPreCon "CCF Parameter - FstChgPreCon

MDF - 0x8325";
CM_ SG_ 1024 CcfHeatNowSoftBtn "Car Configuration HeatNowSoftBtn
Payload 0x8357";
CM_ SG_ 1024 CcfIoniserSoftButton "Car Configuration IoniserSoftButton
Payload 0x8371";
CM_ SG_ 1024 CcfRearAutoSoftBtn "Car Configuration RearAutoSoftBtn
Payload 0x8387";
CM_ SG_ 1024 CcfRearClimPwrSoftBtn "Car Configuration RearClimPwrSoftBtn
Payload 0x8363";
CM_ SG_ 1024 CcfRearComfortLckBtn "Car Configuration RearComfortLckBtn
Payload 0x8361";
CM_ SG_ 1024 CcfRearElecVentsCtrl "Car Configuration RearElecVentsCtrl
Payload 0x8377";
CM_ SG_ 1024 CcfRow2ChillBlowCtrl "Car Configuration Row2ChillBlowCtrl
Payload 0x8351";
CM_ SG_ 1024 CcfRow3ChillBlowCtrl "Car Configuration Row3ChillBlowCtrl
Payload 0x8353";
CM_ SG_ 1024 CcfRow3ChillerLockBtn "Car Configuration Row3ChillerLockBtn
Payload 0x8381";
CM_ SG_ 1024 CcfRow3chillerPowrBtn "Car Configuration Row3chillerPowrBtn
Payload 0x8373";
CM_ SG_ 1024 CcfSyncSoftBtn "Car Configuration SyncSoftBtn
Payload 0x8343";
CM_ SG_ 1024 CcfVentNowSoftBtn "Car Configuration VentNowSoftBtn
Payload 0x8367";
CM_ SG_ 1024 CcfACChrgCurrConfig "Car Configuration ACChrgCurrConfig
Payload 0x8555";
CM_ SG_ 1024 CcfBattery3Type "Car Configuration Battery3Type
Payload 0x8534";
CM_ SG_ 1024 CcfChargingStatusHMI "Car Configuration ChargingStatusHMI
Payload 0x8527";
CM_ SG_ 1024 CcfChargingTrblShootr "Car Configuration ChargingTrblShootr
Payload 0x8545";
CM_ SG_ 1024 CcfEPDUType "Car Configuration EPDUType
Payload 0x8524";
CM_ SG_ 1024 CcfEVAppType "Car Configuration EVAppType
Payload 0x8552";
CM_ SG_ 1024 CcfInletLEDConfig "Car Configuration InletLEDConfig
Payload 0x8562";
CM_ SG_ 1024 CcfLongLaneChngMrg "CCF Parameter - LongLaneChngMrg

Payload MDF - 0x8567";
CM_ SG_ 1024 CcfManoeuvreGuidance "CCF Parameter - ManoeuvreGuidance

Payload MDF - 0x8565";
CM_ SG_ 1024 CcfMax3PhaseACPwrLmt "Car Configuration Max3PhaseACPwrLmt 
Payload 0x8577";
CM_ SG_ 1024 CcfMaxACCurrLmt "Car Configuration MaxACCurrLmt
Payload 0x8583";
CM_ SG_ 1024 CcfPrdctTimeChrgDisp "Car Configuration PrdctTimeChrgDisp
Payload 0x8542";
CM_ SG_ 1024 CcfTRMCPartc "CCF Parameter - TRMCPartc
MDF - 0x8557";
CM_ SG_ 1024 CcfV1GChrgFeature "Car Configuration V1GChrgFeature
Payload 0x8537";
CM_ SG_ 1024 CcfV2LDisChrgFeature "Car Configuration V2LDisChrgFeature
Payload 0x8573";
CM_ SG_ 1024 CcfWELMSVariant "CCF Parameter - WELMSVariant
MDF - 0x8547";
CM_ SG_ 1024 CcfWiperDisplayTime "CCF Parameter - WiperDisplayTime
MDF - 0x8587";
CM_ SG_ 1024 CcfAdasDrvDistraction "CCF Parameter - AdasDrvDistraction
MDF - 0x8935";
CM_ SG_ 1024 CcfAdasDrvDstrctnMnu "CCF Parameter - AdasDrvDstrctnMnu
MDF - 0x8937";
CM_ SG_ 1024 CcfAdasHazardsControl "CCF Parameter - AdasHazardsControl
MDF - 0x8942";
CM_ SG_ 1024 CcfAdasHornControl "CCF Parameter - AdasHornControl
MDF - 0x8945";
CM_ SG_ 1024 CcfChargePnC "CCF Parameter - ChargePnC
MDF - 0x8952";
CM_ SG_ 1024 CcfChildLckSoftButton "CCF Parameter - ChildLckSoftButton
MDF - 0x8955";
CM_ SG_ 1024 CcfClimAutoDeselect "CCF Parameter - ClimAutoDeselect
MDF - 0x8962";
CM_ SG_ 1024 CcfClimDistDeselect "CCF Parameter - ClimDistDeselect
MDF - 0x8965";
CM_ SG_ 1024 CcfEfficientCabWarmup "CCF Parameter - EfficientCabWarmup
MDF - 0x8972";
CM_ SG_ 1024 CcfHFEfitment "CCF Parameter - HFEfitment
MDF - 0x8957";
CM_ SG_ 1024 CcfPreCrashSeatMovmnt "CCF Parameter - PreCrashSeatMovmnt
MDF - 0x8967";
CM_ SG_ 1024 CcfRearMemoryFitted "CCF Parameter - RearMemoryFitted
MDF - 0x8947";
CM_ SG_ 1024 CcfSeatThrmCntrlrRow1 "CCF Parameter - SeatThrmCntrlrRow1
MDF - 0x8923";
CM_ SG_ 1024 CcfSeatThrmCntrlrRow2 "CCF Parameter - SeatThrmCntrlrRow2
MDF - 0x8927";
CM_ SG_ 1024 CcfSeatThrmCntrlrRow3 "CCF Parameter - SeatThrmCntrlrRow3
MDF - 0x8933";
CM_ SG_ 1024 CcfSlimVents "CCF Parameter - SlimVents
MDF - 0x8975";
CM_ SG_ 1024 CcfSlimVentsSoftCntrl "CCF Parameter - SlimVentsSoftCntrl
MDF - 0x8977";
CM_ SG_ 1024 CcfSSRDataRecorder "CCF Parameter - SSRDataRecorder
MDF - 0x8987";
CM_ SG_ 1024 CcfTSDriverMemory "CCF Parameter - TSDriverMemory
MDF - 0x8982";
CM_ SG_ 1024 CcfTSPassMemory "CCF Parameter - TSPassMemory
MDF - 0x8985";
CM_ SG_ 1024 CcfDD00GlobalRealTime "Global Identifier   DD00	
ID Name               Global Real Time
Size (Bytes)          4
Type                     Unsigned Numeric
Data Description   As defined in GMRDB

Resolution ref: 1/600  Resolution: 0.001666666667 
Numeric size (bits): 32 
Offset: 0.0 
Minimum value: 0.0  Maximum value: 7158278.825 
Unit: min

(from GMRDB)

MDF 0xB027";
CM_ SG_ 1024 CcfDD02MainECUSupVolts "Global Identifier   DD02
ID Name               Main ECU Supply Voltage
Size (Bytes)          1
Type                     Unsigned Numeric
Data Description   As defined in GMRDB

MDF 0xB067";
CM_ SG_ 1024 CcfDD06PowerModePKT "Global Identifier   DD06
ID Name               Power Mode (PKT1)
Size (Bytes)          1
Type                     Packeted
Data Description   As defined in GMRDB

Parameter Size (bits) Datatype Description   

1 3 State Encoded Power Mode Quality Factor   (NOT USED)
2 5 State Encoded Power Mode   

(from GMRDB)

MDF 0xB074";
CM_ SG_ 1024 CcfDD01TotalDistance "Global Identifier   DD01
ID Name               Total Distance
Size (Bytes)          3
Type                     Unsigned Numeric
Data Description   As defined in GMRDB

Resolution ref: 1  Resolution: 1.0 
Numeric size (bits): 24 
Offset: 0.0 
Minimum value: 0.0  Maximum value: 1.6777215E7 
Unit: km 

MDF 0xB127";
CM_ SG_ 1024 CcfDD04InCarTemp "Global Identifier   DD04
ID Name               In-Car Temperature
Size (Bytes)          1
Type                     Unsigned Numeric
Data Description   As defined in GMRDB

MDF 0xB157";
CM_ SG_ 1024 CcfDD05OutdoorTemp "Global Identifier   DD05
ID Name               Outdoor Temperature
Size (Bytes)          1
Type                     Unsigned Numeric
Data Description   As defined in GMRDB

MDF 0xB167";
CM_ SG_ 1029 VehicleInfoParametersPMZ "This signal contains HYSignalConfigID and GGDS Snapshot Data for the HY-HSCAN Network. This signal is compiled in accordance with the Car Configuration EuCD - Vehicle Information Parameters Specification 31812331.

The Publisher of this signal shall read its local constant HYSignalConfigID and shall copy the value to the correct Block and Offset of VehicleInfoParameters that carries HYSignalConfigID [Block 01h, Bytes 7-8].

The Publisher of this signal shall subscribe to various Source Signals from the Network that shall be used to compile the GGDS Global Snapshot data within VehicleInfoParametersHY. The Source Signals that shall be used to compile the GGDS Global Snapshot data are defined in the Network Specific Requirements document.

The MSB of the signal must be written to the COM layer first (with an offset of zero in wr_bytes() ) and therefore transmitted on the bus first.
Similarly, subscribing modules will receive the MSB of the signal when they call rd_bytes(0).

E.g. wr_bytes(0) = publishe";
BA_DEF_ BO_  "GenMsgCycleTime" FLOAT 0 300000;
BA_DEF_ BO_  "GenMsgDelayTime" FLOAT 0 300000;
BA_DEF_ BO_  "GenMsgSendType" ENUM  "cyclic","spontaneous","cyclicIfActive","spontaneousWithDelay","cyclicAndSpontaneous","cyclicAndSpontaneousWithDelay","IfActive","NoMsgSendType";
BA_DEF_ BO_  "GenMsgStartDelayTime" FLOAT 0 300000;
BA_DEF_ SG_  "GenSigSendType" ENUM  "Cyclic","OnWrite","OnWriteWithRepetition","OnChange","OnChangeWithRepetition","IfActive","IfActiveWithRepetition","NoSigSendType";
BA_DEF_ SG_  "GenSigStartValue" FLOAT -1.79769313486232E+308 1.84467440737096E+019;
BA_DEF_ BO_  "SystemMessageLongSymbol" STRING ;
BA_DEF_DEF_  "GenMsgCycleTime" 0;
BA_DEF_DEF_  "GenMsgDelayTime" 0;
BA_DEF_DEF_  "GenMsgSendType" "cyclic";
BA_DEF_DEF_  "GenMsgStartDelayTime" 0;
BA_DEF_DEF_  "GenSigSendType" "Cyclic";
BA_DEF_DEF_  "GenSigStartValue" 0;
BA_DEF_DEF_  "SystemMessageLongSymbol" "";
BA_ "GenMsgSendType" BO_ 1029 1;
BA_ "GenMsgDelayTime" BO_ 1029 245;
BA_ "GenMsgSendType" BO_ 759 1;
BA_ "GenMsgSendType" BO_ 764 1;
BA_ "GenMsgDelayTime" BO_ 764 5;
BA_ "GenMsgSendType" BO_ 1622 1;
BA_ "GenMsgSendType" BO_ 1623 1;
BA_ "GenMsgSendType" BO_ 1621 1;
BA_ "GenMsgDelayTime" BO_ 1621 10;
BA_ "GenMsgSendType" BO_ 1626 1;
BA_ "GenMsgDelayTime" BO_ 1626 10;
BA_ "GenSigSendType" SG_ 1024 CcfLaneKeepAssistLDW 1;
BA_ "GenSigSendType" SG_ 1024 CcfManoeuvLightConfig 1;
BA_ "GenSigSendType" SG_ 1024 CcfParkPawlLocation 1;
BA_ "GenSigSendType" SG_ 1024 CcfPassHeatedCalfRest 1;
BA_ "GenSigSendType" SG_ 1024 CcfPSMFitment 1;
BA_ "GenSigSendType" SG_ 1024 CcfR2SMFitment 1;
BA_ "GenSigSendType" SG_ 1024 CcfR3SMFitment 1;
BA_ "GenSigSendType" SG_ 1024 CcfRghtManoeuvringLgt 1;
BA_ "GenSigSendType" SG_ 1024 CcfRLSMFitment 1;
BA_ "GenSigSendType" SG_ 1024 CcfRRSMFitment 1;
BA_ "GenSigSendType" SG_ 1024 CcfSeatMassHanded 1;
BA_ "GenSigSendType" SG_ 1024 CcfABsPartc 1;
BA_ "GenSigSendType" SG_ 1024 CcfActvDampingPartc 1;
BA_ "GenSigSendType" SG_ 1024 CcfAdaptiveProgMode 1;
BA_ "GenSigSendType" SG_ 1024 CcfAHBSystemStatus 1;
BA_ "GenSigSendType" SG_ 1024 CcfAutoTRProgMode 1;
BA_ "GenSigSendType" SG_ 1024 CcfConfigTRMode 1;
BA_ "GenSigSendType" SG_ 1024 CcfCorneringLampFunc 1;
BA_ "GenSigSendType" SG_ 1024 CcfDrvlinePartc 1;
BA_ "GenSigSendType" SG_ 1024 CcfEDiffPartc 1;
BA_ "GenSigSendType" SG_ 1024 CcfEmergencyBrakeIndic 1;
BA_ "GenSigSendType" SG_ 1024 CcfEnhancedFiltration 1;
BA_ "GenSigSendType" SG_ 1024 CcfEPasPartc 1;
BA_ "GenSigSendType" SG_ 1024 CcfHighBeamLights 1;
BA_ "GenSigSendType" SG_ 1024 CcfNFSVariant 1;
BA_ "GenSigSendType" SG_ 1024 CcfProgrammableCar 1;
BA_ "GenSigSendType" SG_ 1024 CcfReplay 1;
BA_ "GenSigSendType" SG_ 1024 CcfSlcEVChargeAlerts 1;
BA_ "GenSigSendType" SG_ 1024 CcfSplitServiceMessaging 1;
BA_ "GenSigSendType" SG_ 1024 CcfTrackProgMode 1;
BA_ "GenSigSendType" SG_ 1024 CcfTRFitment 1;
BA_ "GenSigSendType" SG_ 1024 CcfTRSwitchType 1;
BA_ "GenSigSendType" SG_ 1024 CcfULPMProgMode 1;
BA_ "GenSigSendType" SG_ 1024 CcfWadeProgMode 1;
BA_ "GenSigSendType" SG_ 1024 CcfWakeupShutDownSeqMenu 1;
BA_ "GenSigSendType" SG_ 1024 Ccf3DrAccessRearFeature 1;
BA_ "GenSigSendType" SG_ 1024 CcfAHBSensitivtyMenu 1;
BA_ "GenSigSendType" SG_ 1024 CcfAuxDrivingLamps 1;
BA_ "GenSigSendType" SG_ 1024 CcfBattery1Type 1;
BA_ "GenSigSendType" SG_ 1024 CcfBattery2BMS 1;
BA_ "GenSigSendType" SG_ 1024 CcfBrakePadWearIndication 1;
BA_ "GenSigSendType" SG_ 1024 CcfImmobiliserChannels 1;
BA_ "GenSigSendType" SG_ 1024 CcfInteriorReleaseTailgate 1;
BA_ "GenSigSendType" SG_ 1024 CcfLightsOnWhenWipers 1;
BA_ "GenSigSendType" SG_ 1024 CcfPixelTouristMode 1;
BA_ "GenSigSendType" SG_ 1024 CcfPSDBFitted 1;
BA_ "GenSigSendType" SG_ 1024 CcfRearFoldFlat 1;
BA_ "GenSigSendType" SG_ 1024 CcfRemoteReleaseTailgate 1;
BA_ "GenSigSendType" SG_ 1024 CcfTailgateHingeType 1;
BA_ "GenSigSendType" SG_ 1024 CcfVIAutoIllumination 1;
BA_ "GenSigSendType" SG_ 1024 CcfVICustomisableShortcut 1;
BA_ "GenSigSendType" SG_ 1024 CcfVisionInteraction 1;
BA_ "GenSigSendType" SG_ 1024 CcfVQMFitted 1;
BA_ "GenSigSendType" SG_ 1024 CcfVSMLVehicleHealthWarn 1;
BA_ "GenSigSendType" SG_ 1024 CcfVSMOilLevelUnit 1;
BA_ "GenSigSendType" SG_ 1024 CcfWirelessDeviceCharger 1;
BA_ "GenSigSendType" SG_ 1024 CcfXenonLamps 1;
BA_ "GenSigSendType" SG_ 1024 CcfA2BConfigurationNo 1;
BA_ "GenSigSendType" SG_ 1024 CcfAutoSSSelectInFCPB 1;
BA_ "GenSigSendType" SG_ 1024 CcfDSCSelectInFCPB 1;
BA_ "GenSigSendType" SG_ 1024 CcfHDCSelectInFCPB 1;
BA_ "GenSigSendType" SG_ 1024 CcfIVIType 1;
BA_ "GenSigSendType" SG_ 1024 CcfManovLightFadeTime 1;
BA_ "GenSigSendType" SG_ 1024 CcfManovLightRevTime 1;
BA_ "GenSigSendType" SG_ 1024 CcfOdoLeadingZero 1;
BA_ "GenSigSendType" SG_ 1024 CcfPreCrashSeatBltPretent 1;
BA_ "GenSigSendType" SG_ 1024 CcfRemoteWingMirrorFold 1;
BA_ "GenSigSendType" SG_ 1024 CcfSpeedoMainScaleUnits 1;
BA_ "GenSigSendType" SG_ 1024 CcfSpeedoSecondDisplay 1;
BA_ "GenSigSendType" SG_ 1024 CcfTerComSelectInFCPB 1;
BA_ "GenSigSendType" SG_ 1024 CcfTerDynSelectInFCPB 1;
BA_ "GenSigSendType" SG_ 1024 CcfTerECOSelectInFCPB 1;
BA_ "GenSigSendType" SG_ 1024 CcfTripCompInitialUnits 1;
BA_ "GenSigSendType" SG_ 1024 CcfAllWheelSteer 1;
BA_ "GenSigSendType" SG_ 1024 CcfATPCSelectInFCPB 1;
BA_ "GenSigSendType" SG_ 1024 CcfClimateHardKey 1;
BA_ "GenSigSendType" SG_ 1024 CcfFrontFogFuntionality 1;
BA_ "GenSigSendType" SG_ 1024 CcfInstrumentSkin 1;
BA_ "GenSigSendType" SG_ 1024 CcfOdometerUnits 1;
BA_ "GenSigSendType" SG_ 1024 CcfParkAid 1;
BA_ "GenSigSendType" SG_ 1024 CcfPreCrashSeatSquab 1;
BA_ "GenSigSendType" SG_ 1024 CcfSpdoSecondDisplayUnit 1;
BA_ "GenSigSendType" SG_ 1024 CcfSpeedoRange 1;
BA_ "GenSigSendType" SG_ 1024 CcfTachoGaugeVariant 1;
BA_ "GenSigSendType" SG_ 1024 CcfTerAutoSelectInFCPB 1;
BA_ "GenSigSendType" SG_ 1024 CcfTerGGSSelectInFCPB 1;
BA_ "GenSigSendType" SG_ 1024 CcfTerMudSelectInFCPB 1;
BA_ "GenSigSendType" SG_ 1024 CcfTerSandSelectInFCPB 1;
BA_ "GenSigSendType" SG_ 1024 CcfTripCompFuelEconomy 1;
BA_ "GenSigSendType" SG_ 1024 CcfTripCompMetFulEcoUnt 1;
BA_ "GenSigSendType" SG_ 1024 CcfVTGlazingRoof 1;
BA_ "GenSigSendType" SG_ 1024 CcfBattery2Type 1;
BA_ "GenSigSendType" SG_ 1024 CcfBSCMFitted 1;
BA_ "GenSigSendType" SG_ 1024 CcfConventionalCharging 1;
BA_ "GenSigSendType" SG_ 1024 CcfDriveModeDiscStrat 1;
BA_ "GenSigSendType" SG_ 1024 CcfDriveModeOrder 1;
BA_ "GenSigSendType" SG_ 1024 CcfDriveModeSigSchema 1;
BA_ "GenSigSendType" SG_ 1024 CcfEVRangeInfoWithPMZ 1;
BA_ "GenSigSendType" SG_ 1024 CcfEVSelectInBlade 1;
BA_ "GenSigSendType" SG_ 1024 CcfEVSelectInFCPB 1;
BA_ "GenSigSendType" SG_ 1024 CcfFLCVariant 1;
BA_ "GenSigSendType" SG_ 1024 CcfLeisureBatt 1;
BA_ "GenSigSendType" SG_ 1024 CcfOverspeedSaudi 1;
BA_ "GenSigSendType" SG_ 1024 CcfParkAssist 1;
BA_ "GenSigSendType" SG_ 1024 CcfSpdoScndDispEnblMenu 1;
BA_ "GenSigSendType" SG_ 1024 CcfSpdoScndDispUnitMenu 1;
BA_ "GenSigSendType" SG_ 1024 CcfSpecialClock 1;
BA_ "GenSigSendType" SG_ 1024 CcfSpeedoMinorScale 1;
BA_ "GenSigSendType" SG_ 1024 CcfVIAutoStart 1;
BA_ "GenSigSendType" SG_ 1024 CcfAirSusSelectInFCPB 1;
BA_ "GenSigSendType" SG_ 1024 CcfBacklightDimStratSel 1;
BA_ "GenSigSendType" SG_ 1024 CcfCCMVariant 1;
BA_ "GenSigSendType" SG_ 1024 CcfCityDrivingPwrSteer 1;
BA_ "GenSigSendType" SG_ 1024 CcfDADCModule 1;
BA_ "GenSigSendType" SG_ 1024 CcfDynSuspensionType 1;
BA_ "GenSigSendType" SG_ 1024 CcfFrontCornerRadars 1;
BA_ "GenSigSendType" SG_ 1024 CcfGuidanceBeamCCF 1;
BA_ "GenSigSendType" SG_ 1024 CcfHandsOnDetection 1;
BA_ "GenSigSendType" SG_ 1024 CcfLoRngSelectInFCPB 1;
BA_ "GenSigSendType" SG_ 1024 CcfPredictableAFS 1;
BA_ "GenSigSendType" SG_ 1024 CcfRearCornerRadars 1;
BA_ "GenSigSendType" SG_ 1024 CcfTA2InputControl 1;
BA_ "GenSigSendType" SG_ 1024 CcfTA2SelectInFCPB 1;
BA_ "GenSigSendType" SG_ 1024 CcfTelematicsSignIn 1;
BA_ "GenSigSendType" SG_ 1024 CcfTerCPSelectInFCPB 1;
BA_ "GenSigSendType" SG_ 1024 CcfTerCTSelectInFCPB 1;
BA_ "GenSigSendType" SG_ 1024 CcfTerRockSelectInFCPB 1;
BA_ "GenSigSendType" SG_ 1024 CcfTerWadeSelectInFCPB 1;
BA_ "GenSigSendType" SG_ 1024 CcfADASCBV 1;
BA_ "GenSigSendType" SG_ 1024 CcfApproachOpenDoors 1;
BA_ "GenSigSendType" SG_ 1024 CcfATPCPRO 1;
BA_ "GenSigSendType" SG_ 1024 CcfCamWashType 1;
BA_ "GenSigSendType" SG_ 1024 CcfeHorizonVariant 1;
BA_ "GenSigSendType" SG_ 1024 CcfEngCoolantHotWarn 1;
BA_ "GenSigSendType" SG_ 1024 CcfEngCoolantVryHotWarn 1;
BA_ "GenSigSendType" SG_ 1024 CcfEVSDCalNo 1;
BA_ "GenSigSendType" SG_ 1024 CcfGestureBonnet 1;
BA_ "GenSigSendType" SG_ 1024 CcfGestureDoorHandles 1;
BA_ "GenSigSendType" SG_ 1024 CcfPowerSideDoors 1;
BA_ "GenSigSendType" SG_ 1024 CcfRefrigerantType 1;
BA_ "GenSigSendType" SG_ 1024 CcfReverseLightActStra 1;
BA_ "GenSigSendType" SG_ 1024 CcfSeeThroughTrailer 1;
BA_ "GenSigSendType" SG_ 1024 CcfSideDoorObjectDet 1;
BA_ "GenSigSendType" SG_ 1024 CcfVehClearGuidance 1;
BA_ "GenSigSendType" SG_ 1024 CcfVertAccelSource 1;
BA_ "GenSigSendType" SG_ 1024 CcfActiveBrakeDuctVanes 1;
BA_ "GenSigSendType" SG_ 1024 CcfDADLInhibitOff 1;
BA_ "GenSigSendType" SG_ 1024 CcfEDUDriveline 1;
BA_ "GenSigSendType" SG_ 1024 CcfFrntUpperDispMargin 1;
BA_ "GenSigSendType" SG_ 1024 CcfFrtAnmSeqWkUpShutDn 1;
BA_ "GenSigSendType" SG_ 1024 CcfIVIAPIXClusterComms 1;
BA_ "GenSigSendType" SG_ 1024 CcfIVIeSIMProfileType 1;
BA_ "GenSigSendType" SG_ 1024 CcfIVIWiFiHotspot 1;
BA_ "GenSigSendType" SG_ 1024 CcfLHSWSFvClusterView 1;
BA_ "GenSigSendType" SG_ 1024 CcfPM25Market 1;
BA_ "GenSigSendType" SG_ 1024 CcfPwrTgateHMIControl 1;
BA_ "GenSigSendType" SG_ 1024 CcfRoofControlStrategy 1;
BA_ "GenSigSendType" SG_ 1024 CcfUserEEBReserveMgmt 1;
BA_ "GenSigSendType" SG_ 1024 CcfAnmProjWakeUpShutDn 1;
BA_ "GenSigSendType" SG_ 1024 CcfBrakeWarnings 1;
BA_ "GenSigSendType" SG_ 1024 CcfHVBatteryCapacity 1;
BA_ "GenSigSendType" SG_ 1024 CcfIndirectVentsFitted 1;
BA_ "GenSigSendType" SG_ 1024 CcfPreEmpSuspBowWvDmp 1;
BA_ "GenSigSendType" SG_ 1024 CcfPreEmpSusPitchDamp 1;
BA_ "GenSigSendType" SG_ 1024 CcfPreEmptSusCnrRdEnh 1;
BA_ "GenSigSendType" SG_ 1024 CcfPreEmptSusCollMtgn 1;
BA_ "GenSigSendType" SG_ 1024 CcfPreEmptSusCrPkAccHt 1;
BA_ "GenSigSendType" SG_ 1024 CcfPreEmptSusKrbStrkDt 1;
BA_ "GenSigSendType" SG_ 1024 CcfPreEmptSusSpeedLwr 1;
BA_ "GenSigSendType" SG_ 1024 CcfRow1SeatBolster 1;
BA_ "GenSigSendType" SG_ 1024 CcfRow1SeatCushExt 1;
BA_ "GenSigSendType" SG_ 1024 CcfRow1SeatHeadrest 1;
BA_ "GenSigSendType" SG_ 1024 CcfRow1SeatLumbar 1;
BA_ "GenSigSendType" SG_ 1024 CcfRow1SeatShoulder 1;
BA_ "GenSigSendType" SG_ 1024 CcfRow2SeatBolster 1;
BA_ "GenSigSendType" SG_ 1024 CcfRow2SeatHeadrest 1;
BA_ "GenSigSendType" SG_ 1024 CcfRow2SeatLumbar 1;
BA_ "GenSigSendType" SG_ 1024 CcfRow2SeatShoulder 1;
BA_ "GenSigSendType" SG_ 1024 CcfRrAnmSeqWkUpShutDn 1;
BA_ "GenSigSendType" SG_ 1024 CcfTailgateEventExperience 1;
BA_ "GenSigSendType" SG_ 1024 CcfTailgateEventLight 1;
BA_ "GenSigSendType" SG_ 1024 Ccf4x4iD8Driveline 1;
BA_ "GenSigSendType" SG_ 1024 CcfAirSuspUIType 1;
BA_ "GenSigSendType" SG_ 1024 CcfAutoStpStrtButtonType 1;
BA_ "GenSigSendType" SG_ 1024 CcfCentrSideAirbag 1;
BA_ "GenSigSendType" SG_ 1024 CcfDSCSwitchSource 1;
BA_ "GenSigSendType" SG_ 1024 CcfIMSCalNo1 1;
BA_ "GenSigSendType" SG_ 1024 CcfIMSCalNo2 1;
BA_ "GenSigSendType" SG_ 1024 CcfIMSType 1;
BA_ "GenSigSendType" SG_ 1024 CcfLSPFitment 1;
BA_ "GenSigSendType" SG_ 1024 CcfPNLeisureBattstatus 1;
BA_ "GenSigSendType" SG_ 1024 CcfPoliceLightsFuncReq 1;
BA_ "GenSigSendType" SG_ 1024 CcfPreEmptSusPkgKrbAvd 1;
BA_ "GenSigSendType" SG_ 1024 CcfPyroBrake 1;
BA_ "GenSigSendType" SG_ 1024 CcfSeatPeripheralCtrl 1;
BA_ "GenSigSendType" SG_ 1024 CcfTaskLightingTLMB 1;
BA_ "GenSigSendType" SG_ 1024 CcfTaskLightingTLMC 1;
BA_ "GenSigSendType" SG_ 1024 CcfTracDSCFitted 1;
BA_ "GenSigSendType" SG_ 1024 CcfAGMcActrFitment 1;
BA_ "GenSigSendType" SG_ 1024 CcfAGMdActrFitment 1;
BA_ "GenSigSendType" SG_ 1024 CcfCabinSnapshot 1;
BA_ "GenSigSendType" SG_ 1024 CcfCDMHandlingPartc 1;
BA_ "GenSigSendType" SG_ 1024 CcfCDMISCSPartc 1;
BA_ "GenSigSendType" SG_ 1024 CcfCTRBCSPartc 1;
BA_ "GenSigSendType" SG_ 1024 CcfEVBattUsablekWh 1;
BA_ "GenSigSendType" SG_ 1024 CcfExpDateFormatSigs 1;
BA_ "GenSigSendType" SG_ 1024 CcfFntClimateSeatsSZM 1;
BA_ "GenSigSendType" SG_ 1024 CcfHDAdaptDrvBeam 1;
BA_ "GenSigSendType" SG_ 1024 CcfItemReminder 1;
BA_ "GenSigSendType" SG_ 1024 CcfOCSPFitment 1;
BA_ "GenSigSendType" SG_ 1024 CcfPassSeatHeelCatcher 1;
BA_ "GenSigSendType" SG_ 1024 CcfPetrolEmissionsHW 1;
BA_ "GenSigSendType" SG_ 1024 CcfRemoteDeviceReminder 1;
BA_ "GenSigSendType" SG_ 1024 CcfRrClimateSeatsSZM 1;
BA_ "GenSigSendType" SG_ 1024 CcfSpecialVehicles 1;
BA_ "GenSigSendType" SG_ 1024 CcfSpeedoMarket 1;
BA_ "GenSigSendType" SG_ 1024 CcfTEETailgateActuation 1;
BA_ "GenSigSendType" SG_ 1024 CcfATPCButtonType 1;
BA_ "GenSigSendType" SG_ 1024 CcfAutoBlowerIntensityLvlConfig 1;
BA_ "GenSigSendType" SG_ 1024 CcfDDMCalibration 1;
BA_ "GenSigSendType" SG_ 1024 CcfDepDoorHandShowMode 1;
BA_ "GenSigSendType" SG_ 1024 CcfFntLowerDispHaptic 1;
BA_ "GenSigSendType" SG_ 1024 CcfFntUpperDispHaptic 1;
BA_ "GenSigSendType" SG_ 1024 CcfPhoneSignalBooster 1;
BA_ "GenSigSendType" SG_ 1024 CcfPM25SensorType 1;
BA_ "GenSigSendType" SG_ 1024 CcfRearChillerUserControl 1;
BA_ "GenSigSendType" SG_ 1024 CcfRSESubscriptionVer 1;
BA_ "GenSigSendType" SG_ 1024 CcfSeatSpec 1;
BA_ "GenSigSendType" SG_ 1024 CcfSensorSlopeType 1;
BA_ "GenSigSendType" SG_ 1024 CcfTailgateCloseLockSwitch 1;
BA_ "GenSigSendType" SG_ 1024 CcfTSSecSeatMovement 1;
BA_ "GenSigSendType" SG_ 1024 CcfADASAlertSensitivity 1;
BA_ "GenSigSendType" SG_ 1024 CcfADASSpdLimOffset 1;
BA_ "GenSigSendType" SG_ 1024 CcfAutoHoldType 1;
BA_ "GenSigSendType" SG_ 1024 CcfDeployableRSEType 1;
BA_ "GenSigSendType" SG_ 1024 CcfEcoDrivingCoachVar 1;
BA_ "GenSigSendType" SG_ 1024 CcfEVInletLidSecure 1;
BA_ "GenSigSendType" SG_ 1024 CcfFirstRowFridge 1;
BA_ "GenSigSendType" SG_ 1024 CcfFogLampLocation 1;
BA_ "GenSigSendType" SG_ 1024 CcfFrntLoadSpaceLight 1;
BA_ "GenSigSendType" SG_ 1024 CcfPersonalisationStorage 1;
BA_ "GenSigSendType" SG_ 1024 CcfPwrSideDrBrakePedalClose 1;
BA_ "GenSigSendType" SG_ 1024 CcfRevLampLocation 1;
BA_ "GenSigSendType" SG_ 1024 CcfRrClimateAutoSigs 1;
BA_ "GenSigSendType" SG_ 1024 CcfRrDILampLocation 1;
BA_ "GenSigSendType" SG_ 1024 CcfRrPosLampLocation 1;
BA_ "GenSigSendType" SG_ 1024 CcfRrSideDrTwoStgRel 1;
BA_ "GenSigSendType" SG_ 1024 CcfStopLampLocation 1;
BA_ "GenSigSendType" SG_ 1024 CcfTRDriAdvAirSusRcmndRse 1;
BA_ "GenSigSendType" SG_ 1024 CcfASDProgMode 1;
BA_ "GenSigSendType" SG_ 1024 CcfAutoBlrIntenstySet 1;
BA_ "GenSigSendType" SG_ 1024 CcfBrakeSystemTypeCRB 1;
BA_ "GenSigSendType" SG_ 1024 CcfClimateHMIControlStrategy 1;
BA_ "GenSigSendType" SG_ 1024 CcfDADLSpeedOptions 1;
BA_ "GenSigSendType" SG_ 1024 CcfEVInletLidPosition 1;
BA_ "GenSigSendType" SG_ 1024 CcfEVInletLidType 1;
BA_ "GenSigSendType" SG_ 1024 CcfEVInletUnlockType 1;
BA_ "GenSigSendType" SG_ 1024 CcfGearboxFltWarStrat 1;
BA_ "GenSigSendType" SG_ 1024 CcfGSMSOption 1;
BA_ "GenSigSendType" SG_ 1024 CcfHealthWellnessActiv 1;
BA_ "GenSigSendType" SG_ 1024 CcfINCARTempSensorTyp 1;
BA_ "GenSigSendType" SG_ 1024 CcfIPMAWSVarCal 1;
BA_ "GenSigSendType" SG_ 1024 CcfMLASoftSwitches 1;
BA_ "GenSigSendType" SG_ 1024 CcfPredictvEnrgyOptm 1;
BA_ "GenSigSendType" SG_ 1024 CcfSeatbuckleLED 1;
BA_ "GenSigSendType" SG_ 1024 CcfSpeechSesDuckBehav 1;
BA_ "GenSigSendType" SG_ 1024 CcfTemperatureUnits 1;
BA_ "GenSigSendType" SG_ 1024 CcfTRClusterRibbonDir 1;
BA_ "GenSigSendType" SG_ 1024 CcfUsrEEBReserveMgmt 1;
BA_ "GenSigSendType" SG_ 1024 CcfBrakeDuctType 1;
BA_ "GenSigSendType" SG_ 1024 CcfCabinCleaning 1;
BA_ "GenSigSendType" SG_ 1024 CcfCamVideoResolution 1;
BA_ "GenSigSendType" SG_ 1024 CcfHapticSeatPowertrain 1;
BA_ "GenSigSendType" SG_ 1024 CcfHapticSeatsAudio 1;
BA_ "GenSigSendType" SG_ 1024 CcfInfoEmerChargePnC 1;
BA_ "GenSigSendType" SG_ 1024 CcfInfotainEmerParm20 1;
BA_ "GenSigSendType" SG_ 1024 CcfInfotainEmerParm21 1;
BA_ "GenSigSendType" SG_ 1024 CcfMILActtDrivingCycl 1;
BA_ "GenSigSendType" SG_ 1024 CcfOffRoadRideHeight 1;
BA_ "GenSigSendType" SG_ 1024 CcfPwrDoorCrankOp 1;
BA_ "GenSigSendType" SG_ 1024 CcfRainSensorType 1;
BA_ "GenSigSendType" SG_ 1024 CcfRefrigerantLoop 1;
BA_ "GenSigSendType" SG_ 1024 CcfSmartProgramWiping 1;
BA_ "GenSigSendType" SG_ 1024 CcfSVDynamicMode 1;
BA_ "GenSigSendType" SG_ 1024 CcfVibroAcousticTherapy 1;
BA_ "GenSigSendType" SG_ 1024 CcfAlcoholIntLKDevice 1;
BA_ "GenSigSendType" SG_ 1024 CcfCabinCleanCyclTime 1;
BA_ "GenSigSendType" SG_ 1024 CcfCornerSpeedAdapt 1;
BA_ "GenSigSendType" SG_ 1024 CcfEnhFiltrationAQI 1;
BA_ "GenSigSendType" SG_ 1024 CcfHapticPwrTrnCalNo 1;
BA_ "GenSigSendType" SG_ 1024 CcfInfotainEmerParm22 1;
BA_ "GenSigSendType" SG_ 1024 CcfInfotainEmerParm23 1;
BA_ "GenSigSendType" SG_ 1024 CcfInfotainEmerParm24 1;
BA_ "GenSigSendType" SG_ 1024 CcfRefrigerantSnsHVAC 1;
BA_ "GenSigSendType" SG_ 1024 CcfSidebarControls 1;
BA_ "GenSigSendType" SG_ 1024 CcfSpeedLimitAdapt 1;
BA_ "GenSigSendType" SG_ 1024 CcfAEBMenu 1;
BA_ "GenSigSendType" SG_ 1024 CcfDriverCondMonMenu 1;
BA_ "GenSigSendType" SG_ 1024 CcfDrvModeSwitchMsg 1;
BA_ "GenSigSendType" SG_ 1024 CcfeTSRFaultInd 1;
BA_ "GenSigSendType" SG_ 1024 CcfFLCHeating 1;
BA_ "GenSigSendType" SG_ 1024 CcfHDCButtonType 1;
BA_ "GenSigSendType" SG_ 1024 CcfHibernatedNav 1;
BA_ "GenSigSendType" SG_ 1024 CcfIVILoRngSwitchFit 1;
BA_ "GenSigSendType" SG_ 1024 CcfLaneAssistMenu 1;
BA_ "GenSigSendType" SG_ 1024 CcfNewSpdLimAudioAlrt 1;
BA_ "GenSigSendType" SG_ 1024 CcfOverSpdLimWarnSel 1;
BA_ "GenSigSendType" SG_ 1024 CcfReCircSoftBtn 1;
BA_ "GenSigSendType" SG_ 1024 CcfSideBarClimate 1;
BA_ "GenSigSendType" SG_ 1024 CcfStartupLogo 1;
BA_ "GenSigSendType" SG_ 1024 CcfSVShiftLightHysteresis 1;
BA_ "GenSigSendType" SG_ 1024 CcfTSRSpdLimDispConv 1;
BA_ "GenSigSendType" SG_ 1024 CcfVehicleClassific 1;
BA_ "GenSigSendType" SG_ 1024 CcfVolumeSoftKeys 1;
BA_ "GenSigSendType" SG_ 1024 CcfACOnOffSoftBtn 1;
BA_ "GenSigSendType" SG_ 1024 CcfAEBFaultInd 1;
BA_ "GenSigSendType" SG_ 1024 CcfAirSUISignalSet 1;
BA_ "GenSigSendType" SG_ 1024 CcfAutoClimateSoftBtn 1;
BA_ "GenSigSendType" SG_ 1024 CcfChildLckdInCarMiti 1;
BA_ "GenSigSendType" SG_ 1024 CcfCTRAirSusPartc 1;
BA_ "GenSigSendType" SG_ 1024 CcfDCMFaultInd 1;
BA_ "GenSigSendType" SG_ 1024 CcfFrntHtdScrnSoftBtn 1;
BA_ "GenSigSendType" SG_ 1024 CcfFrontConnectSocket 1;
BA_ "GenSigSendType" SG_ 1024 CcfIFMVoltThreshold 1;
BA_ "GenSigSendType" SG_ 1024 CcfInfotainEmerParm29 1;
BA_ "GenSigSendType" SG_ 1024 CcfInfotainEmerParm30 1;
BA_ "GenSigSendType" SG_ 1024 CcfInstClusterLayMenu 1;
BA_ "GenSigSendType" SG_ 1024 CcfLaneAssistEmrgMenu 1;
BA_ "GenSigSendType" SG_ 1024 CcfLSSFaultInd 1;
BA_ "GenSigSendType" SG_ 1024 CcfMaxACSoftBtn 1;
BA_ "GenSigSendType" SG_ 1024 CcfMaxDefrostSoftBtn 1;
BA_ "GenSigSendType" SG_ 1024 CcfRearHtdScrnSoftBtn 1;
BA_ "GenSigSendType" SG_ 1024 CcfRemClimIndication 1;
BA_ "GenSigSendType" SG_ 1024 CcfSlopeInfoMode 1;
BA_ "GenSigSendType" SG_ 1024 CcfSVDynModeRideHght 1;
BA_ "GenSigSendType" SG_ 1024 CcfSVRoofLoadAdvice 1;
BA_ "GenSigSendType" SG_ 1024 CcfAdasDrvFatigue 1;
BA_ "GenSigSendType" SG_ 1024 CcfAdasDrvFatigueMenu 1;
BA_ "GenSigSendType" SG_ 1024 CcfAdasDrvMon 1;
BA_ "GenSigSendType" SG_ 1024 CcfAndroidPluginBox 1;
BA_ "GenSigSendType" SG_ 1024 CcfCabFragBoostSftBtn 1;
BA_ "GenSigSendType" SG_ 1024 CcfCabFragCartridges 1;
BA_ "GenSigSendType" SG_ 1024 CcfCabFragLockSftBtn 1;
BA_ "GenSigSendType" SG_ 1024 CcfCabFragPwrSftBtn 1;
BA_ "GenSigSendType" SG_ 1024 CcfCabFragTraySoftBtn 1;
BA_ "GenSigSendType" SG_ 1024 CcfFragranceDiffuser 1;
BA_ "GenSigSendType" SG_ 1024 CcfFrtWinOneShotUpDn 1;
BA_ "GenSigSendType" SG_ 1024 CcfLeftChargingInlet 1;
BA_ "GenSigSendType" SG_ 1024 CcfRemClimInhibStrat 1;
BA_ "GenSigSendType" SG_ 1024 CcfRightChargingInlet 1;
BA_ "GenSigSendType" SG_ 1024 CcfRrWinOneShotUpDn 1;
BA_ "GenSigSendType" SG_ 1024 CcfRSEMediaStreaming 1;
BA_ "GenSigSendType" SG_ 1024 CcfTerSDSelectInFCPB 1;
BA_ "GenSigSendType" SG_ 1024 CcfAdasDrvMonMenu 1;
BA_ "GenSigSendType" SG_ 1024 CcfAdasRmm 1;
BA_ "GenSigSendType" SG_ 1024 CcfAQSSoftButton 1;
BA_ "GenSigSendType" SG_ 1024 CcfCabFragBoostTime 1;
BA_ "GenSigSendType" SG_ 1024 CcfCabFragIntnstyHMI 1;
BA_ "GenSigSendType" SG_ 1024 CcfClimPreconSoftBtn 1;
BA_ "GenSigSendType" SG_ 1024 CcfClimRecircSoftBtn 1;
BA_ "GenSigSendType" SG_ 1024 CcfCO2SoftButton 1;
BA_ "GenSigSendType" SG_ 1024 CcfFrontAutoSoftBtn 1;
BA_ "GenSigSendType" SG_ 1024 CcfFrontClimPwrSftBtn 1;
BA_ "GenSigSendType" SG_ 1024 CcfFrontElecVentsCtrl 1;
BA_ "GenSigSendType" SG_ 1024 CcfFstChgPreCon 1;
BA_ "GenSigSendType" SG_ 1024 CcfHeatNowSoftBtn 1;
BA_ "GenSigSendType" SG_ 1024 CcfIoniserSoftButton 1;
BA_ "GenSigSendType" SG_ 1024 CcfRearAutoSoftBtn 1;
BA_ "GenSigSendType" SG_ 1024 CcfRearClimPwrSoftBtn 1;
BA_ "GenSigSendType" SG_ 1024 CcfRearComfortLckBtn 1;
BA_ "GenSigSendType" SG_ 1024 CcfRearElecVentsCtrl 1;
BA_ "GenSigSendType" SG_ 1024 CcfRow2ChillBlowCtrl 1;
BA_ "GenSigSendType" SG_ 1024 CcfRow3ChillBlowCtrl 1;
BA_ "GenSigSendType" SG_ 1024 CcfRow3ChillerLockBtn 1;
BA_ "GenSigSendType" SG_ 1024 CcfRow3chillerPowrBtn 1;
BA_ "GenSigSendType" SG_ 1024 CcfSyncSoftBtn 1;
BA_ "GenSigSendType" SG_ 1024 CcfVentNowSoftBtn 1;
BA_ "GenSigSendType" SG_ 1024 CcfACChrgCurrConfig 1;
BA_ "GenSigSendType" SG_ 1024 CcfBattery3Type 1;
BA_ "GenSigSendType" SG_ 1024 CcfChargingStatusHMI 1;
BA_ "GenSigSendType" SG_ 1024 CcfChargingTrblShootr 1;
BA_ "GenSigSendType" SG_ 1024 CcfEPDUType 1;
BA_ "GenSigSendType" SG_ 1024 CcfEVAppType 1;
BA_ "GenSigSendType" SG_ 1024 CcfInletLEDConfig 1;
BA_ "GenSigSendType" SG_ 1024 CcfLongLaneChngMrg 1;
BA_ "GenSigSendType" SG_ 1024 CcfManoeuvreGuidance 1;
BA_ "GenSigSendType" SG_ 1024 CcfMax3PhaseACPwrLmt 1;
BA_ "GenSigSendType" SG_ 1024 CcfMaxACCurrLmt 1;
BA_ "GenSigSendType" SG_ 1024 CcfPrdctTimeChrgDisp 1;
BA_ "GenSigSendType" SG_ 1024 CcfTRMCPartc 1;
BA_ "GenSigSendType" SG_ 1024 CcfV1GChrgFeature 1;
BA_ "GenSigSendType" SG_ 1024 CcfV2LDisChrgFeature 1;
BA_ "GenSigSendType" SG_ 1024 CcfWELMSVariant 1;
BA_ "GenSigSendType" SG_ 1024 CcfWiperDisplayTime 1;
BA_ "GenSigSendType" SG_ 1024 CcfAdasDrvDistraction 1;
BA_ "GenSigSendType" SG_ 1024 CcfAdasDrvDstrctnMnu 1;
BA_ "GenSigSendType" SG_ 1024 CcfAdasHazardsControl 1;
BA_ "GenSigSendType" SG_ 1024 CcfAdasHornControl 1;
BA_ "GenSigSendType" SG_ 1024 CcfChargePnC 1;
BA_ "GenSigSendType" SG_ 1024 CcfChildLckSoftButton 1;
BA_ "GenSigSendType" SG_ 1024 CcfClimAutoDeselect 1;
BA_ "GenSigSendType" SG_ 1024 CcfClimDistDeselect 1;
BA_ "GenSigSendType" SG_ 1024 CcfEfficientCabWarmup 1;
BA_ "GenSigSendType" SG_ 1024 CcfHFEfitment 1;
BA_ "GenSigSendType" SG_ 1024 CcfPreCrashSeatMovmnt 1;
BA_ "GenSigSendType" SG_ 1024 CcfRearMemoryFitted 1;
BA_ "GenSigSendType" SG_ 1024 CcfSeatThrmCntrlrRow1 1;
BA_ "GenSigSendType" SG_ 1024 CcfSeatThrmCntrlrRow2 1;
BA_ "GenSigSendType" SG_ 1024 CcfSeatThrmCntrlrRow3 1;
BA_ "GenSigSendType" SG_ 1024 CcfSlimVents 1;
BA_ "GenSigSendType" SG_ 1024 CcfSlimVentsSoftCntrl 1;
BA_ "GenSigSendType" SG_ 1024 CcfSSRDataRecorder 1;
BA_ "GenSigSendType" SG_ 1024 CcfTSDriverMemory 1;
BA_ "GenSigSendType" SG_ 1024 CcfTSPassMemory 1;
BA_ "GenSigSendType" SG_ 1024 CcfDD00GlobalRealTime 1;
BA_ "GenSigSendType" SG_ 1024 CcfDD02MainECUSupVolts 1;
BA_ "GenSigSendType" SG_ 1024 CcfDD06PowerModePKT 1;
BA_ "GenSigSendType" SG_ 1024 CcfDD01TotalDistance 1;
BA_ "GenSigSendType" SG_ 1024 CcfDD04InCarTemp 1;
BA_ "GenSigSendType" SG_ 1024 CcfDD05OutdoorTemp 1;
BA_ "GenSigSendType" SG_ 1029 VehicleInfoParametersPMZ 1;
VAL_ 1024 CcfLaneKeepAssistLDW 0 "Not supported" 1 "Not Fitted" 2 "Fitted" 3 "Error" ;
VAL_ 1024 CcfManoeuvLightConfig 0 "Not supported" 1 "Not Fitted" 2 "Fitted" 3 "Error" ;
VAL_ 1024 CcfParkPawlLocation 0 "Not Supported" 1 "Transmission - Front Axle only" 2 "Transmission - Rear Axle only" 3 "Transmission - Front and Rear Axles" 4 "EDU - Front Axle only" 5 "EDU - Rear Axle only" 6 "EDU - Front and Rear Axles" 7 "Wheels - Front Axle only" 8 "Wheels - Rear Axle only" 9 "Wheels - Front and Rear Axle" 10 "Transmission - Front Axle and EDU - Rear Axle" 11 "Transmission - Rear Axle and EDU - Front Axle" 15 "Error" ;
VAL_ 1024 CcfPassHeatedCalfRest 0 "Not Supported" 1 "Not Fitted" 2 "Heated Calf Rest fitted on second row passenger-side seat" 3 "Error" ;
VAL_ 1024 CcfPSMFitment 0 "Not Supported" 1 "Not Fitted" 2 "Fitted" 3 "Error" ;
VAL_ 1024 CcfR2SMFitment 0 "Not Supported" 1 "Not Fitted" 2 "Fitted" 3 "Error" ;
VAL_ 1024 CcfR3SMFitment 0 "Not Supported" 1 "Not Fitted" 2 "Fitted" 3 "Error" ;
VAL_ 1024 CcfRghtManoeuvringLgt 0 "Not supported" 1 "Not Fitted" 2 "Fitted" 3 "Error" ;
VAL_ 1024 CcfRLSMFitment 0 "Not Supported" 1 "Not Fitted" 2 "Fitted" 3 "Error" ;
VAL_ 1024 CcfRRSMFitment 0 "Not Supported" 1 "Not Fitted" 2 "Fitted" 3 "Error" ;
VAL_ 1024 CcfSeatMassHanded 0 "Not Supported" 1 "Rear massage signals inverted on LHD vehicles, straight on RHD vehicles" 2 "Rear massage signals straight on all vehicles" 3 "Error" ;
VAL_ 1024 CcfABsPartc 0 "Not Supported" 1 "Not Participating in Mode Management" 2 "Participating in Mode Management" 3 "Error" ;
VAL_ 1024 CcfActvDampingPartc 0 "Not Supported" 1 "Not Participating in Mode Management" 2 "Participating in Mode Management" 3 "Error" ;
VAL_ 1024 CcfAdaptiveProgMode 0 "Not supported" 1 "Not Fitted" 2 "Fitted" 3 "Error" ;
VAL_ 1024 CcfAHBSystemStatus 0 "Not Supported" 1 "AHBA Not Fitted" 2 "AHBA Fitted" 3 "Error" ;
VAL_ 1024 CcfAutoTRProgMode 0 "Not supported" 1 "Not Fitted" 2 "Fitted" 3 "Error" ;
VAL_ 1024 CcfConfigTRMode 0 "Not Supported" 1 "Not available for selection" 2 "Available for selection without timeout" 3 "Available for selection with timeout" 7 "Error" ;
VAL_ 1024 CcfCorneringLampFunc 0 "Not Supported" 1 "Disabled" 2 "Enabled" 3 "Error" ;
VAL_ 1024 CcfDrvlinePartc 0 "Not Supported" 1 "Not Participating in Mode Management" 2 "Participating in Mode Management" 3 "Error" ;
VAL_ 1024 CcfEDiffPartc 0 "Not Supported" 1 "Not Participating in Mode Management" 2 "Participating in Mode Management" 3 "Error" ;
VAL_ 1024 CcfEmergencyBrakeIndic 0 "Not Supported" 1 "Disabled" 2 "Enabled" 3 "Error" ;
VAL_ 1024 CcfEnhancedFiltration 0 "Not Supported" 1 "No Enhanced Particulate Filter fitted. No soft button fitted. No sensor fitted." 2 "Enhanced Particulate Filter fitted. No soft button or sensor fitted." 3 "Enhanced Particulate Filter and soft button fitted. No sensor fitted." 4 "Enhanced Particulate Filter and sensor fitted. No soft button fitted." 5 "Enhanced Particulate Filter and sensor fitted and soft button fitted." 7 "Error" ;
VAL_ 1024 CcfEPasPartc 0 "Not Supported" 1 "Not Participating in Mode Management" 2 "Participating in Mode Management" 3 "Error" ;
VAL_ 1024 CcfHighBeamLights 0 "Not supported" 1 "Not Fitted" 2 "Fitted" 3 "Error" ;
VAL_ 1024 CcfNFSVariant 0 "Not Supported" 1 "Not Fitted" 2 "NFS Low" 3 "NFS Mid" 4 "NFS High" 7 "Error" ;
VAL_ 1024 CcfProgrammableCar 0 "Not Supported" 1 "Not Fitted" 2 "Driver Only" 3 "Front Row" 4 "Front Row + Row2" 5 "Front Row + Row2 + Row3" 7 "Error" ;
VAL_ 1024 CcfReplay 0 "Not Supported" 1 "Replay Not Available" 2 "Replay Supported" 3 "Error" ;
VAL_ 1024 CcfSlcEVChargeAlerts 0 "Not Supported" 1 "Disabled" 2 "Enabled" 3 "Error" ;
VAL_ 1024 CcfSplitServiceMessaging 0 "Not Supported" 1 "Inactive" 2 "Active" 3 "Error" ;
VAL_ 1024 CcfTrackProgMode 0 "Not Supported" 1 "Not available for selection" 2 "Available for selection without timeout" 3 "Available for selection with timeout" 7 "Error" ;
VAL_ 1024 CcfTRFitment 0 "Not supported" 1 "Not Fitted" 2 "Fitted" 3 "Error" ;
VAL_ 1024 CcfTRSwitchType 0 "Not Supported" 1 "Not Fitted" 2 "Infotainment Touch Screen" 3 "Climate Control Panel" 7 "Error" ;
VAL_ 1024 CcfULPMProgMode 0 "Not Supported" 1 "Not available for selection" 2 "Available for selection without timeout" 3 "Available for selection with timeout" 7 "Error" ;
VAL_ 1024 CcfWadeProgMode 0 "Not Supported" 1 "Not available for selection" 2 "Available for selection without timeout" 3 "Available for selection with timeout" 7 "Error" ;
VAL_ 1024 CcfWakeupShutDownSeqMenu 0 "Not Supported" 1 "Menu Disabled" 2 "Menu Enabled" 3 "Error" ;
VAL_ 1024 Ccf3DrAccessRearFeature 0 "Not supported" 1 "Not Fitted" 2 "Fitted" 3 "Error" ;
VAL_ 1024 CcfAHBSensitivtyMenu 0 "Not Supported" 1 "Sensitivity Menu Disabled" 2 "Sensitivity Menu enabled" 3 "Error" ;
VAL_ 1024 CcfAuxDrivingLamps 0 "Not supported" 1 "Not Fitted" 2 "Fitted" 3 "Error" ;
VAL_ 1024 CcfBattery1Type 0 "Not Supported" 2 "H6 AGM 70/760" 3 "H7 AGM 80/800" 4 "T4 Flooded 47/420" 6 "H6 AGM 70/760 IGOR NWS" 7 "H7 AGM 80/800 IGOR NWS" 9 "H6 AGM 70/760 Plugin IGOR NWS" 10 "H7 AGM 80/800 Plugin IGOR NWS" 11 "H8 AGM 95/850 Plugin IGOR NWS" 16 "GS Yuasa 60Ah Li-ion H4" 17 "GS Yuasa 60Ah Li-ion H4 Plugin" 18 "H4 Li-ion 40Ah CosMX" 25 "H8 AGM 95/850 IGOR NWS" 28 "H6 EFB 70/760 IGOR NWS" 29 "H7 EFB 80/800 IGOR EFB" 30 "H8 EFB 90/850 IGOR NWS" 31 "Error" ;
VAL_ 1024 CcfBattery2BMS 0 "Not supported" 1 "Not Fitted" 2 "Fitted" 3 "Error" ;
VAL_ 1024 CcfBrakePadWearIndication 0 "Not Supported" 1 "Disabled" 2 "Enabled" 3 "Error" ;
VAL_ 1024 CcfImmobiliserChannels 0 "Not Supported" 1 "IC Engine (PATS)" 2 "IC Engine + 1 Inverter (PATS + EPIC)" 3 "IC Engine + 2 Inverters (PATS + EPIC + EPIC B)" 4 "2 Inverters (EPIC + EPIC B)" 5 "Dual IC Engine (PATS + PATS)" 6 "1 Inverter" 7 "3 Inverters" 8 "4 Inverters" 254 "Not In Use" 255 "Error" ;
VAL_ 1024 CcfInteriorReleaseTailgate 0 "Not Supported" 1 "Disabled" 2 "Enabled" 3 "Error" ;
VAL_ 1024 CcfLightsOnWhenWipers 0 "Not supported" 1 "Not Fitted" 2 "Fitted" 3 "Error" ;
VAL_ 1024 CcfPixelTouristMode 0 "Not Supported" 1 "Pixel Tourist Mode Disabled" 2 "Pixel Tourist Mode Enabled" 3 "Error" ;
VAL_ 1024 CcfPSDBFitted 0 "Not supported" 1 "Not Fitted" 2 "Fitted" 3 "Error" ;
VAL_ 1024 CcfRearFoldFlat 0 "Not supported" 1 "Not Fitted" 2 "Fitted" 3 "Error" ;
VAL_ 1024 CcfRemoteReleaseTailgate 0 "Not Supported" 1 "Disabled" 2 "Enabled" 3 "Error" ;
VAL_ 1024 CcfTailgateHingeType 0 "Not Supported" 1 "Upper Hinged" 2 "Side Hinged" 3 "Error" ;
VAL_ 1024 CcfVIAutoIllumination 0 "Not Supported" 1 "Not Fitted" 2 "Auto Illumination available to the driver only" 3 "Auto Illumination available to the driver and the passenger in row one only" 4 "Auto Illumination available to the driver and the passenger in row one and all passengers in row two only" 5 "Auto Illumination available to the driver and passenger in row one and all passengers in row two and all passengers in row three" 7 "Error" ;
VAL_ 1024 CcfVICustomisableShortcut 0 "Not Supported" 1 "Not Fitted" 2 "Customisable Shortcuts available to the driver only" 3 "Customisable Shortcuts available to the driver and the passenger in row one only" 4 "Customisable Shortcuts available to the driver and the passenger in row one and all passengers in row two only" 5 "Customisable Shortcuts available to the driver and the passenger in row one and all passengers in row two and all passengers in row three" 7 "Error" ;
VAL_ 1024 CcfVisionInteraction 0 "Not supported" 1 "Not Fitted" 2 "Fitted" 3 "Error" ;
VAL_ 1024 CcfVQMFitted 0 "Not supported" 1 "Not Fitted" 2 "Fitted" 3 "Error" ;
VAL_ 1024 CcfVSMLVehicleHealthWarn 0 "Not Supported" 1 "Vehicle Settings Vehicle Health & Warning category not displayed on In Vehicle Infotainment" 2 "Vehicle Settings Vehicle Health & Warning category displayed on In Vehicle Infotainment" 3 "Error" ;
VAL_ 1024 CcfVSMOilLevelUnit 0 "Not Supported" 1 "Metric - Litres" 2 "US - Quarts" 3 "Error" ;
VAL_ 1024 CcfWirelessDeviceCharger 0 "Not Supported" 1 "Not Fitted" 2 "Front Wireless Device Charger fitted" 3 "Rear Wireless Device Charger Fitted" 4 "Front and Rear Wireless Device Charger Fitted" 7 "Error" ;
VAL_ 1024 CcfXenonLamps 0 "Not supported" 1 "Not Fitted" 2 "Fitted" 3 "Error" ;
VAL_ 1024 CcfA2BConfigurationNo 0 "Not Supported" 1 "Configuration #1" 2 "Configuration #2" 3 "Configuration #3" 4 "Configuration #4" 5 "Configuration #5" 6 "Configuration #6" 7 "Configuration #7" 8 "Configuration #8" 9 "Configuration #9" 10 "Configuration #10" 11 "Configuration #11" 12 "Configuration #12" 13 "Configuration #13" 14 "Configuration #14" 15 "Configuration #15" 16 "Configuration #16" 17 "Configuration #17" 18 "Configuration #18" 19 "Configuration #19" 20 "Configuration #20" 21 "Configuration #21" 22 "Configuration #22" 23 "Configuration #23" 24 "Configuration #24" 25 "Configuration #25" 26 "Configuration #26" 27 "Configuration #27" 28 "Configuration #28" 29 "Configuration #29" 30 "Configuration #30" 31 "Configuration #31" 32 "Configuration #32" 33 "Configuration #33" 34 "Configuration #34" 35 "Configuration #35" 36 "Configuration #36" 37 "Configuration #37" 38 "Configuration #38" 39 "Configuration #39" 40 "Configuration #40" 254 "Configuration Number Not applicable" 255 "Error" ;
VAL_ 1024 CcfAutoSSSelectInFCPB 0 "Not Supported" 1 "Control interface not available in FCPB" 2 "Available as single purpose button" 3 "Selectable within rotary" 4 "Available as shared purpose button" 5 "Rotary used for selection within touch screen" 7 "Error" ;
VAL_ 1024 CcfDSCSelectInFCPB 0 "Not Supported" 1 "Control interface not available in FCPB" 2 "Available as single purpose button" 3 "Selectable within rotary" 4 "Available as shared purpose button" 5 "Rotary used for selection within touch screen" 7 "Error" ;
VAL_ 1024 CcfHDCSelectInFCPB 0 "Not Supported" 1 "Control interface not available in FCPB" 2 "Available as single purpose button" 3 "Selectable within rotary" 4 "Available as shared purpose button" 5 "Rotary used for selection within touch screen" 7 "Error" ;
VAL_ 1024 CcfIVIType 0 "Not Supported" 1 "Gen 2.1" 2 "NGI Low Line" 3 "NGI Mid Line" 4 "NGI High Line" 5 "NLI Low Line" 6 "NLI High Line" 7 "PIVI Low Line" 8 "PIVI Mid Line" 9 "PIVI High Line" 10 "CCCM Mid" 11 "CCCM High" 255 "Error" ;
VAL_ 1024 CcfManovLightFadeTime 0 "Not Supported" 1 "0ms" 2 "250ms" 3 "500ms" 4 "750ms" 5 "1000ms" 6 "1250ms" 7 "1500ms" 8 "1750ms" 9 "2000ms" 10 "2250ms" 11 "2500ms" 12 "2750ms" 13 "3000ms" 15 "Error" ;
VAL_ 1024 CcfManovLightRevTime 0 "Not Supported" 1 "0s" 2 "120s" 3 "135s" 4 "150s" 5 "165s" 6 "180s" 7 "195s" 8 "210s" 9 "225s" 10 "240s" 11 "255s" 12 "270s" 13 "285s" 14 "300s" 15 "Error" ;
VAL_ 1024 CcfOdoLeadingZero 0 "Not Supported" 1 "Not Displayed" 2 "Displayed" 3 "Error" ;
VAL_ 1024 CcfPreCrashSeatBltPretent 0 "Not Supported" 1 "Seat Belt Pretention Not Fitted" 2 "Seat Belt Pretention Fitted" 3 "Error" ;
VAL_ 1024 CcfRemoteWingMirrorFold 0 "Not Supported" 1 "Remote Wing Mirror Fold not available" 2 "Remote Wing Mirror Fold available" 3 "Error" ;
VAL_ 1024 CcfSpeedoMainScaleUnits 0 "Not Supported" 1 "MPH" 2 "km/h" 3 "Menu" 4 "as trip computer" 7 "Error" ;
VAL_ 1024 CcfSpeedoSecondDisplay 0 "Not Supported" 1 "Not Displayed" 2 "Displayed if MPH selected" 3 "Displayed if km/h selected" 4 "Displayed" 7 "Error" ;
VAL_ 1024 CcfTerComSelectInFCPB 0 "Not Supported" 1 "Control interface not available in FCPB" 2 "Available as single purpose button" 3 "Selectable within rotary" 4 "Available as shared purpose button" 5 "Rotary used for selection within touch screen" 7 "Error" ;
VAL_ 1024 CcfTerDynSelectInFCPB 0 "Not Supported" 1 "Control interface not available in FCPB" 2 "Available as single purpose button" 3 "Selectable within rotary" 4 "Available as shared purpose button" 5 "Rotary used for selection within touch screen" 7 "Error" ;
VAL_ 1024 CcfTerECOSelectInFCPB 0 "Not Supported" 1 "Control interface not available in FCPB" 2 "Available as single purpose button" 3 "Selectable within rotary" 4 "Available as shared purpose button" 5 "Rotary used for selection within touch screen" 7 "Error" ;
VAL_ 1024 CcfTripCompInitialUnits 0 "Not Supported" 1 "Metric" 2 "Imperial / US" 3 "Error" ;
VAL_ 1024 CcfAllWheelSteer 0 "Not supported" 1 "Not Fitted" 2 "Fitted" 3 "Error" ;
VAL_ 1024 CcfATPCSelectInFCPB 0 "Not Supported" 1 "Control interface not available in FCPB" 2 "Available as single purpose button" 3 "Selectable within rotary" 4 "Available as shared purpose button" 5 "Rotary used for selection within touch screen" 7 "Error" ;
VAL_ 1024 CcfClimateHardKey 0 "Not Supported" 1 "Climate Hard Key Not Fitted" 2 "Climate Hard Key Fitted" 3 "Error" ;
VAL_ 1024 CcfFrontFogFuntionality 0 "Not Supported" 1 "No additional functionality required" 2 "Front Fog and SBL" 3 "Front Fog and CL" 4 "Front Fog/SBL/CL" 5 "Front SBL and CL" 6 "Front Fog / AFS / SBL / CL" 7 "Error" ;
VAL_ 1024 CcfInstrumentSkin 0 "Not Supported" 1 "Design 01" 2 "Design 02" 3 "Design 03" 4 "Design 04" 5 "Design 05" 6 "Design 06" 7 "Design 07" 8 "Design 08" 9 "Design 09" 10 "Design 10" 11 "Design 11" 12 "Design 12" 13 "Design 13" 14 "Design 14" 15 "Design 15" 16 "Undefined" 31 "Error" ;
VAL_ 1024 CcfOdometerUnits 0 "Not Supported" 1 "miles" 2 "km" 3 "same as trip computer" 7 "Error" ;
VAL_ 1024 CcfParkAid 0 "Not Supported" 1 "Not Available" 2 "Available" 3 "Error" ;
VAL_ 1024 CcfPreCrashSeatSquab 0 "Not Supported" 1 "Seat Squab Not Fitted" 2 "Seat Squab Fitted" 3 "Error" ;
VAL_ 1024 CcfSpdoSecondDisplayUnit 0 "Not Supported" 1 "MPH" 2 "km/h" 3 "same as trip computer" 4 "opposite to trip computer" 7 "Error" ;
VAL_ 1024 CcfSpeedoRange 0 "Not Supported" 1 "scale 1" 2 "scale 2" 3 "scale 3" 4 "scale 4" 5 "scale 5" 6 "scale 6" 7 "scale 7" 8 "scale 8" 9 "scale 9" 10 "scale 10" 11 "scale 11" 12 "scale 12" 13 "scale 13" 14 "scale 14" 15 "initial - use scale 1" 16 "error - use last scale selected" 31 "Error" ;
VAL_ 1024 CcfTachoGaugeVariant 0 "Not Supported" 1 "scale 1" 2 "scale 2" 3 "scale 3" 4 "scale 4" 7 "Error" ;
VAL_ 1024 CcfTerAutoSelectInFCPB 0 "Not Supported" 1 "Control interface not available in FCPB" 2 "Available as single purpose button" 3 "Selectable within rotary" 4 "Available as shared purpose button" 5 "Rotary used for selection within touch screen" 7 "Error" ;
VAL_ 1024 CcfTerGGSSelectInFCPB 0 "Not Supported" 1 "Control interface not available in FCPB" 2 "Available as single purpose button" 3 "Selectable within rotary" 4 "Available as shared purpose button" 5 "Rotary used for selection within touch screen" 7 "Error" ;
VAL_ 1024 CcfTerMudSelectInFCPB 0 "Not Supported" 1 "Control interface not available in FCPB" 2 "Available as single purpose button" 3 "Selectable within rotary" 4 "Available as shared purpose button" 5 "Rotary used for selection within touch screen" 7 "Error" ;
VAL_ 1024 CcfTerSandSelectInFCPB 0 "Not Supported" 1 "Control interface not available in FCPB" 2 "Available as single purpose button" 3 "Selectable within rotary" 4 "Available as shared purpose button" 5 "Rotary used for selection within touch screen" 7 "Error" ;
VAL_ 1024 CcfTripCompFuelEconomy 0 "Not Supported" 1 "-0.075" 2 "-0.07" 3 "-0.065" 4 "-0.06" 5 "-0.055" 6 "-0.05" 7 "-0.045" 8 "-0.04" 9 "-0.035" 10 "-0.03" 11 "-0.025" 12 "-0.02" 13 "-0.015" 14 "-0.01" 15 "-0.005" 16 "0" 17 "+0.005" 18 "+0.01" 19 "+0.015" 20 "+0.02" 21 "+0.025" 22 "+0.03" 23 "+0.035" 24 "+0.04" 25 "+0.045" 26 "+0.05" 27 "+0.055" 28 "+0.06" 29 "+0.065" 30 "+0.07" 31 "+0.075" 32 "+0.08" 63 "Error" ;
VAL_ 1024 CcfTripCompMetFulEcoUnt 0 "Not Supported" 1 "km/l" 2 "l/100km" 3 "Error" ;
VAL_ 1024 CcfVTGlazingRoof 0 "Not Supported" 1 "Not Fitted" 2 "Front Panel Only" 3 "Rear Panel Only" 4 "Front and Rear Panel" 5 "Reserved for future use" 7 "Error" ;
VAL_ 1024 CcfBattery2Type 0 "Not Supported" 1 "Not Fitted" 2 "H6 AGM 70/760" 3 "H7 AGM 80/800" 4 "H4 Yuasa 60Ah Li-ion" 7 "T4 Flooded 43/390" 8 "T5 Flooded 52/500" 9 "T6 Flooded 60/590" 10 "T7 Flooded 80/700" 11 "T8 Flooded 90/800" 12 "H5 Flooded 60/520" 13 "H6 Flooded 70/600" 14 "H7 Flooded 80/700" 15 "H8 Flooded 90/800" 16 "H8 Flooded 90/950" 27 "B19 AGM 14/200" 31 "Error" ;
VAL_ 1024 CcfBSCMFitted 0 "Not supported" 1 "Not Fitted" 2 "Fitted" 3 "Error" ;
VAL_ 1024 CcfConventionalCharging 0 "Not supported" 1 "Not Fitted" 2 "Fitted" 3 "Error" ;
VAL_ 1024 CcfDriveModeDiscStrat 0 "Not Supported" 1 "Drive mode support is not fitted" 2 "Use legacy strategy to discover drive mode fitment" 3 "Use legacy strategy to discover drive mode fitment (repair)" 4 "Use consolidated strategy to discover drive mode fitment" 15 "Error" ;
VAL_ 1024 CcfDriveModeOrder 0 "Not Supported" 1 "All Terrain Vehicle Standard Order" 2 "Road Vehicle Standard Order" 3 "Track Option Custom Order" 4 "All Terrain Vehicle Including Auto Order" 5 "Special Dynamic Vehicle Mode Order" 6 "Off Road Special Dynamic Vehicle Mode Order" 63 "Error" ;
VAL_ 1024 CcfDriveModeSigSchema 0 "Not Supported" 1 "All Terrain Vehicle Standard Schema" 2 "Road Vehicle Standard Schema" 3 "Track Option Custom Schema" 63 "Error" ;
VAL_ 1024 CcfEVRangeInfoWithPMZ 0 "Not Supported" 1 "EVRangeDispPMZ and EVRangeMilesDispPMZ are not available" 2 "EVRangeDispPMZ and EVRangeMilesDispPMZ are available" 3 "Error" ;
VAL_ 1024 CcfEVSelectInBlade 0 "Not Supported" 1 "Hybrid mode keys not in lower screen" 2 "Hybrid mode keys in lower screen" 7 "Error" ;
VAL_ 1024 CcfEVSelectInFCPB 0 "Not Supported" 1 "Control interface not available in FCPB" 2 "Available as single purpose button" 3 "Selectable within rotary" 4 "Available as shared purpose button" 5 "Rotary used for selection within touch screen" 7 "Error" ;
VAL_ 1024 CcfFLCVariant 0 "Not Supported" 1 "Not Fitted" 2 "FLC Mono" 3 "FLC Stereo" 7 "Error" ;
VAL_ 1024 CcfLeisureBatt 0 "Not supported" 1 "Not Fitted" 2 "Fitted" 3 "Error" ;
VAL_ 1024 CcfOverspeedSaudi 0 "Not Supported" 1 "Disabled" 2 "Enabled" 3 "Error" ;
VAL_ 1024 CcfParkAssist 0 "Not Supported" 1 "Not Fitted" 2 "Semi-Auto VarB (Semi-automated park assist with automated steering)" 3 "Full Auto VarD (Fully automated park assist with automated steering, braking, acceleration and gears)" 4 "Full Auto + Remote VarD + VarE (Fully automated park assist with automated steering, braking, acceleration and gears + Remote operation) " 15 "Error" ;
VAL_ 1024 CcfSpdoScndDispEnblMenu 0 "Not Supported" 1 "Disabled" 2 "Enabled" 3 "Error" ;
VAL_ 1024 CcfSpdoScndDispUnitMenu 0 "Not Supported" 1 "Disabled" 2 "Enabled" 3 "Error" ;
VAL_ 1024 CcfSpecialClock 0 "Not Supported" 1 "Not Fitted" 2 "Standard Analogue Clock Fitted" 3 "Trinity-Zenith Clock Fitted" 15 "Error" ;
VAL_ 1024 CcfSpeedoMinorScale 0 "Not Supported" 1 "Not Displayed" 2 "Displayed" 3 "Error" ;
VAL_ 1024 CcfVIAutoStart 0 "Not Supported" 1 "Not Fitted" 2 "Auto Start available" 3 "Error" ;
VAL_ 1024 CcfAirSusSelectInFCPB 0 "Not Supported" 1 "Control interface not available in FCPB" 2 "Available as single purpose button" 3 "Selectable within rotary" 4 "Available as shared purpose button" 5 "Rotary used for selection within touch screen" 7 "Error" ;
VAL_ 1024 CcfBacklightDimStratSel 0 "Not Supported" 1 "Dimmer Knob selection" 2 "Virtual Dimmer selection" 3 "Error" ;
VAL_ 1024 CcfCCMVariant 0 "Not Supported" 1 "Not Fitted" 2 "MRRevo14F Fitted" 15 "Error" ;
VAL_ 1024 CcfCityDrivingPwrSteer 0 "Not supported" 1 "Not Fitted" 2 "Fitted" 3 "Error" ;
VAL_ 1024 CcfDADCModule 0 "Not Supported" 1 "Not Fitted" 2 "DADC LL" 3 "DADC HL" 15 "Error" ;
VAL_ 1024 CcfDynSuspensionType 0 "Not Supported" 1 "Not Fitted" 2 "AD2" 3 "AD2 and eARC" 4 "AD2 eARC and DAS" 5 "DAS and FAS" 6 "AD2 and DAS" 7 "FAS" 8 "AD2 and Pre-emptive" 9 "AD2 eARC and Pre-emptive" 10 "AD2 eARC DAS and Pre-emptive" 11 "DAS FAS and Pre-emptive" 12 "AD2 DAS and Pre-emptive" 13 "FAS and Pre-emptive" 14 "AD2 and Kinetic" 15 "AD2 and DAS and Kinetic" 16 "AD2 and Kinetic and Pre-emptive" 17 "AD2 and DAS and Kinetic and Pre-emptive" 31 "Error" ;
VAL_ 1024 CcfFrontCornerRadars 0 "Not Supported" 1 "Front corner radars not fitted" 2 "Front corner radars fitted" 7 "Error" ;
VAL_ 1024 CcfGuidanceBeamCCF 0 "Not supported" 1 "Not Fitted" 2 "Fitted" 3 "Error" ;
VAL_ 1024 CcfHandsOnDetection 0 "Not supported" 1 "Not Fitted" 2 "Fitted" 3 "Error" ;
VAL_ 1024 CcfLoRngSelectInFCPB 0 "Not Supported" 1 "Control interface not available in FCPB" 2 "Available as single purpose button" 3 "Selectable within rotary" 4 "Available as shared purpose button" 5 "Rotary used for selection within touch screen" 7 "Error" ;
VAL_ 1024 CcfPredictableAFS 0 "Not supported" 1 "Not Fitted" 2 "Fitted" 3 "Error" ;
VAL_ 1024 CcfRearCornerRadars 0 "Not Supported" 1 "Rear corner radars not fitted" 2 "Rear corner radars fitted" 7 "Error" ;
VAL_ 1024 CcfTA2InputControl 0 "Not Supported" 1 "Not fitted" 2 "Use legacy logic" 3 "ATCM rotary switch" 4 "BLADE rotary" 5 "HVAC rotary" 6 "SUPER ICP rotary" 7 "PIVI Touch Screen" 15 "Error" ;
VAL_ 1024 CcfTA2SelectInFCPB 0 "Not Supported" 1 "Control interface not available in FCPB" 2 "Available as single purpose button" 3 "Selectable within rotary" 4 "Available as shared purpose button" 5 "Rotary used for selection within touch screen" 7 "Error" ;
VAL_ 1024 CcfTelematicsSignIn 0 "Not Supported" 1 "Sign-in not possible" 2 "Sign-in possible" 3 "Error" ;
VAL_ 1024 CcfTerCPSelectInFCPB 0 "Not Supported" 1 "Control interface not available in FCPB" 2 "Available as single purpose button" 3 "Selectable within rotary" 4 "Available as shared purpose button" 5 "Rotary used for selection within touch screen" 7 "Error" ;
VAL_ 1024 CcfTerCTSelectInFCPB 0 "Not Supported" 1 "Control interface not available in FCPB" 2 "Available as single purpose button" 3 "Selectable within rotary" 4 "Available as shared purpose button" 5 "Rotary used for selection within touch screen" 7 "Error" ;
VAL_ 1024 CcfTerRockSelectInFCPB 0 "Not Supported" 1 "Control interface not available in FCPB" 2 "Available as single purpose button" 3 "Selectable within rotary" 4 "Available as shared purpose button" 5 "Rotary used for selection within touch screen" 7 "Error" ;
VAL_ 1024 CcfTerWadeSelectInFCPB 0 "Not Supported" 1 "Control interface not available in FCPB" 2 "Available as single purpose button" 3 "Selectable within rotary" 4 "Available as shared purpose button" 5 "Rotary used for selection within touch screen" 7 "Error" ;
VAL_ 1024 CcfADASCBV 0 "Not Supported" 1 "Not Fitted" 2 "Fitted" 7 "Error" ;
VAL_ 1024 CcfApproachOpenDoors 0 "Not Supported" 1 "Not Fitted" 2 "Fitted - Drivers Door Only" 3 "Fitted - Selectable by User" 7 "Error" ;
VAL_ 1024 CcfATPCPRO 0 "Not Supported" 1 "ATPC PRO Not Fitted" 2 "ATPC PRO Pre-Emptive and Reactive" 3 "ATPC PRO Reactive only" 7 "Error" ;
VAL_ 1024 CcfCamWashType 0 "Not Supported" 1 "Not Fitted" 2 "Manual Wash" 3 "Auto Wash With Settings" 4 "Auto Wash Without Settings" 7 "Error" ;
VAL_ 1024 CcfeHorizonVariant 0 "Not Supported" 1 "Not fitted" 2 "eHorizon Av2 short fitted" 3 "eHorizon proprietary protocol long fitted" 4 "eHorizon Av2 short and proprietary protocol long fitted" 7 "Error" ;
VAL_ 1024 CcfEngCoolantHotWarn 0 "Not Supported" 1 "Base value 1 plus 01c" 2 "Base value 1 plus 02c" 3 "Base value 1 plus 03c" 4 "Base value 1 plus 04c" 5 "Base value 1 plus 05c" 6 "Base value 1 plus 06c" 7 "Base value 1 plus 07c" 8 "Base value 1 plus 08c" 9 "Base value 1 plus 09c" 10 "Base value 1 plus 10c" 11 "Base value 1 plus 11c" 12 "Base value 1 plus 12c" 13 "Base value 1 plus 13c" 14 "Base value 1 plus 14c" 15 "Base value 1 plus 15c" 16 "Warning Not displayed" 31 "Error" ;
VAL_ 1024 CcfEngCoolantVryHotWarn 0 "Not Supported" 1 "Base value 2 plus 01c" 2 "Base value 2 plus 02c" 3 "Base value 2 plus 03c" 4 "Base value 2 plus 04c" 5 "Base value 2 plus 05c" 6 "Base value 2 plus 06c" 7 "Base value 2 plus 07c" 8 "Base value 2 plus 08c" 9 "Base value 2 plus 09c" 10 "Base value 2 plus 10c" 11 "Base value 2 plus 11c" 12 "Base value 2 plus 12c" 13 "Base value 2 plus 13c" 14 "Base value 2 plus 14c" 15 "Base value 2 plus 15c" 16 "Undefined / Not programmed" 31 "Error" ;
VAL_ 1024 CcfEVSDCalNo 0 "Not Supported" 1 "Not Fitted" 2 "Calibration 1" 3 "Calibration 2" 4 "Calibration 3" 5 "Calibration 4" 6 "Calibration 5" 7 "Calibration 6" 8 "Calibration 7" 9 "Calibration 8" 10 "Calibration 9" 11 "Calibration 10" 12 "Calibration 11" 13 "Calibration 12" 14 "Calibration 13" 15 "Calibration 14" 16 "Calibration 15" 17 "Calibration 16" 18 "Calibration 17" 19 "Calibration 18" 20 "Calibration 19" 21 "Calibration 20" 254 "Cal Number Not Applicable" 255 "Error" ;
VAL_ 1024 CcfGestureBonnet 0 "Not Supported" 1 "No Powered Gesture Sense" 2 "Powered Gesture Sense" 3 "Error" ;
VAL_ 1024 CcfGestureDoorHandles 0 "Not supported" 1 "Not Fitted" 2 "Fitted" 3 "Error" ;
VAL_ 1024 CcfPowerSideDoors 0 "Not Supported" 1 "Manual Side Doors" 2 "Powered Side Doors ALL Doors" 3 "Powered Side Doors Front Doors only" 4 "Powered Side Doors Rear Doors only" 5 "Powered Side Doors Drivers Door only" 7 "Error" ;
VAL_ 1024 CcfRefrigerantType 0 "Not Supported" 1 "HF01234YF" 2 "R134A" 3 "R744" 7 "Error" ;
VAL_ 1024 CcfReverseLightActStra 0 "Not Supported" 1 "Conventional Reverse Gear selection signals only" 2 "Vehicle direction signal used" 7 "Error" ;
VAL_ 1024 CcfSeeThroughTrailer 0 "Not Supported" 1 "Not Available" 2 "Available" 3 "Error" ;
VAL_ 1024 CcfSideDoorObjectDet 0 "Not Supported" 1 "Not Fitted" 2 "Fitted" 7 "Error" ;
VAL_ 1024 CcfVehClearGuidance 0 "Not Supported" 1 "Not Available" 2 "Available" 3 "Error" ;
VAL_ 1024 CcfVertAccelSource 0 "Not Supported" 1 "Vertical Accelerometers not fitted" 2 "Vertical Accelerometers fitted" 7 "Error" ;
VAL_ 1024 CcfActiveBrakeDuctVanes 0 "Not supported" 1 "Not Fitted" 2 "Fitted" 3 "Error" ;
VAL_ 1024 CcfDADLInhibitOff 0 "Not Supported" 1 "Inhibit Off" 2 "Allow Off" 3 "Error" ;
VAL_ 1024 CcfEDUDriveline 0 "Not Supported" 1 "No EDU" 2 "Single Front EDU" 3 "Single Rear EDU" 4 "Single Front EDU & Single Rear EDU" 5 "Single Front EDU & Dual Rear EDU" 6 "Dual Front EDU & Dual Rear EDU" 7 "Error" ;
VAL_ 1024 CcfFrntUpperDispMargin 0 "Not Supported" 1 "No Margin - nothing obscured" 2 "Margin obscuring 8mm Left, 8mm Right, 0mm Top, 0mm Bottom" 15 "Error" ;
VAL_ 1024 CcfFrtAnmSeqWkUpShutDn 0 "Not Supported" 1 "Not fitted" 2 "Front Wakeup and Shutdown Anim Sequence Sequence 1" 3 "Front Wakeup and Shutdown Anim Sequence Sequence 2" 4 "Front Wakeup and Shutdown Anim Sequence Sequence 3" 5 "Front Wakeup and Shutdown Anim Sequence Sequence 4" 6 "Front Wakeup and Shutdown Anim Sequence Sequence 5" 7 "Error" ;
VAL_ 1024 CcfIVIAPIXClusterComms 0 "Not Supported" 1 "Not Fitted" 2 "SOME-IP over APIX Back Channel" 3 "SOME-IP over Infotainment Ethernet" 15 "Error" ;
VAL_ 1024 CcfIVIeSIMProfileType 0 "Not Supported" 1 "Not fitted" 2 "Roaming Profile" 3 "Local network Profile 1" 4 "Local network Profile 2" 5 "Local network Profile 3" 6 "Local network Profile 4" 7 "Local network Profile 5" 8 "Local network Profile 6" 9 "Local network Profile 7" 10 "Local network Profile 8" 11 "Local network Profile 9" 12 "Local network Profile 10" 13 "Local network Profile 11" 14 "Local network Profile 12" 15 "Local network Profile 13" 16 "Local network Profile 14" 17 "Local network Profile 15" 255 "Error" ;
VAL_ 1024 CcfIVIWiFiHotspot 0 "Not Supported" 1 "Internal WiFi Hotspot not fitted" 2 "Internal WiFi Hotspot fitted" 3 "Error" ;
VAL_ 1024 CcfLHSWSFvClusterView 0 "Not supported" 1 "Not Fitted" 2 "Fitted" 3 "Error" ;
VAL_ 1024 CcfPM25Market 0 "Not Supported" 1 "Market 1" 2 "Market 2" 3 "Market 3" 4 "Market 4" 254 "Not Fitted" 255 "Error" ;
VAL_ 1024 CcfPwrTgateHMIControl 0 "Not Supported" 1 "Not Fitted" 2 "Fitted" 3 "Spare value unused" 255 "Error" ;
VAL_ 1024 CcfRoofControlStrategy 0 "Not Supported" 1 "No Roof System Control" 2 "Blind Control - Hardwired switches" 3 "Convertible Independent Control" 4 "Convertible - Global Close on Roof Close" 5 "Convertible - Full Global Close" 6 "Blind Control - Networked switches" 255 "Error" ;
VAL_ 1024 CcfUserEEBReserveMgmt 0 "Not Supported" 1 "Not Fitted" 2 "Fitted" 3 "Error" ;
VAL_ 1024 CcfAnmProjWakeUpShutDn 0 "Not Supported" 1 "Not Fitted" 2 "Wakeup and Shutdown Projection Sequence 1" 3 "Wakeup and Shutdown Projection Sequence 2" 4 "Wakeup and Shutdown Projection Sequence 3" 5 "Wakeup and Shutdown Projection Sequence 4" 6 "Wakeup and Shutdown Projection Sequence 5" 7 "Error" ;
VAL_ 1024 CcfBrakeWarnings 0 "Not Supported" 1 "Do not flash red brake warning" 2 "Flash red brake warning" 3 "Error" ;
VAL_ 1024 CcfHVBatteryCapacity 0 "Not Supported" 1 "No HV battery fitted" 2 "90kWh" 3 "97kWh" 4 "115kWh" 5 "81kWh" 6 "101kWh" 7 "102kWh" 8 "117kWh" 9 "120kWh" 10 "121kWh" 11 "122kWh" 12 "138kWh" 31 "Error" ;
VAL_ 1024 CcfIndirectVentsFitted 0 "Not Supported" 1 "Not Fitted" 2 "Fitted with Manual Control " 3 "Fitted with Electric Control" 7 "Error" ;
VAL_ 1024 CcfPreEmpSuspBowWvDmp 0 "Not Supported" 1 "Feature disabled" 2 "Feature enabled" 3 "Error" ;
VAL_ 1024 CcfPreEmpSusPitchDamp 0 "Not Supported" 1 "Feature disabled" 2 "Feature enabled" 3 "Error" ;
VAL_ 1024 CcfPreEmptSusCnrRdEnh 0 "Not Supported" 1 "Feature disabled" 2 "Feature enabled" 3 "Error" ;
VAL_ 1024 CcfPreEmptSusCollMtgn 0 "Not Supported" 1 "Feature disabled" 2 "Feature enabled" 3 "Error" ;
VAL_ 1024 CcfPreEmptSusCrPkAccHt 0 "Not Supported" 1 "Feature disabled" 2 "Feature enabled" 3 "Error" ;
VAL_ 1024 CcfPreEmptSusKrbStrkDt 0 "Not Supported" 1 "Feature disabled" 2 "Feature enabled" 3 "Error" ;
VAL_ 1024 CcfPreEmptSusSpeedLwr 0 "Not Supported" 1 "Feature disabled" 2 "Feature enabled" 3 "Error" ;
VAL_ 1024 CcfRow1SeatBolster 0 "Not supported" 1 "Not Fitted" 2 "Fitted" 3 "Error" ;
VAL_ 1024 CcfRow1SeatCushExt 0 "Not supported" 1 "Not Fitted" 2 "Fitted" 3 "Error" ;
VAL_ 1024 CcfRow1SeatHeadrest 0 "Not Supported" 1 "Not Fitted" 2 "2-Way Fitted" 3 "4-Way Fitted without Passenger Dump" 4 "4-Way Fitted with Passenger Dump" 7 "Error" ;
VAL_ 1024 CcfRow1SeatLumbar 0 "Not Supported" 1 "Not Fitted" 2 "2-Way Fitted" 3 "4-Way 2 Bags Fitted" 4 "4-Way 3 Bags Fitted" 7 "Error" ;
VAL_ 1024 CcfRow1SeatShoulder 0 "Not supported" 1 "Not Fitted" 2 "Fitted" 3 "Error" ;
VAL_ 1024 CcfRow2SeatBolster 0 "Not supported" 1 "Not Fitted" 2 "Fitted" 3 "Error" ;
VAL_ 1024 CcfRow2SeatHeadrest 0 "Not Supported" 1 "Not Fitted" 2 "2-Way Fitted" 3 "4-Way Fitted" 4 "Dropping Headrest Fitted" 5 "2-Way FA Fitted" 7 "Error" ;
VAL_ 1024 CcfRow2SeatLumbar 0 "Not Supported" 1 "Not Fitted" 2 "2-Way Fitted" 3 "4-Way 2 Bags Fitted" 4 "4-Way 3 Bags Fitted" 7 "Error" ;
VAL_ 1024 CcfRow2SeatShoulder 0 "Not supported" 1 "Not Fitted" 2 "Fitted" 3 "Error" ;
VAL_ 1024 CcfRrAnmSeqWkUpShutDn 0 "Not Supported" 1 "Not fitted" 2 "Rear Wakeup and Shutdown Anim Sequence Sequence 1" 3 "Rear Wakeup and Shutdown Anim Sequence Sequence 2" 4 "Rear Wakeup and Shutdown Anim Sequence Sequence 3" 5 "Rear Wakeup and Shutdown Anim Sequence Sequence 4" 6 "Rear Wakeup and Shutdown Anim Sequence Sequence 5" 7 "Error" ;
VAL_ 1024 CcfTailgateEventExperience 0 "Not supported" 1 "Not Fitted" 2 "Fitted" 3 "Error" ;
VAL_ 1024 CcfTailgateEventLight 0 "Not Supported" 1 "Feature disabled" 2 "Feature enabled" 3 "Error" ;
VAL_ 1024 Ccf4x4iD8Driveline 0 "Not Supported" 1 "Not Fitted" 2 "MultiCAN torque bar signals" 3 "EVA1 torque bar signals" 4 "EVA2 torque bar signals" 7 "Error" ;
VAL_ 1024 CcfAirSuspUIType 0 "Not Supported" 1 "Not Fitted" 2 "Up/Down switches" 3 "Blade controls" 4 "PIVI controls" 7 "Error" ;
VAL_ 1024 CcfAutoStpStrtButtonType 0 "Not Supported" 1 "Not Fitted" 2 "Hard Button Fitted" 3 "Soft Button Fitted" 7 "Error" ;
VAL_ 1024 CcfCentrSideAirbag 0 "Not supported" 1 "Not Fitted" 2 "Fitted" 3 "Error" ;
VAL_ 1024 CcfDSCSwitchSource 0 "Not Supported" 1 "Not Fitted" 2 "ATCM hosted button" 3 "Blade hosted button" 4 "PIVI hosted soft switch " 5 "HVAC hosted switch" 7 "Error" ;
VAL_ 1024 CcfIMSCalNo1 0 "Not Supported" 255 "Error" ;
VAL_ 1024 CcfIMSCalNo2 0 "Not Supported" 255 "Error" ;
VAL_ 1024 CcfIMSType 0 "Not Supported" 1 "Not Fitted" 2 "IMS Type 1" 3 "IMS Type 2" 4 "IMS Type 3" 7 "Error" ;
VAL_ 1024 CcfLSPFitment 0 "Not supported" 1 "Not Fitted" 2 "Fitted" 3 "Error" ;
VAL_ 1024 CcfPNLeisureBattstatus 0 "Not Supported" 1 "PNLeisureBattery Disabled" 2 "PNLeisureBattery Enabled" 3 "Error" ;
VAL_ 1024 CcfPoliceLightsFuncReq 0 "Not Supported" 1 "Not Fitted" 2 "DRL Alternating Flash 1Hz" 3 "DRL Simultaneous Flash 1Hz" 4 "Not in use" 5 "High Beam Simultaneous Flash 1Hz" 6 "Not in use" 31 "Error" ;
VAL_ 1024 CcfPreEmptSusPkgKrbAvd 0 "Not Supported" 1 "Feature disabled" 2 "Feature enabled" 3 "Error" ;
VAL_ 1024 CcfPyroBrake 0 "Not supported" 1 "Not Fitted" 2 "Fitted" 3 "Error" ;
VAL_ 1024 CcfSeatPeripheralCtrl 0 "Not Supported" 1 "No Heating and Cooling function provided" 2 "Heating and Cooling Controlled by HVAC" 3 "Heating and Cooling Controlled by SZM" 7 "Error" ;
VAL_ 1024 CcfTaskLightingTLMB 0 "Not Supported" 1 "Not Fitted" 2 "Dimmable Task Light Variant B Fitted" 3 "Error" ;
VAL_ 1024 CcfTaskLightingTLMC 0 "Not Supported" 1 "Not Fitted" 2 "Dimmable Task Light Variant C Fitted" 3 "Error" ;
VAL_ 1024 CcfTracDSCFitted 0 "Not Supported" 1 "TracDSC not fitted" 2 "TracDSC fitted" 7 "Error" ;
VAL_ 1024 CcfAGMcActrFitment 0 "Not Supported" 1 "Not Fitted" 2 "Actuator AGM-C Fitted" 3 "Error" ;
VAL_ 1024 CcfAGMdActrFitment 0 "Not Supported" 1 "Not Fitted" 2 "Actuator AGM-D Fitted" 3 "Error" ;
VAL_ 1024 CcfCabinSnapshot 0 "Not Supported" 1 "Not Fitted" 2 "Fitted" 7 "Error" ;
VAL_ 1024 CcfCDMHandlingPartc 0 "Not Supported" 1 "Not Participating in Mode Management" 2 "Participating in Mode Management" 3 "Error" ;
VAL_ 1024 CcfCDMISCSPartc 0 "Not Supported" 1 "Not Participating in Mode Management" 2 "Participating in Mode Management" 3 "Error" ;
VAL_ 1024 CcfCTRBCSPartc 0 "Not Supported" 1 "Not Participating in Mode Management" 2 "Participating in Mode Management" 3 "Error" ;
VAL_ 1024 CcfEVBattUsablekWh 0 "Not Supported" 1 "Not Fitted" 2 "2kWh" 254 "254kWh" 255 "Error" ;
VAL_ 1024 CcfExpDateFormatSigs 0 "Not Supported" 1 "Expanded Date Format Signals not available" 2 "Expanded Date Format Signals available" 3 "Error" ;
VAL_ 1024 CcfFntClimateSeatsSZM 0 "Not supported" 1 "No Heated or Climate Seats" 2 "Heated Only Seats with SPEC 3 mats" 3 "Ventilated Seats with SPEC 3 mats" 4 "Ventilated Seats with SPEC 4 mats" 5 "Active Cooling Seats with SPEC 4 mats" 6 "Heated Only Seats with Spec 4 Mats" 7 "Active Cooling Seats with Spec 3 mats" 15 "Error" ;
VAL_ 1024 CcfHDAdaptDrvBeam 0 "Not Supported" 1 "HD ADB Not Fitted" 2 "HD ADB Fitted" 3 "Error" ;
VAL_ 1024 CcfItemReminder 0 "Not Supported" 1 "Not Fitted" 2 "Fitted" 7 "Error" ;
VAL_ 1024 CcfOCSPFitment 0 "Not supported" 1 "Not Fitted" 2 "Fitted" 3 "Error" ;
VAL_ 1024 CcfPassSeatHeelCatcher 0 "Not supported" 1 "Not Fitted" 2 "Fitted" 3 "Error" ;
VAL_ 1024 CcfPetrolEmissionsHW 0 "Not Supported" 1 "Petrol Not Fitted" 2 "Federal" 3 "European non-GPF" 4 "European GPF" 5 "China non-GPF" 6 "China GPF" 7 "Brazil E22" 8 "Brazil E100" 9 "ROW" 10 "Japan" 11 "European GPF With E85" 15 "Error" ;
VAL_ 1024 CcfRemoteDeviceReminder 0 "Not Supported" 1 "Not Fitted" 2 "Fitted" 7 "Error" ;
VAL_ 1024 CcfRrClimateSeatsSZM 0 "Not supported" 1 "No Heated or Climate Seats" 2 "Rear Heated only Seats" 3 "Rear Ventilated Seats with SPEC 3 Matts" 4 "Rear Ventilated Seats with SPEC 4 Matts" 5 "Rear Active Cooling Seats" 6 "Rear Heated Only seats with third row heated" 7 "Rear Ventilated Seats with third row heated" 31 "Error" ;
VAL_ 1024 CcfSpecialVehicles 0 "Not supported" 1 "Not a Special Vehicle" 2 "Waymo" 3 "Waymo pre upfit" 7 "Error" ;
VAL_ 1024 CcfSpeedoMarket 0 "Not Supported" 1 "Market 0 (+3.5% +2km/h)" 2 "Market 1 (+2.0% +0km/h)" 3 "Error" ;
VAL_ 1024 CcfTEETailgateActuation 0 "Not Supported" 1 "Not Fitted" 2 "Tailgate Event Experience moves Upper Tailgate only" 3 "Tailgate Event Experience moves Upper and Lower Tailgate" 7 "Error" ;
VAL_ 1024 CcfATPCButtonType 0 "Not Supported" 1 "Not Fitted" 2 "Hard Button Fitted" 3 "Soft Button Fitted" 7 "Error" ;
VAL_ 1024 CcfAutoBlowerIntensityLvlConfig 0 "Not Supported" 1 "Not Fitted" 2 "3 Level configuration" 3 "5 Level configuration" 7 "Error" ;
VAL_ 1024 CcfDDMCalibration 0 "Not Supported" 1 "DDM Not Fitted" 2 "Calibration 1" 3 "Calibration 2" 4 "Calibration 3" 7 "Error" ;
VAL_ 1024 CcfDepDoorHandShowMode 0 "Not Supported" 1 "Deployable Pivot Handle Showroom Mode Enabled" 2 "Deployable Pivot Handle Showroom Mode Disabled" 3 "Deployable Door Handle Showroom Mode Enabled" 4 "Deployable Door Handle Showroom Mode Disabled" 7 "Error" ;
VAL_ 1024 CcfFntLowerDispHaptic 0 "Not Supported" 1 "Not Fitted" 2 "Front Lower Haptic Display fitted" 3 "Error" ;
VAL_ 1024 CcfFntUpperDispHaptic 0 "Not Supported" 1 "Not Fitted" 2 "Front Upper Haptic Display fitted" 3 "Error" ;
VAL_ 1024 CcfPhoneSignalBooster 0 "Not supported" 1 "Not Fitted" 2 "Fitted" 3 "Error" ;
VAL_ 1024 CcfPM25SensorType 0 "Not Supported" 1 "Not Fitted" 2 "PM2.5 sensor only fitted" 3 "PM2.5 sensor integrated with C02 sensor fitted" 7 "Error" ;
VAL_ 1024 CcfRearChillerUserControl 0 "Not Supported" 1 "Not Fitted" 2 "Chiller controlled by ON/OFF control only" 3 "Chiller controlled by Speed Levels" 7 "Error" ;
VAL_ 1024 CcfSeatSpec 0 "Not Supported" 1 "Bench 5 Seater" 2 "Bench 7 Seater" 3 "Exec" 4 "Exec SVO 4 Seats" 5 "2 Seats" 6 "Exec SVO 5 Seats" 7 "Error" ;
VAL_ 1024 CcfSensorSlopeType 0 "Not Supported" 1 "Slope Type 90' body" 2 "Slope Type 110' body" 3 "Slope Type 130' body" 255 "Error" ;
VAL_ 1024 CcfTailgateCloseLockSwitch 0 "Not Supported" 1 "Vehicle fitted with single switch for close and close & lock system" 2 "Vehicle fitted dedicated switch for close and lock system" 3 "Vehicle NOT fitted with close and lock switch" 7 "Error" ;
VAL_ 1024 CcfTSSecSeatMovement 0 "Not Supported" 1 "Touch Screen Control of Secondary Seat Movement - Not Fitted" 2 "Touch Screen Control of Secondary Seat Movement - Fitted" 3 "Error" ;
VAL_ 1024 CcfADASAlertSensitivity 0 "Not Supported" 1 "Not Fitted" 2 "Fitted Var A (Off, Very Early, Early, Normal)" 3 "Legacy" 4 "Fitted Var B (Very Early, Early, Normal)" 5 "Fitted Var C (Early, Normal)" 7 "Error" ;
VAL_ 1024 CcfADASSpdLimOffset 0 "Not Supported" 1 "Not Fitted" 2 "Fitted Var A Fixed Settings" 3 "Legacy" 4 "Fitted Var B Variable Settings" 7 "Error" ;
VAL_ 1024 CcfAutoHoldType 0 "Not Supported" 1 "Enhanced - Uphill only" 2 "Auto" 3 "Error" ;
VAL_ 1024 CcfDeployableRSEType 0 "Not Supported" 1 "Not Fitted" 2 "Deployable RSE Screen Type 1 Fitted" 7 "Error" ;
VAL_ 1024 CcfEcoDrivingCoachVar 0 "Not Supported" 1 "Not Fitted" 2 "ON/OFF Setting" 3 "EDC Comfort mode enable" 15 "Error" ;
VAL_ 1024 CcfEVInletLidSecure 0 "Not supported" 1 "Not Fitted" 2 "Fitted" 3 "Error" ;
VAL_ 1024 CcfFirstRowFridge 0 "Not Supported" 1 "Not Fitted" 2 "Hard wired" 3 "LIN control single function fridge" 4 "LIN control multi function fridge" 7 "Error" ;
VAL_ 1024 CcfFogLampLocation 0 "Not Supported" 1 "Outer Lamp Module" 2 "Inner Lamp Module" 3 "Bumper Lamp Module" 4 "Outer and Inner Lamp Moduie" 5 "Outer and Bumper Lamp Module" 6 "Inner and Bumper Lamp Modules" 7 "Outer Inner and Bumper Lamp Modules" 15 "Error" ;
VAL_ 1024 CcfFrntLoadSpaceLight 0 "Not supported" 1 "Not Fitted" 2 "Fitted" 3 "Error" ;
VAL_ 1024 CcfPersonalisationStorage 0 "Not Supported" 1 "Not Fitted" 2 "Infotainment" 3 "Vehicle Domain Controller" 7 "Error" ;
VAL_ 1024 CcfPwrSideDrBrakePedalClose 0 "Not Supported" 1 "Not Fitted" 2 "Fitted - Driver Door Only" 3 "Fitted - Front Doors Only" 4 "Fitted All Side Doors" 5 "Fitted All Apertures" 7 "Error" ;
VAL_ 1024 CcfRevLampLocation 0 "Not Supported" 1 "Outer Lamp Module" 2 "Inner Lamp Module" 3 "Bumper Lamp Module" 4 "Outer and Inner Lamp Moduie" 5 "Outer and Bumper Lamp Module" 6 "Inner and Bumper Lamp Modules" 7 "Outer Inner and Bumper Lamp Modules" 15 "Error" ;
VAL_ 1024 CcfRrClimateAutoSigs 0 "Not Supported" 1 "Use legacy strategy for Rear Climate Auto status" 2 "Use consolidated strategy for Rear Climate Auto status" 3 "Error" ;
VAL_ 1024 CcfRrDILampLocation 0 "Not Supported" 1 "Outer Lamp Module" 2 "Inner Lamp Module" 3 "Bumper Lamp Module" 4 "Outer and Inner Lamp Moduie" 5 "Outer and Bumper Lamp Module" 6 "Inner and Bumper Lamp Modules" 7 "Outer Inner and Bumper Lamp Modules" 15 "Error" ;
VAL_ 1024 CcfRrPosLampLocation 0 "Not Supported" 1 "Outer Lamp Module" 2 "Inner Lamp Module" 3 "Bumper Lamp Module" 4 "Outer and Inner Lamp Moduie" 5 "Outer and Bumper Lamp Module" 6 "Inner and Bumper Lamp Modules" 7 "Outer Inner and Bumper Lamp Modules" 15 "Error" ;
VAL_ 1024 CcfRrSideDrTwoStgRel 0 "Not Supported" 1 "Not Fitted" 2 "1 Stage door unlock and release" 3 "2 Stages door unlock and release" 7 "Error" ;
VAL_ 1024 CcfStopLampLocation 0 "Not Supported" 1 "Outer Lamp Module" 2 "Inner Lamp Module" 3 "Bumper Lamp Module" 4 "Outer and Inner Lamp Moduie" 5 "Outer and Bumper Lamp Module" 6 "Inner and Bumper Lamp Modules" 7 "Outer Inner and Bumper Lamp Modules" 15 "Error" ;
VAL_ 1024 CcfTRDriAdvAirSusRcmndRse 0 "Not Supported" 1 "No Recommend Raising Air Sus Messages" 2 "Recommend Raising Air Sus in Mud Only" 3 "Recommend Raising Air Sus in AutoTR Only" 4 "Recommend Raising Air Sus in Mud and AutoTR" 7 "Error" ;
VAL_ 1024 CcfASDProgMode 0 "Not Supported" 1 "Not available for selection" 2 "Available for selection without timeout" 3 "Available for selection with timeout" 7 "Error" ;
VAL_ 1024 CcfAutoBlrIntenstySet 0 "Not Supported" 1 "Auto Blower Intensity not displayed in Climate menu settings" 2 "Auto Blower Intensity displayed in Climate menu settings" 3 "Error" ;
VAL_ 1024 CcfBrakeSystemTypeCRB 0 "Not supported" 1 "Not Fitted" 2 "Fitted" 3 "Error" ;
VAL_ 1024 CcfClimateHMIControlStrategy 0 "Not Supported" 1 "HMI logic controlled by Display Control Units" 2 "HMI logic controlled by HVAC ECU" 7 "Error" ;
VAL_ 1024 CcfDADLSpeedOptions 0 "Not Supported" 1 "Variable speed 0/5/10/20mph (0=off)" 2 "Variable speed 5/10/20mph" 7 "Error" ;
VAL_ 1024 CcfEVInletLidPosition 0 "Not Supported" 1 "Not Fitted" 2 "Position Sensor Type 1- LPP Sensor, position sense fitted, sensor included in locking push push unit" 7 "Error" ;
VAL_ 1024 CcfEVInletLidType 0 "Not Supported" 1 "Not Fitted" 2 "Manual" 3 "Powered closed" 4 "Powered Bidirectional" 7 "Error" ;
VAL_ 1024 CcfEVInletUnlockType 0 "Not Supported" 1 "Not Fitted" 2 "Trigger type 1 - Vehicle unlock from key" 3 "Trigger Type 2 - Single button in bowl" 4 "Trigger Type 3 - Module in bowl with backlit switch" 5 "Trigger Type 4 - Module in bowl connected to BMCM with task/status lighting" 7 "Error" ;
VAL_ 1024 CcfGearboxFltWarStrat 0 "Not Supported" 1 "'Gearbox Fault' warning message Disabled" 2 "'Gearbox Fault' warning message Enabled" 3 "Error" ;
VAL_ 1024 CcfGSMSOption 0 "Not Supported" 1 "Gear Shift Module without S option" 2 "Gear Shift Module with S option" 3 "Error" ;
VAL_ 1024 CcfHealthWellnessActiv 0 "Not Supported" 1 "Not Fitted" 2 "Variant A : Audio guided exercises (Physical/Mindfulness)" 3 "Variant B : Audio guided exercises (Physical/Mindfulness) + Bio feedback games" 7 "Error" ;
VAL_ 1024 CcfINCARTempSensorTyp 0 "Not Supported" 1 "Not Fitted" 2 "Fitted with Aspirated Incar Sensor" 3 "Fitted with Non Aspirated ITOS Sensor" 7 "Error" ;
VAL_ 1024 CcfIPMAWSVarCal 0 "Not Supported" 1 "Calibration 1: Standard windscreen glass" 2 "Calibration 2: Standard windscreen glass heated" 3 "Calibration 3: Standard windscreen glass with HUD" 4 "Calibration 4: Standard windscreen glass heated with HUD" 5 "Calibration 5: IRA Protected windscreen with HUD" 6 "Calibration 6: IRA Protected windscreen heated with HUD" 7 "Calibration 7: IRA Protected windscreen" 8 "Calibration 8: IRA Protected windscreen heated" 9 "Calibration 9: IRR protected windscreen glass" 10 "Calibration 10: IRR protected windscreen glass heated" 11 "Calibration 11: IRR Protected windscreen glass with HUD" 12 "Calibration 12: IRR Protected windscreen glass heated with HUD" 62 "No Calibration: Not fitted" 63 "Error" ;
VAL_ 1024 CcfMLASoftSwitches 0 "Not supported" 1 "Not Fitted" 2 "Fitted" 3 "Error" ;
VAL_ 1024 CcfPredictvEnrgyOptm 0 "Not Supported" 1 "Use Legacy logic for Predictive Energy Optimisation" 2 "Predictive Energy Optimisation (Variant A)" 3 "Predictive Energy Optimisation - Geofencing Low Emission zones, Auto Commute Start and HMI enhancement (Variant B)" 4 "Predictive Energy Optimisation - Geofencing Low Emission zones, Auto Commute Start, EV Mode switching  and HMI enhancement (Variant C)" 14 "Not Fitted" 15 "Error" ;
VAL_ 1024 CcfSeatbuckleLED 0 "Not Supported" 1 "Not Fitted" 2 "Illuminated Seat Buckle LED Fitted" 3 "Error" ;
VAL_ 1024 CcfSpeechSesDuckBehav 0 "Not Supported" 1 "Fully Duck" 2 "Partially Duck" 3 "Error" ;
VAL_ 1024 CcfTemperatureUnits 0 "Not Supported" 1 "Not Fiited" 2 "Degrees C" 3 "Degrees F" 7 "Error" ;
VAL_ 1024 CcfTRClusterRibbonDir 0 "Not Supported" 1 "No Ribbon" 2 "Bottom to Top (Vertical)" 3 "Top to Bottom (Vertical)" 4 "Left to Right (Horizontal)" 5 "Right to Left (Horizontal)" 7 "Error" ;
VAL_ 1024 CcfUsrEEBReserveMgmt 0 "Not supported" 1 "Not Fitted" 2 "Fitted" 3 "Error" ;
VAL_ 1024 CcfBrakeDuctType 0 "Not Supported" 1 "Not Fitted" 2 "Active Vanes" 3 "Permanently Closed Ducts" 4 "Permanently Open Ducts" 7 "Error" ;
VAL_ 1024 CcfCabinCleaning 0 "Not supported" 1 "Not Fitted" 2 "Var A Fitted--Off-Board On Demand activation only" 3 "Var B Fitted--Off-Board On Demand activation + Scheduled activation both On And Off Board" 7 "Error" ;
VAL_ 1024 CcfCamVideoResolution 0 "Not supported" 1 "1574 x 590" 2 "1620 x 690" 255 "Error" ;
VAL_ 1024 CcfHapticSeatPowertrain 0 "Not Supported" 1 "Not Fitted" 2 "Fitted 2 Seat" 3 "Fitted 4 Seat" 31 "Error" ;
VAL_ 1024 CcfHapticSeatsAudio 0 "Not Supported" 1 "Not Fitted" 2 "Fitted 2 Seat (Haptic seat Fitted Row 1)" 3 "Fitted 4 Seat (Haptic seat Fitted Row 1 & Row 2)" 4 "Haptic seat Fitted Row 1 w/Foot Relaxation Front Only" 5 "Haptic seat Fitted Row 1 and Row 2 w/Foot Relaxation Front Only" 6 "Haptic seat Fitted Row 1 and Row 2 w/Foot Relaxation Front & Rear" 31 "Error" ;
VAL_ 1024 CcfInfoEmerChargePnC 0 "Not Supported" 1 "Plug n Charge not fitted" 2 "Plug n Charge fitted" 3 "Error" ;
VAL_ 1024 CcfInfotainEmerParm20 0 "Not Supported" 1 "Not Fitted" 2 "Fitted" 3 "Error" ;
VAL_ 1024 CcfInfotainEmerParm21 0 "Not Supported" 1 "Not Fitted" 2 "Fitted" 3 "Error" ;
VAL_ 1024 CcfMILActtDrivingCycl 0 "Not Supported" 1 "MIL lamp activation at 1st  trip" 2 "MIL lamp activation at 2nd  trip" 3 "MIL lamp activation at 3rd  trip" 5 "MIL lamp activation at 2nd  trip or NO MIL lamp activation for specific modules" 6 "MIL lamp activation at 3rd  trip or NO MIL lamp activation for specific modules" 7 "Error" ;
VAL_ 1024 CcfOffRoadRideHeight 0 "Not supported" 1 "Use standard Off-Road height settings" 2 "Use Hong Kong Off-Road height settings" 6 "Coil Suspension" 7 "Error" ;
VAL_ 1024 CcfPwrDoorCrankOp 0 "Not Supported" 1 "Enabled (Power Door operation IS allowed during crank)" 2 "Disabled (Power Door operation is NOT allowed during crank)" 3 "Error" ;
VAL_ 1024 CcfRainSensorType 0 "Not Supported" 1 "Not Fitted" 2 "Fitted with integrated Solar sensing" 3 "Fitted without integrated Solar sensing" 7 "Error" ;
VAL_ 1024 CcfRefrigerantLoop 0 "Not Supported" 1 "No EV HFMS" 2 "Solenoid front shutoff, LIN expansion valve, LIN inline expansion valve, internal energy priority" 3 "LIN front shutoff, LIN expansion valve, LIN inline expansion valve, internal energy priority" 4 "LIN front shutoff, LIN inline expansion valve, LIN L-Shut off Valve, LIN T-Shut off Valve, external energy priority" 5 "LIN front shutoff, LIN inline expansion valve, external energy priority" 6 "LIN 3-way-Multi-way Shut off Valve, LIN 3-way-Multi-way Shut off Valve, external energy priority" 7 "LIN SOV3EX, LIN EXVRD, LIN EXVCB, LIN LP valve, SOV1RD, SOV2RD" 8 "LIN inline expansion valve, Chiller SOV" 9 "FrontAC SOV S-TXV, Chiller SOV S-TXV" 10 "FrontAC_SOV_S-TXV, LIN_EXV#1_EXVCP" 15 "Error" ;
VAL_ 1024 CcfSmartProgramWiping 0 "Not Supported" 1 "100ms washing permitted prior programmed wash wiping" 2 "200ms washing permitted prior programmed wash wiping" 3 "300ms washing permitted prior programmed wash wiping" 4 "400ms washing permitted prior programmed wash wiping" 5 "500ms washing permitted prior programmed wash wiping" 6 "SmartProgramWiping Disabled" 7 "Error" ;
VAL_ 1024 CcfSVDynamicMode 0 "Not Supported" 1 "Not available for selection" 2 "Available for selection without timeout" 3 "Available for selection with timeout" 7 "Error" ;
VAL_ 1024 CcfVibroAcousticTherapy 0 "Not Supported" 1 "Not Fitted" 2 "Fitted 2 Seat (Haptic seat Fitted Row 1)" 3 "Fitted 4 Seat (Haptic seat Fitted Row 1 & Row 2)" 4 "Haptic seat Fitted Row 1 w/Foot Relaxation Front Only" 5 "Haptic seat Fitted Row 1 and Row 2 w/Foot Relaxation Front Only" 6 "Haptic seat Fitted Row 1 and Row 2 w/Foot Relaxation Front & Rear" 31 "Error" ;
VAL_ 1024 CcfAlcoholIntLKDevice 0 "Not Supported" 1 "Not Fitted" 2 "Fitted" 3 "Error" ;
VAL_ 1024 CcfCabinCleanCyclTime 0 "Not Supported" 254 "Not Fitted" 255 "Error" ;
VAL_ 1024 CcfCornerSpeedAdapt 0 "Not Supported" 1 "Not Fitted" 2 "Fitted" 3 "Error" ;
VAL_ 1024 CcfEnhFiltrationAQI 0 "Not Supported" 1 "Not fitted" 2 "AQI Button Fitted" 3 "Not in use" 15 "Error" ;
VAL_ 1024 CcfHapticPwrTrnCalNo 0 "Not Supported" 1 "Not Fitted" 2 "Calibration 1" 3 "Calibration 2" 4 "Calibration 3" 5 "Calibration 4" 6 "Calibration 5" 7 "Calibration 6" 8 "Calibration 7" 9 "Calibration 8" 10 "Calibration 9" 11 "Calibration 10" 12 "Calibration 11" 13 "Calibration 12" 14 "Calibration 13" 15 "Calibration 14" 16 "Calibration 15" 17 "Calibration 16" 18 "Calibration 17" 19 "Calibration 18" 20 "Calibration 19" 21 "Calibration 20" 22 "Cal Number Not Applicable" 255 "Error" ;
VAL_ 1024 CcfInfotainEmerParm22 0 "Not Supported" 1 "Not fitted" 2 "Type A" 3 "Type B" 15 "Error" ;
VAL_ 1024 CcfInfotainEmerParm23 0 "Not Supported" 1 "Not Fitted" 2 "Type A" 3 "Type B" 4 "Type C" 5 "Type D" 6 "Type E" 7 "Type F" 8 "Type G" 9 "Type H" 10 "Type J" 11 "Type K" 12 "Type L" 13 "Type M" 14 "Type N" 254 "Type ZZ" 255 "Error" ;
VAL_ 1024 CcfInfotainEmerParm24 0 "Not Supported" 1 "Not Fitted" 2 "Type A" 3 "Type B" 4 "Type C" 5 "Type D" 6 "Type E" 7 "Type F" 8 "Type G" 9 "Type H" 10 "Type J" 11 "Type K" 12 "Type L" 13 "Type M" 14 "Type N" 254 "Type ZZ" 255 "Error" ;
VAL_ 1024 CcfRefrigerantSnsHVAC 0 "Not Supported" 1 "Not fitted and legacy vehicles Hybrid Type indicator" 2 "ICE, 1x evaporator fin temperature sensor, 1x H/P refrigerant liquid discharge pressure sensor" 3 "EV, 1x evaporator fin temperature sensor, 1x H/P refrigerant gas discharge pressure sensor, 1x L/P battery cooler P+T sensor" 4 "EV, 1x evaporator fin temperature sensor, 1x eDrive temperature sensor, 1x H/P refrigerant gas discharge P+T sensor, 1x L/P battery cooler P+T sensor" 5 "EV, 1x evaporator fin temperature sensor, 1x H/P refrigerant gas discharge P+T sensor, 1x L/P battery cooler P+T sensor" 6 "EV, 1x evaporator fin temperature sensor, 1x H/P refrigerant gas discharge P+T sensor, 1x L/P battery cooler P+T sensor, 1x L/P front evaporator P+T sensor" 7 "EV, 1x evaporator fin temperature sensor, 1x H/P refrigerant gas discharge pressure sensor, 1x L/P Suction P+T sensor" 8 "LIN PressTempHiPress, LIN PressTempLoPress, ChillerTempSns" 9 "FrontEvaporator_Temperature, LIN_HighPressureSide and Pressure and Temperature, LIN_LowPressureSide and Pressure and Temperature" 10 "FrontEvaporator_Temperature, LIN_HighPressureSide and Pressure and Temperature, LIN_LowPressureSide and Pressure and Temperature,LIN_HighPressureSide and Pressure and Temperature#2" 15 "Error" ;
VAL_ 1024 CcfSidebarControls 0 "Not Supported" 1 "Legacy" 2 "Sidebar Controls with DSC + VC Drawer AND VC Bar on 4x4i" 15 "Error" ;
VAL_ 1024 CcfSpeedLimitAdapt 0 "Not Supported" 1 "Not Fitted" 2 "Fitted" 3 "Error" ;
VAL_ 1024 CcfAEBMenu 0 "Not Supported" 1 "Not Fitted" 2 "Pre-GSR2 AEB Menu Fitted" 3 "GSR2 AEB Menu Fitted" 7 "Error" ;
VAL_ 1024 CcfDriverCondMonMenu 0 "Not Supported" 1 "Not Fitted" 2 "Driver fatigue and rest areas Pre-GSR2 Settings Fitted" 3 "Driver condition monitoring GSR2 Settings Fitted" 4 "Driver condition monitoring Fatigue Settings Fitted" 7 "Error" ;
VAL_ 1024 CcfDrvModeSwitchMsg 0 "Not Supported" 1 "No Driver Mode Messages Display" 2 "Driver Mode Messages Display" 3 "Error" ;
VAL_ 1024 CcfeTSRFaultInd 0 "Not supported" 1 "Disabled" 2 "Enabled" 7 "Error" ;
VAL_ 1024 CcfFLCHeating 0 "Not Supported" 1 "FLC heating not fitted" 2 "FLC heating fitted" 3 "Error" ;
VAL_ 1024 CcfHDCButtonType 0 "Not supported" 1 "Not Fitted" 2 "Hard Button Fitted" 3 "Soft Button Fitted" 7 "Error" ;
VAL_ 1024 CcfHibernatedNav 0 "Not Supported" 1 "Hibernated Navigation Not Fitted" 2 "Hibernated Navigation Fitted" 3 "Error" ;
VAL_ 1024 CcfIVILoRngSwitchFit 0 "Not Supported" 1 "IVI Low Range Button Not Fitted" 2 "IVI Low Range Button Fitted" 3 "Error" ;
VAL_ 1024 CcfLaneAssistMenu 0 "Not Supported" 1 "Not Fitted" 2 "Lane Assistance Menu Fitted" 3 "Error" ;
VAL_ 1024 CcfNewSpdLimAudioAlrt 0 "Not Supported" 1 "Not Fitted" 2 "Speed Limit Change Audio Alert Menu Fitted" 7 "Error" ;
VAL_ 1024 CcfOverSpdLimWarnSel 0 "Not Supported" 1 "Not Fitted" 2 "Over Speed Limit Warning Selection Menu Fitted" 7 "Error" ;
VAL_ 1024 CcfReCircSoftBtn 0 "Not Supported" 1 "Not Fitted" 2 "Soft Button Fitted with timed logic" 3 "Soft Button Fitted with latched logic" 4 "Soft Button Fitted with timed and latched logic" 7 "Error" ;
VAL_ 1024 CcfSideBarClimate 0 "Not Supported" 1 "Climate Icon on Side Bar Not Available" 2 "Climate Icon on Side Bar Available - FICP Replacement" 31 "Error" ;
VAL_ 1024 CcfStartupLogo 0 "Not Supported" 1 "Mainstream Brand-based" 2 "Black Edition" 3 "SV Halo" 4 "SV Vehicle Personalisation Bespoke" 5 "First Edition" 63 "Error" ;
VAL_ 1024 CcfSVShiftLightHysteresis 0 "Not Supported" 1 "Not Fitted" 31 "Error" ;
VAL_ 1024 CcfTSRSpdLimDispConv 0 "Not Supported" 1 "TSR Speed Limit Display Convention 1 - Vienna [RoW]" 2 "TSR Speed Limit Display Convention 2 - US" 3 "TSR Speed Limit Display Convention 3 - Canada" 7 "Error" ;
VAL_ 1024 CcfVehicleClassific 0 "Not Supported" 1 "Commercial Vehicle" 2 "Non-Commercial Vehicle" 3 "Error" ;
VAL_ 1024 CcfVolumeSoftKeys 0 "Not Supported" 1 "Not Fitted" 2 "Audio Volume Soft Keys pattern 1" 7 "Error" ;
VAL_ 1024 CcfACOnOffSoftBtn 0 "Not Supported" 1 "Not Fitted" 2 "Soft Button Fitted" 3 "Error" ;
VAL_ 1024 CcfAEBFaultInd 0 "Not supported" 1 "Disabled" 2 "Enabled" 3 "Error" ;
VAL_ 1024 CcfAirSUISignalSet 0 "Not supported" 1 "Use legacy AIR_ControlStatus and AIR_SuspensionMode signals, or coil suspension is fitted" 2 "Use AirSUIDispHgtModSym and AirSUIDispHgtChgeSym signals" 3 "Error" ;
VAL_ 1024 CcfAutoClimateSoftBtn 0 "Not Supported" 1 "Front AUTO Climate Soft Button Not Fitted" 2 "Front AUTO Climate Soft Button Fitted" 3 "Error" ;
VAL_ 1024 CcfChildLckdInCarMiti 0 "Not Supported" 1 "Not Fitted" 2 "Fitted MOCLIC Variant A Basic Occupant Detection for US" 3 "Fitted MOCLIC Variant A Basic Occupant Detection for Non-US" 4 "Fitted MOCLIC Variant B Advanced Occupant Classification for US" 5 "Fitted MOCLIC Variant B Advanced Occupant Classification for Non-US" 7 "Error" ;
VAL_ 1024 CcfCTRAirSusPartc 0 "Not Supported" 1 "Not Participating in Mode Management" 2 "Participating in Mode Management" 3 "Error" ;
VAL_ 1024 CcfDCMFaultInd 0 "Not supported" 1 "Disabled" 2 "Enabled" 3 "Error" ;
VAL_ 1024 CcfFrntHtdScrnSoftBtn 0 "Not Supported" 1 "Not Fitted" 2 "Soft Button Fitted" 3 "Error" ;
VAL_ 1024 CcfFrontConnectSocket 0 "Not Supported" 1 "Not Fitted" 2 "Low Line Fitted (Dual USB only)" 3 "High Line Fitted (Dual USB with H2H, and HDMI)" 4 "High Line Fitted with SIM (Dual USB with H2H, HDMI, and SIM)" 5 "Mid Line Fitted (Dual USB with H2H only)" 6 "Mid Line Fitted with SIM (Dual USB with H2H, and SIM)" 7 "Mid Line Fitted (Single USB with H2H only)" 31 "Error" ;
VAL_ 1024 CcfIFMVoltThreshold 0 "Not Supported" 1 "12.5V" 2 "12.6V" 3 "12.7V" 4 "12.8V" 5 "12.9V" 6 "13.0V" 7 "13.1V" 8 "13.2V" 9 "13.3V" 10 "13.4V" 11 "13.5V" 15 "Error" ;
VAL_ 1024 CcfInfotainEmerParm29 0 "Not Supported" 1 "Not Fitted" 2 "Type A" 3 "Type B" 4 "Type C" 5 "Type D" 6 "Type E" 7 "Type F" 8 "Type G" 9 "Type H" 10 "Type J" 11 "Type K" 12 "Type L" 13 "Type M" 14 "Type N" 15 "Error" ;
VAL_ 1024 CcfInfotainEmerParm30 0 "Not Supported" 1 "Not Fitted" 2 "Type A" 3 "Type B" 4 "Type C" 5 "Type D" 6 "Type E" 7 "Type F" 8 "Type G" 9 "Type H" 10 "Type J" 11 "Type K" 12 "Type L" 13 "Type M" 14 "Type N" 15 "Error" ;
VAL_ 1024 CcfInstClusterLayMenu 0 "Not Supported" 1 "Disabled" 2 "Enabled" 3 "Error" ;
VAL_ 1024 CcfLaneAssistEmrgMenu 0 "Not supported" 1 "Not Fitted" 2 "Lane Assistance Emergency Menu Fitted" 3 "Legacy" 7 "Error" ;
VAL_ 1024 CcfLSSFaultInd 0 "Not supported" 1 "Disabled" 2 "Enabled" 3 "Error" ;
VAL_ 1024 CcfMaxACSoftBtn 0 "Not Supported" 1 "Not Fitted" 2 "Soft Button Fitted" 3 "Error" ;
VAL_ 1024 CcfMaxDefrostSoftBtn 0 "Not Supported" 1 "Not Fitted" 2 "Soft Button Fitted" 3 "Error" ;
VAL_ 1024 CcfRearHtdScrnSoftBtn 0 "Not Supported" 1 "Not Fitted" 2 "Soft Button Fitted" 3 "Error" ;
VAL_ 1024 CcfRemClimIndication 0 "Not Supported" 1 "Remote climate indication on the ICP control panel" 2 "Remote climate indication on cluster" 7 "Error" ;
VAL_ 1024 CcfSlopeInfoMode 0 "Not supported" 1 "Use legacy signals PitchAngle and RollAngle, or Slope Information is not fitted" 2 "Use GlobalVehPitchAngle and GlobalVehRollAngle signals" 3 "Error" ;
VAL_ 1024 CcfSVDynModeRideHght 0 "Not Supported" 1 "Disabled" 2 "Enabled" 3 "Error" ;
VAL_ 1024 CcfSVRoofLoadAdvice 0 "Not Supported" 1 "Disabled" 2 "Enabled" 3 "Error" ;
VAL_ 1024 CcfAdasDrvFatigue 0 "Not Supported" 1 "Not Fitted" 2 "Fitted" 3 "Error" ;
VAL_ 1024 CcfAdasDrvFatigueMenu 0 "Not Supported" 1 "Not Fitted" 2 "Fitted" 3 "Error" ;
VAL_ 1024 CcfAdasDrvMon 0 "Not Supported" 1 "Not Fitted" 2 "Fitted" 3 "Error" ;
VAL_ 1024 CcfAndroidPluginBox 0 "Not Supported" 1 "Not Fitted" 2 "Standard Fitted" 7 "Error" ;
VAL_ 1024 CcfCabFragBoostSftBtn 0 "Not supported" 1 "Not Fitted" 2 "Soft Button Fitted" 3 "Error" ;
VAL_ 1024 CcfCabFragCartridges 0 "Not supported" 1 "No Cartridges Fitted" 2 "1 Cartridge Fitted" 3 "2 Cartridge Fitted" 4 "3 Cartridge Fitted" 7 "Error" ;
VAL_ 1024 CcfCabFragLockSftBtn 0 "Not supported" 1 "Not Fitted" 2 "Soft Button Fitted" 3 "Error" ;
VAL_ 1024 CcfCabFragPwrSftBtn 0 "Not supported" 1 "Not Fitted" 2 "Soft Button Fitted" 3 "Error" ;
VAL_ 1024 CcfCabFragTraySoftBtn 0 "Not supported" 1 "Not Fitted" 2 "Soft Button Fitted" 3 "Error" ;
VAL_ 1024 CcfFragranceDiffuser 0 "Not Supported" 1 "Not Fitted" 2 "Fitted" 3 "Error" ;
VAL_ 1024 CcfFrtWinOneShotUpDn 0 "Not supported" 1 "Enabled Up Down" 2 "Disabled Up Down" 3 "Down Only" 4 "Up Only" 14 "Not fitted" 15 "Error" ;
VAL_ 1024 CcfLeftChargingInlet 0 "Not Supported" 1 "Not Fitted" 2 "AC Type 1 without power flap" 3 "AC Type 2 without power flap" 4 "AC GBT without power flap" 5 "AC+DC Type 1 Combo without power flap" 6 "AC+DC Type 2 Combo without power flap" 7 "DC GBT without power flap" 8 "DC Chademo without power flap" 9 "DC Chaoji without power flap" 10 "DC Chaoji + AC Type 1 without power flap" 11 "DC Chaoji + AC GBT without power flap" 12 "DC GBT + AC GBT without power flap" 13 "DC Chademo + AC Type 1 without power flap" 14 "NACS AC & DC without power flap" 15 "NACS DC without power flap" 16 "Fuel Filler without power flap" 130 "AC Type 1 with power flap" 131 "AC Type 2 with power flap" 132 "AC GBT with power flap" 133 "AC+DC Type 1 Combo with power flap" 134 "AC+DC Type 2 Combo with power flap" 135 "DC GBT with power flap" 136 "DC Chademo with power flap" 137 "DC Chaoji with power flap" 138 "DC Chaoji + AC Type 1 with power flap" 139 "DC Chaoji + AC GBT with power flap" 140 "DC GBT + AC GBT with power flap" 141 "DC Chademo + AC Type 1 with power flap" 142 "NACS AC & DC" 143 "NACS DC" 144 "Fuel Filler with power flap" 255 "Error" ;
VAL_ 1024 CcfRemClimInhibStrat 0 "Not Supported" 1 "Not Fitted" 2 "No Inhibit logic in HVAC and PIVI with Legacy Implementation" 3 "Inhibit logic available in HVAC" 7 "Error" ;
VAL_ 1024 CcfRightChargingInlet 0 "Not Supported" 1 "Not Fitted" 2 "AC Type 1 without power flap" 3 "AC Type 2 without power flap" 4 "AC GBT without power flap" 5 "AC+DC Type 1 Combo without power flap" 6 "AC+DC Type 2 Combo without power flap" 7 "DC GBT without power flap" 8 "DC Chademo without power flap" 9 "DC Chaoji without power flap" 10 "DC Chaoji + AC Type 1 without power flap" 11 "DC Chaoji + AC GBT without power flap" 12 "DC GBT + AC GBT without power flap" 13 "DC Chademo + AC Type 1 without power flap" 14 "NACS AC & DC without power flap" 15 "NACS DC without power flap" 16 "Fuel Filler without power flap" 130 "AC Type 1 with power flap" 131 "AC Type 2 with power flap" 132 "AC GBT with power flap" 133 "AC+DC Type 1 Combo with power flap" 134 "AC+DC Type 2 Combo with power flap" 135 "DC GBT with power flap" 136 "DC Chademo with power flap" 137 "DC Chaoji with power flap" 138 "DC Chaoji + AC Type 1 with power flap" 139 "DC Chaoji + AC GBT with power flap" 140 "DC GBT + AC GBT with power flap" 141 "DC Chademo + AC Type 1 with power flap" 142 "NACS AC & DC" 143 "NACS DC" 144 "Fuel Filler with power flap" 255 "Error" ;
VAL_ 1024 CcfRrWinOneShotUpDn 0 "Not supported" 1 "Enabled Up Down" 2 "Disabled Up Down" 3 "Down Only" 4 "Up Only" 14 "Not fitted" 15 "Error" ;
VAL_ 1024 CcfRSEMediaStreaming 0 "Not Supported" 1 "Not fitted" 2 "Fitted - China" 3 "Fitted - Region 1" 4 "Fitted - Region 2" 15 "Error" ;
VAL_ 1024 CcfTerSDSelectInFCPB 0 "Not supported" 1 "Control interface not available in FCPB" 2 "Available as single purpose button" 3 "Selectable within rotary" 4 "Available as shared purpose button" 5 "Rotary used for selection within touch screen" 7 "Error" ;
VAL_ 1024 CcfAdasDrvMonMenu 0 "Not Supported" 1 "Not Fitted" 2 "Fitted" 3 "Error" ;
VAL_ 1024 CcfAdasRmm 0 "Not Supported" 1 "Not Fitted" 2 "Fitted" 3 "Error" ;
VAL_ 1024 CcfAQSSoftButton 0 "Not Supported" 1 "Not Fitted" 2 "Soft Button Fitted" 3 "Error" ;
VAL_ 1024 CcfCabFragBoostTime 0 "Not supported" 1 "5 Second" 2 "10 Seconds" 3 "15 Seconds" 4 "20 Seconds" 5 "25 Seconds" 6 "30 Seconds" 7 "35 Seconds" 8 "40 Seconds" 9 "45 Seconds" 10 "50 Seconds" 11 "55 Seconds" 12 "60 Seconds" 13 "65 Seconds" 14 "70 Seconds" 15 "75 Seconds" 16 "80 Seconds" 17 "85 Seconds" 18 "90 Seconds" 19 "95 Seconds" 20 "100 Seconds" 21 "105 Seconds" 22 "110 Seconds" 23 "115 Seconds" 24 "120 Seconds" 25 "125 Seconds" 26 "130 Seconds" 27 "135 Seconds" 28 "140 Seconds" 29 "145 Seconds" 30 "150 Seconds" 31 "155 Seconds" 32 "160 Seconds" 33 "165 Seconds" 34 "170 Seconds" 35 "175 Seconds" 36 "180 Seconds" 37 "185 Seconds" 38 "190 Seconds" 39 "195 Seconds" 40 "200 Seconds" 41 "205 Seconds" 42 "210 Seconds" 43 "215 Seconds" 44 "220 Seconds" 45 "225 Seconds" 46 "230 Seconds" 47 "235 Seconds" 48 "240 Seconds" 49 "245 Seconds" 50 "250 Seconds" 51 "255 Seconds" 52 "260 Seconds" 53 "265 Seconds" 54 "270 Seconds" 55 "275 Seconds" 56 "280 Seconds" 57 "285 Seconds" 58 "290 Seconds" 59 "295 Seconds" 60 "300 Seconds" 62 "Not Fitted" 63 "Error" ;
VAL_ 1024 CcfCabFragIntnstyHMI 0 "Not supported" 1 "Not Fitted" 2 "1 intensity level supported (OFF & ON)" 3 "3 intensity levels supported (OFF & Low / Med / High)" 4 "100 intensity levels supported (0-100%)" 7 "Error" ;
VAL_ 1024 CcfClimPreconSoftBtn 0 "Not Supported" 1 "Not Fitted" 2 "Soft Button Fitted" 3 "Error" ;
VAL_ 1024 CcfClimRecircSoftBtn 0 "Not Supported" 1 "Not Fitted" 2 "Soft Button Fitted" 3 "Error" ;
VAL_ 1024 CcfCO2SoftButton 0 "Not Supported" 1 "Not Fitted" 2 "Soft Button Fitted" 3 "Error" ;
VAL_ 1024 CcfFrontAutoSoftBtn 0 "Not Supported" 1 "Not Fitted" 2 "Single AUTO Zone Climate Soft Button" 3 "Dual AUTO Zone Climate Soft Button" 7 "Error" ;
VAL_ 1024 CcfFrontClimPwrSftBtn 0 "Not Supported" 1 "Not Fitted" 2 "Soft Button Fitted" 3 "Error" ;
VAL_ 1024 CcfFrontElecVentsCtrl 0 "Not Supported" 1 "Not Fitted" 2 "Fitted" 3 "Error" ;
VAL_ 1024 CcfFstChgPreCon 0 "Not supported" 1 "Not fitted" 2 "Fitted - HV Battery DCFC Precon Standard" 7 "Error" ;
VAL_ 1024 CcfHeatNowSoftBtn 0 "Not Supported" 1 "Not Fitted" 2 "Soft Button Fitted" 3 "Error" ;
VAL_ 1024 CcfIoniserSoftButton 0 "Not Supported" 1 "Not Fitted" 2 "Soft Button Fitted" 3 "Error" ;
VAL_ 1024 CcfRearAutoSoftBtn 0 "Not Supported" 1 "Not Fitted" 2 "Single AUTO Zone Climate Soft Button" 3 "Dual AUTO Zone Climate Soft Button" 7 "Error" ;
VAL_ 1024 CcfRearClimPwrSoftBtn 0 "Not Supported" 1 "Not Fitted" 2 "Soft Button Fitted" 3 "Error" ;
VAL_ 1024 CcfRearComfortLckBtn 0 "Not Supported" 1 "Not Fitted" 2 "Soft Button Fitted" 3 "Error" ;
VAL_ 1024 CcfRearElecVentsCtrl 0 "Not Supported" 1 "Not Fitted" 2 "Fitted" 3 "Error" ;
VAL_ 1024 CcfRow2ChillBlowCtrl 0 "Not Supported" 1 "Not Fitted" 2 "Fitted" 3 "Error" ;
VAL_ 1024 CcfRow3ChillBlowCtrl 0 "Not Supported" 1 "Not Fitted" 2 "Fitted" 3 "Error" ;
VAL_ 1024 CcfRow3ChillerLockBtn 0 "Not Supported" 1 "Not Fitted" 2 "Fitted" 3 "Error" ;
VAL_ 1024 CcfRow3chillerPowrBtn 0 "Not Supported" 1 "Not Fitted" 2 "Fitted" 3 "Error" ;
VAL_ 1024 CcfSyncSoftBtn 0 "Not Supported" 1 "Not Fitted" 2 "Soft Button Fitted" 3 "Error" ;
VAL_ 1024 CcfVentNowSoftBtn 0 "Not Supported" 1 "Not Fitted" 2 "Soft Button Fitted" 3 "Error" ;
VAL_ 1024 CcfACChrgCurrConfig 0 "Not supported" 1 "User selectable AC Charging current is not fitted" 2 "User selectable AC Charging current is fitted " 3 "User selectable AC Charging current with Geofencing fitted" 7 "Error" ;
VAL_ 1024 CcfBattery3Type 0 "Not Supported" 1 "Not Fitted" 2 "H4 Li-ion 40Ah CosMX" 31 "Error" ;
VAL_ 1024 CcfChargingStatusHMI 0 "Not supported" 1 "ChargingStatusHMI not fitted" 2 "Gen1 ChargingStatusHMI" 3 "Gen2 ChargingStatusHMI" 7 "Error" ;
VAL_ 1024 CcfChargingTrblShootr 0 "Not supported" 1 "Charging trouble shooter not fitted" 2 "Charging trouble shooter fitted" 7 "Error" ;
VAL_ 1024 CcfEPDUType 0 "Not Supported" 1 "Not Fitted" 2 "Fitted ADAS L2+ Supported" 3 "Fitted ADAS L3 Supported" 31 "Error" ;
VAL_ 1024 CcfEVAppType 0 "Not supported" 1 "EV App not fitted" 2 "Style1 EV app" 3 "Style2 EV app" 7 "Error" ;
VAL_ 1024 CcfInletLEDConfig 0 "Not supported" 1 "Illumination strategy not fitted" 2 "Configurable" 3 "Illumination ON while charging" 7 "Error" ;
VAL_ 1024 CcfLongLaneChngMrg 0 "Not supported" 1 "Not Fitted" 2 "Fitted - Adapt speed for lane change" 3 "Error" ;
VAL_ 1024 CcfManoeuvreGuidance 0 "Not supported" 1 "Not Fitted" 2 "Manoeuvring Guidance" 3 "Manoeuvring Guidance with Clearance Guidance" 7 "Error" ;
VAL_ 1024 CcfMax3PhaseACPwrLmt 0 "Not supported" 1 "Not fitted" 2 "7kW" 3 "11kW" 4 "22kW" 15 "Error" ;
VAL_ 1024 CcfMaxACCurrLmt 0 "Not supported" 1 "Not fitted" 2 "32A" 3 "40A" 4 "48A" 5 "80A" 6 "64A" 15 "Error" ;
VAL_ 1024 CcfPrdctTimeChrgDisp 0 "Not supported" 1 "Predicted time to charge not fitted" 2 "Basic Predicted time to charge Display" 3 "Advanced Predicted time to charge Display" 7 "Error" ;
VAL_ 1024 CcfTRMCPartc 0 "Not Supported" 1 "Not Fitted" 2 "Fitted" 3 "Error" ;
VAL_ 1024 CcfV1GChrgFeature 0 "Not supported" 1 "V1G not fitted" 2 "V1G fitted" 7 "Error" ;
VAL_ 1024 CcfV2LDisChrgFeature 0 "Not supported" 1 "V2L Not Fitted" 2 "HVPO supported" 3 "V2L Adapter supported" 4 "V2L Adapter and HVPO supported" 15 "Error" ;
VAL_ 1024 CcfWELMSVariant 0 "Not Supported" 1 "Waymo load management strategy active" 2 "Normal Load Management Active" 3 "Error" ;
VAL_ 1024 CcfWiperDisplayTime 0 "Not Supported" 1 "Wiper display 1 second" 2 "Wiper display 2 second(s)" 3 "Wiper display 3 second(s)" 4 "Wiper display 4 second(s)" 5 "Wiper display 5 second(s)" 6 "Wiper display 6 second(s)" 7 "Wiper display 7 second(s)" 15 "Error" ;
VAL_ 1024 CcfAdasDrvDistraction 0 "Not Supported" 1 "Not Fitted" 2 "Fitted" 3 "Error" ;
VAL_ 1024 CcfAdasDrvDstrctnMnu 0 "Not Supported" 1 "Not Fitted" 2 "Fitted" 3 "Error" ;
VAL_ 1024 CcfAdasHazardsControl 0 "Not Supported" 1 "Not Regulated" 2 "NAS Regulated" 7 "Error" ;
VAL_ 1024 CcfAdasHornControl 0 "Not Supported" 1 "Not Regulated" 2 "NAS Regulated" 7 "Error" ;
VAL_ 1024 CcfChargePnC 0 "Not Supported" 1 "Plug n Charge not fitted" 2 "Plug n Charge fitted" 7 "Error" ;
VAL_ 1024 CcfChildLckSoftButton 0 "Not Supported" 1 "Not Fitted" 2 "Child Lock Plus Fitted" 7 "Error" ;
VAL_ 1024 CcfClimAutoDeselect 0 "Not Supported" 1 "Not Fitted" 2 "Auto deselection NOT permitted" 3 "Auto deselection permitted" 7 "Error" ;
VAL_ 1024 CcfClimDistDeselect 0 "Not Supported" 1 "Not Fitted" 2 "Manual distribution deselection NOT permitted" 3 "Manual distribution deselection permitted" 7 "Error" ;
VAL_ 1024 CcfEfficientCabWarmup 0 "Not Supported" 1 "Not Fitted" 2 "Fitted" 7 "Error" ;
VAL_ 1024 CcfHFEfitment 0 "Not Supported" 1 "Not Fitted" 2 "Fitted" 3 "Error" ;
VAL_ 1024 CcfPreCrashSeatMovmnt 0 "Not Supported" 1 "Not Fitted" 2 "Fitted" 3 "Error" ;
VAL_ 1024 CcfRearMemoryFitted 0 "Not Supported" 1 "Not Fitted" 2 "Fitted" 3 "Error" ;
VAL_ 1024 CcfSeatThrmCntrlrRow1 0 "Not Supported" 1 "Seats not thermally controlled" 2 "Seats thermal control via climate controller" 3 "Seats thermal control via seat controller" 15 "Error" ;
VAL_ 1024 CcfSeatThrmCntrlrRow2 0 "Not Supported" 1 "Seats not thermally controlled" 2 "Seats thermal control via climate controller" 3 "Seats thermal control via seat controller" 15 "Error" ;
VAL_ 1024 CcfSeatThrmCntrlrRow3 0 "Not Supported" 1 "Seats not thermally controlled" 2 "Seats thermal control via climate controller" 3 "Seats thermal control via seat controller" 15 "Error" ;
VAL_ 1024 CcfSlimVents 0 "Not Supported" 1 "Not Fitted" 2 "Fitted" 7 "Error" ;
VAL_ 1024 CcfSlimVentsSoftCntrl 0 "Not Supported" 1 "Not Fitted" 2 "Fitted" 3 "Error" ;
VAL_ 1024 CcfSSRDataRecorder 0 "Not Supported" 1 "SSR Not Fitted" 2 "SSR Fitted" 3 "Error" ;
VAL_ 1024 CcfTSDriverMemory 0 "Not Supported" 1 "Not Fitted" 2 "Recall Only" 3 "Store and Recall" 7 "Error" ;
VAL_ 1024 CcfTSPassMemory 0 "Not Supported" 1 "Not Fitted" 2 "Recall Only" 3 "Store and Recall" 7 "Error" ;
