VERSION "PMZ_HSCAN"

NS_ :

BS_:

BU_: BCM_Gp BECM CCF_Server EPICD EPICD_E GWM HVAC PCM SGCM TSTR Virtual_Node

BO_ 1024 VEHCONFIG_400PMZ_AutoSAR: 8 CCF_Server
 SG_ SF_VEHCONFIG_400PMZ_AutoSAR_PDU M : 0|8@1+ (1,0) [0|255] ""  BECM,EPICD_E,HVAC,SGCM
 SG_ CcfTyreCircumference m8 : 23|8@0+ (1,0) [0|255] "" Vector__XXX
 SG_ CcfBrand m9 : 55|8@0+ (1,0) [0|255] "" Vector__XXX
 SG_ CcfFreqRemoteControls m9 : 63|8@0+ (1,0) [0|255] "" Vector__XXX
 SG_ CcfHeatedWindscreen m9 : 23|8@0+ (1,0) [0|255] ""  HVAC
 SG_ CcfHillDescentControl m9 : 39|8@0+ (1,0) [0|255] "" Vector__XXX
 SG_ CcfParkingAssistance m9 : 31|8@0+ (1,0) [0|255] "" Vector__XXX
 SG_ CcfParkingBrakeType m9 : 15|8@0+ (1,0) [0|255] "" Vector__XXX
 SG_ CcfSafetyBeltReminder m9 : 47|8@0+ (1,0) [0|255] "" Vector__XXX
 SG_ CcfBodyStyle m10 : 55|8@0+ (1,0) [0|255] "" Vector__XXX
 SG_ CcfEmissionStandard m10 : 47|8@0+ (1,0) [0|255] "" Vector__XXX
 SG_ CcfGlassType m10 : 23|8@0+ (1,0) [0|255] ""  HVAC
 SG_ CcfOctaneRating m10 : 39|8@0+ (1,0) [0|255] "" Vector__XXX
 SG_ CcfRearAirConditioning m10 : 15|8@0+ (1,0) [0|255] ""  HVAC
 SG_ CcfRoofTyp m10 : 31|8@0+ (1,0) [0|255] "" Vector__XXX
 SG_ CcfTyreDimension m10 : 63|8@0+ (1,0) [0|255] "" Vector__XXX
 SG_ Ccf12VoltOutletLuggage m15 : 23|8@0+ (1,0) [0|255] "" Vector__XXX
 SG_ CcfELVacuumPumpRrBooster m15 : 55|8@0+ (1,0) [0|255] "" Vector__XXX
 SG_ CcfOilLevelSensor m15 : 39|8@0+ (1,0) [0|255] "" Vector__XXX
 SG_ CcfParkAssistCamera m15 : 15|8@0+ (1,0) [0|255] ""  HVAC
 SG_ CcfRollStabilityControl m15 : 47|8@0+ (1,0) [0|255] "" Vector__XXX
 SG_ CcfTyrePressureModeSystem m15 : 31|8@0+ (1,0) [0|255] "" Vector__XXX
 SG_ CcfWheelBrakesTypeRear m15 : 63|8@0+ (1,0) [0|255] "" Vector__XXX
 SG_ CcfAudibleMislockFeedback m21 : 63|8@0+ (1,0) [0|255] "" Vector__XXX
 SG_ CcfAutoRelocking m21 : 47|8@0+ (1,0) [0|255] "" Vector__XXX
 SG_ CcfPowerHeatedMirrors m21 : 39|8@0+ (1,0) [0|255] "" Vector__XXX
 SG_ CcfRearGlazing m21 : 15|8@0+ (1,0) [0|255] ""  HVAC
 SG_ CcfRearWashWipe m21 : 31|8@0+ (1,0) [0|255] "" Vector__XXX
 SG_ CcfRoofHeight m21 : 23|8@0+ (1,0) [0|255] "" Vector__XXX
 SG_ CcfZonalOppositeDoorRelock m21 : 55|8@0+ (1,0) [0|255] "" Vector__XXX
 SG_ CcfAccessoryUSBUnit m22 : 63|8@0+ (1,0) [0|255] "" Vector__XXX
 SG_ CcfAirQualitySensor m22 : 31|8@0+ (1,0) [0|255] ""  HVAC
 SG_ CcfConfigurableUnlocking m22 : 15|8@0+ (1,0) [0|255] "" Vector__XXX
 SG_ CcfEmissionEvaporationSys m22 : 39|8@0+ (1,0) [0|255] "" Vector__XXX
 SG_ CcfExternalAlarmUnitSupply m22 : 55|8@0+ (1,0) [0|255] "" Vector__XXX
 SG_ CcfHeadrestsRearFolding m22 : 47|8@0+ (1,0) [0|255] "" Vector__XXX
 SG_ CcfHomesafeLighting m22 : 23|8@0+ (1,0) [0|255] "" Vector__XXX
 SG_ CcfACCompressorType m23 : 23|8@0+ (1,0) [0|255] ""  HVAC
 SG_ CcfAdaptiveLoadLimiterFnt m23 : 63|8@0+ (1,0) [0|255] "" Vector__XXX
 SG_ CcfBluetoothHandsfree m23 : 31|8@0+ (1,0) [0|255] "" Vector__XXX
 SG_ CcfOccupantWeightSensor m23 : 39|8@0+ (1,0) [0|255] "" Vector__XXX
 SG_ CcfPyroTechSteeringColumn m23 : 55|8@0+ (1,0) [0|255] "" Vector__XXX
 SG_ CcfRearBeltDetection m23 : 47|8@0+ (1,0) [0|255] "" Vector__XXX
 SG_ CcfTrafficInformation m23 : 15|8@0+ (1,0) [0|255] "" Vector__XXX
 SG_ CcfAsthmaAndAllergy m26 : 63|8@0+ (1,0) [0|255] "" Vector__XXX
 SG_ CcfDampSensor m26 : 55|8@0+ (1,0) [0|255] ""  HVAC
 SG_ CcfDoorHandleTechnology m26 : 15|8@0+ (1,0) [0|255] "" Vector__XXX
 SG_ CcfNeutralControlAutoGear m26 : 39|8@0+ (1,0) [0|255] "" Vector__XXX
 SG_ CcfRPMSpeedController m26 : 47|8@0+ (1,0) [0|255] "" Vector__XXX
 SG_ CcfSelfOpeningBootlid m26 : 23|8@0+ (1,0) [0|255] "" Vector__XXX
 SG_ CcfShiftIndication m26 : 31|8@0+ (1,0) [0|255] "" Vector__XXX
 SG_ CcfClimateZoneUserLayout m29 : 15|8@0+ (1,0) [0|255] ""  HVAC
 SG_ CcfEcoInfoSystem m29 : 23|8@0+ (1,0) [0|255] "" Vector__XXX
 SG_ CcfNightVision m29 : 31|8@0+ (1,0) [0|255] "" Vector__XXX
 SG_ CcfReverseGearChime m29 : 47|8@0+ (1,0) [0|255] "" Vector__XXX
 SG_ CcfSolarSensor m29 : 55|8@0+ (1,0) [0|255] ""  HVAC
 SG_ CcfTelematics m29 : 39|8@0+ (1,0) [0|255] "" Vector__XXX
 SG_ CcfTelematicsProtection m29 : 63|8@0+ (1,0) [0|255] "" Vector__XXX
 SG_ CcfAutoSpeedLimiter m32 : 63|8@0+ (1,0) [0|255] "" Vector__XXX
 SG_ CcfHeadUpDisplay m32 : 55|8@0+ (1,0) [0|255] "" Vector__XXX
 SG_ CcfIGORSystemDescription m32 : 15|8@0+ (1,0) [0|255] "" Vector__XXX
 SG_ CcfLanguageRegion m32 : 23|8@0+ (1,0) [0|255] "" Vector__XXX
 SG_ CcfSideCamera m32 : 31|8@0+ (1,0) [0|255] "" Vector__XXX
 SG_ CcfStopStart m32 : 47|8@0+ (1,0) [0|255] ""  HVAC
 SG_ CcfTrailerTyrePressMonSys m32 : 39|8@0+ (1,0) [0|255] "" Vector__XXX
 SG_ Ccf4x4InfoDisplay m33 : 31|8@0+ (1,0) [0|255] "" Vector__XXX
 SG_ CcfAdvancedChauffeurFunc m33 : 15|8@0+ (1,0) [0|255] "" Vector__XXX
 SG_ CcfAudibleAlarmMode m33 : 39|8@0+ (1,0) [0|255] "" Vector__XXX
 SG_ CcfCrashEventDataRec m33 : 55|8@0+ (1,0) [0|255] "" Vector__XXX
 SG_ CcfDoorLatchType m33 : 63|8@0+ (1,0) [0|255] "" Vector__XXX
 SG_ CcfLowSpdIntEmergBrake m33 : 23|8@0+ (1,0) [0|255] "" Vector__XXX
 SG_ CcfModelYear m33 : 47|8@0+ (0.25,2009.75) [2010|2073.25] "MY" Vector__XXX
 SG_ CcfActiveRollControl m34 : 63|8@0+ (1,0) [0|255] "" Vector__XXX
 SG_ CcfAuxillaryWaterPump m34 : 15|8@0+ (1,0) [0|255] ""  HVAC
 SG_ CcfConversationAssist m34 : 31|8@0+ (1,0) [0|255] "" Vector__XXX
 SG_ CcfNavECORouteExtraUrban m34 : 47|8@0+ (1,0) [0|255] "" Vector__XXX
 SG_ CcfNavECORouteUrban m34 : 39|8@0+ (1,0) [0|255] "" Vector__XXX
 SG_ CcfPartNumberFormat m34 : 23|8@0+ (1,0) [0|255] "" Vector__XXX
 SG_ CcfTrsferBxCntrllrType m34 : 55|8@0+ (1,0) [0|255] ""  HVAC
 SG_ CcfCameraHMIStrategy m65 : 10|3@0+ (1,0) [0|7] "" Vector__XXX
 SG_ CcfDeplBatterySystem m65 : 55|2@0+ (1,0) [0|3] "" Vector__XXX
 SG_ CcfDriverBuckleSwitch m65 : 57|2@0+ (1,0) [0|3] "" Vector__XXX
 SG_ CcfDriverKneeAirbag m65 : 37|2@0+ (1,0) [0|3] "" Vector__XXX
 SG_ CcfDriverPassBeltPret m65 : 28|3@0+ (1,0) [0|7] "" Vector__XXX
 SG_ CcfDriverSwtchLdLimit m65 : 63|2@0+ (1,0) [0|3] "" Vector__XXX
 SG_ CcfEventDataRecorder m65 : 61|2@0+ (1,0) [0|3] "" Vector__XXX
 SG_ CcfFntDIFbdkMech m65 : 25|2@0+ (1,0) [0|3] "" Vector__XXX
 SG_ CcfInfotainmentType m65 : 13|3@0+ (1,0) [0|7] "" Vector__XXX
 SG_ CcfLeftCurtainAirbag m65 : 51|2@0+ (1,0) [0|3] "" Vector__XXX
 SG_ CcfLeftRearHeadAbag m65 : 47|2@0+ (1,0) [0|3] "" Vector__XXX
 SG_ CcfLeftSideAirbag m65 : 35|2@0+ (1,0) [0|3] "" Vector__XXX
 SG_ CcfmPACOS m65 : 31|3@0+ (1,0) [0|7] "" Vector__XXX
 SG_ CcfPADLamp m65 : 42|3@0+ (1,0) [0|7] "" Vector__XXX
 SG_ CcfPassBuckleSwitch m65 : 59|2@0+ (1,0) [0|3] "" Vector__XXX
 SG_ CcfPassOccWghtSensor m65 : 39|2@0+ (1,0) [0|3] "" Vector__XXX
 SG_ CcfRightCurtainAirbag m65 : 53|2@0+ (1,0) [0|3] "" Vector__XXX
 SG_ CcfRightRearHeadAbag m65 : 49|2@0+ (1,0) [0|3] "" Vector__XXX
 SG_ CcfRightSideAirbag m65 : 33|2@0+ (1,0) [0|3] "" Vector__XXX
 SG_ CcfRollOverSensing m65 : 45|3@0+ (1,0) [0|7] "" Vector__XXX
 SG_ CcfThirdRowChiller m65 : 15|2@0+ (1,0) [0|3] ""  HVAC
 SG_ CcfTrunkLmpOutput m65 : 23|2@0+ (1,0) [0|3] "" Vector__XXX
 SG_ CcfWindowCalibration m65 : 18|3@0+ (1,0) [0|7] "" Vector__XXX
 SG_ CcfWindowOpFeedback m65 : 21|3@0+ (1,0) [0|7] "" Vector__XXX
 SG_ CcfATPC m68 : 63|8@0+ (1,0) [0|255] ""  HVAC
 SG_ CcfBCMCtrlAmbLitSet m68 : 26|3@0+ (1,0) [0|7] "" Vector__XXX
 SG_ CcfBumperType m68 : 43|4@0+ (1,0) [0|15] "" Vector__XXX
 SG_ CcfDLNAStatus m68 : 51|4@0+ (1,0) [0|15] "" Vector__XXX
 SG_ CcfDriverFrontAirbag m68 : 36|3@0+ (1,0) [0|7] "" Vector__XXX
 SG_ CcfDriverPassRetractor m68 : 29|3@0+ (1,0) [0|7] "" Vector__XXX
 SG_ CcfDRLMLSInteraction m68 : 12|3@0+ (1,0) [0|7] "" Vector__XXX
 SG_ CcfDRLTransInteraction m68 : 15|3@0+ (1,0) [0|7] "" Vector__XXX
 SG_ CcfGracenotes m68 : 55|4@0+ (1,0) [0|15] "" Vector__XXX
 SG_ CcfLowBeamFdbkMech m68 : 18|3@0+ (1,0) [0|7] "" Vector__XXX
 SG_ CcfMainBeamFdbkMech m68 : 21|3@0+ (1,0) [0|7] "" Vector__XXX
 SG_ CcfPassFrontAirbag m68 : 39|3@0+ (1,0) [0|7] "" Vector__XXX
 SG_ CcfPwrTailProxSenPAM m68 : 23|2@0+ (1,0) [0|3] "" Vector__XXX
 SG_ CcfQRBPowerPAM m68 : 33|2@0+ (1,0) [0|3] "" Vector__XXX
 SG_ CcfRemoteStartCapable m68 : 9|2@0+ (1,0) [0|3] "" Vector__XXX
 SG_ CcfStealthMode m68 : 31|2@0+ (1,0) [0|3] "" Vector__XXX
 SG_ CcfTPMSVariant m68 : 47|4@0+ (1,0) [0|15] "" Vector__XXX
 SG_ CcfCHMSLProfile m71 : 13|6@0+ (1,0) [0|63] "" Vector__XXX
 SG_ CcfDrvDrowsyMonDDM m71 : 61|2@0+ (1,0) [0|3] "" Vector__XXX
 SG_ CcfExtSyntheticSounder m71 : 23|2@0+ (1,0) [0|3] "" Vector__XXX
 SG_ CcfFntDIProfile m71 : 45|6@0+ (1,0) [0|63] "" Vector__XXX
 SG_ CcfFntDRLProfile m71 : 21|6@0+ (1,0) [0|63] "" Vector__XXX
 SG_ CcfFntPosProfile m71 : 37|6@0+ (1,0) [0|63] "" Vector__XXX
 SG_ CcfFntSMProfile m71 : 29|6@0+ (1,0) [0|63] "" Vector__XXX
 SG_ CcfFwdCollWarnAEB m71 : 57|2@0+ (1,0) [0|3] "" Vector__XXX
 SG_ CcfIntelEmerBrkingCUIEB m71 : 59|2@0+ (1,0) [0|3] "" Vector__XXX
 SG_ CcfISLFitment m71 : 63|2@0+ (1,0) [0|3] "" Vector__XXX
 SG_ CcfNavBtnFCIM m71 : 15|2@0+ (1,0) [0|3] ""  HVAC
 SG_ CcfNLIAudioAmp m71 : 31|2@0+ (1,0) [0|3] "" Vector__XXX
 SG_ CcfP4UBtnFACP m71 : 47|2@0+ (1,0) [0|3] ""  HVAC
 SG_ CcfPassAirbagVent m71 : 55|2@0+ (1,0) [0|3] "" Vector__XXX
 SG_ CcfPCMEWULine m71 : 50|3@0+ (1,0) [0|7] "" Vector__XXX
 SG_ CcfRowTwoSquabRelAct m71 : 53|3@0+ (1,0) [0|7] "" Vector__XXX
 SG_ CcfTrajectoryLines m71 : 39|2@0+ (1,0) [0|3] "" Vector__XXX
 SG_ CcfCDiffType m72 : 39|4@0+ (1,0) [0|15] "" Vector__XXX
 SG_ CcfChauPersonalisation m72 : 13|2@0+ (1,0) [0|3] "" Vector__XXX
 SG_ CcfConnectInfoStatus m72 : 53|3@0+ (1,0) [0|7] "" Vector__XXX
 SG_ CcfDistribPlayback m72 : 27|2@0+ (1,0) [0|3] "" Vector__XXX
 SG_ CcfEDTType m72 : 47|4@0+ (1,0) [0|15] "" Vector__XXX
 SG_ CcfElecDepTowBar m72 : 57|2@0+ (1,0) [0|3] "" Vector__XXX
 SG_ CcfFntOptDiskDrive m72 : 35|4@0+ (1,0) [0|15] "" Vector__XXX
 SG_ CcfFuelPumpType m72 : 43|4@0+ (1,0) [0|15] "" Vector__XXX
 SG_ CcfGliding m72 : 15|2@0+ (1,0) [0|3] "" Vector__XXX
 SG_ CcfICCFitment m72 : 55|2@0+ (1,0) [0|3] "" Vector__XXX
 SG_ CcfIntStoreIMC m72 : 29|2@0+ (1,0) [0|3] "" Vector__XXX
 SG_ CcfIntStoreISC m72 : 31|2@0+ (1,0) [0|3] "" Vector__XXX
 SG_ CcfLaneKeepAssistLKA m72 : 9|2@0+ (1,0) [0|3] "" Vector__XXX
 SG_ CcfNGINLIDigRadRecSys m72 : 23|8@0+ (1,0) [0|255] "" Vector__XXX
 SG_ CcfNoseLoadMeasure m72 : 61|2@0+ (1,0) [0|3] "" Vector__XXX
 SG_ CcfPDCBtnFCIM m72 : 25|2@0+ (1,0) [0|3] ""  HVAC
 SG_ CcfTCUConnectivity m72 : 50|3@0+ (1,0) [0|7] "" Vector__XXX
 SG_ CcfTrailerLightMod m72 : 59|2@0+ (1,0) [0|3] "" Vector__XXX
 SG_ CcfTRMFitment m72 : 63|2@0+ (1,0) [0|3] "" Vector__XXX
 SG_ CcfAirIonizer m73 : 50|3@0+ (1,0) [0|7] ""  HVAC
 SG_ CcfAutoAccessHeight m73 : 36|2@0+ (1,0) [0|3] "" Vector__XXX
 SG_ CcfCameraBtnFCIM m73 : 27|2@0+ (1,0) [0|3] ""  HVAC
 SG_ CcfClusterAlertGFX m73 : 23|3@0+ (1,0) [0|7] "" Vector__XXX
 SG_ CcfDepSideSteps m73 : 13|2@0+ (1,0) [0|3] "" Vector__XXX
 SG_ CcfDriverDoorLock m73 : 34|3@0+ (1,0) [0|7] "" Vector__XXX
 SG_ CcfDSSOffRoadOperation m73 : 11|2@0+ (1,0) [0|3] "" Vector__XXX
 SG_ CcfDualViewBtnFCIM m73 : 29|2@0+ (1,0) [0|3] ""  HVAC
 SG_ CcfECOmodeText m73 : 41|2@0+ (1,0) [0|3] "" Vector__XXX
 SG_ CcfKeyFobTechnology m73 : 18|3@0+ (1,0) [0|7] "" Vector__XXX
 SG_ CcfPassDoorLock m73 : 39|3@0+ (1,0) [0|7] "" Vector__XXX
 SG_ CcfPedProtectSystem m73 : 25|2@0+ (1,0) [0|3] "" Vector__XXX
 SG_ CcfRearExitDetect m73 : 31|2@0+ (1,0) [0|3] "" Vector__XXX
 SG_ CcfRestrictSunroofOpen m73 : 20|2@0+ (1,0) [0|3] "" Vector__XXX
 SG_ CcfRLPassDoorLock m73 : 44|3@0+ (1,0) [0|7] "" Vector__XXX
 SG_ CcfRRPassDoorLock m73 : 47|3@0+ (1,0) [0|7] "" Vector__XXX
 SG_ CcfSoftCloseDoors m73 : 53|3@0+ (1,0) [0|7] "" Vector__XXX
 SG_ CcfSunGblClTelLock m73 : 61|2@0+ (1,0) [0|3] "" Vector__XXX
 SG_ CcfTelLock m73 : 57|2@0+ (1,0) [0|3] "" Vector__XXX
 SG_ CcfTelUnlock m73 : 63|2@0+ (1,0) [0|3] "" Vector__XXX
 SG_ CcfTrailerLightTest m73 : 9|2@0+ (1,0) [0|3] "" Vector__XXX
 SG_ CcfVehicleLocator m73 : 55|2@0+ (1,0) [0|3] "" Vector__XXX
 SG_ CcfWalkAwayLocking m73 : 15|2@0+ (1,0) [0|3] "" Vector__XXX
 SG_ CcfWinGblClTelLock m73 : 59|2@0+ (1,0) [0|3] "" Vector__XXX
 SG_ CcfColmnRetractOpenLoad m79 : 10|3@0+ (1,0) [0|7] "" Vector__XXX
 SG_ CcfColmnUpRetractOpenLoad m79 : 13|3@0+ (1,0) [0|7] "" Vector__XXX
 SG_ CcfComfortPlus m79 : 63|2@0+ (1,0) [0|3] "" Vector__XXX
 SG_ CcfEasyEntExtSetMenu m79 : 47|2@0+ (1,0) [0|3] "" Vector__XXX
 SG_ CcfeCallhydrogenStorage m79 : 15|2@0+ (1,0) [0|3] "" Vector__XXX
 SG_ CcfeCallotherPropStorage m79 : 23|2@0+ (1,0) [0|3] "" Vector__XXX
 SG_ CcfEcoModeButtonFit m79 : 39|2@0+ (1,0) [0|3] "" Vector__XXX
 SG_ CcfExtLghtTellTaleCol m79 : 18|3@0+ (1,0) [0|7] "" Vector__XXX
 SG_ CcfHeatWasherOpenLoad m79 : 26|3@0+ (1,0) [0|7] "" Vector__XXX
 SG_ CcfIgnition1OpenLoad m79 : 34|3@0+ (1,0) [0|7] "" Vector__XXX
 SG_ CcfIgnition2OpenLoad m79 : 37|3@0+ (1,0) [0|7] "" Vector__XXX
 SG_ CcfIgnition3OpenLoad m79 : 42|3@0+ (1,0) [0|7] "" Vector__XXX
 SG_ CcfIgnition4OpenLoad m79 : 45|3@0+ (1,0) [0|7] "" Vector__XXX
 SG_ CcfIgnition5OpenLoad m79 : 50|3@0+ (1,0) [0|7] "" Vector__XXX
 SG_ CcfIgnition6OpenLoad m79 : 53|3@0+ (1,0) [0|7] "" Vector__XXX
 SG_ CcfIgnition7OpenLoad m79 : 58|3@0+ (1,0) [0|7] "" Vector__XXX
 SG_ CcfIgnition8OpenLoad m79 : 61|3@0+ (1,0) [0|7] "" Vector__XXX
 SG_ CcfIMCFanAssyAuxCooling m79 : 31|2@0+ (1,0) [0|3] "" Vector__XXX
 SG_ CcfLampSupplyRightOpenLoad m79 : 21|3@0+ (1,0) [0|7] "" Vector__XXX
 SG_ CcfParkAidECUOpenLoad m79 : 29|3@0+ (1,0) [0|7] "" Vector__XXX
 SG_ CcfScreenSurroundSwitch m79 : 55|2@0+ (1,0) [0|3] ""  HVAC
 SG_ CcfAutoAccess m83 : 45|3@0+ (1,0) [0|7] "" Vector__XXX
 SG_ CcfCoolingFanFitment m83 : 31|3@0+ (1,0) [0|7] "" Vector__XXX
 SG_ CcfDriverMemDrSwtchPk m83 : 17|2@0+ (1,0) [0|3] "" Vector__XXX
 SG_ CcfEDiffType m83 : 15|4@0+ (1,0) [0|15] "" Vector__XXX
 SG_ CcfGenericEngPwrOut m83 : 52|5@0+ (1,0) [0|31] "" Vector__XXX
 SG_ CcfHdlampLvlSensPos m83 : 47|2@0+ (1,0) [0|3] "" Vector__XXX
 SG_ CcfLRTerrainJGAllRdLaunch m83 : 39|2@0+ (1,0) [0|3] "" Vector__XXX
 SG_ CcfPassMemDrSwtchPk m83 : 19|2@0+ (1,0) [0|3] "" Vector__XXX
 SG_ CcfPTCruiseFitment m83 : 55|3@0+ (1,0) [0|7] "" Vector__XXX
 SG_ CcfRearDriverMemDrSwtchPk m83 : 21|2@0+ (1,0) [0|3] "" Vector__XXX
 SG_ CcfRearlampType m83 : 37|3@0+ (1,0) [0|7] "" Vector__XXX
 SG_ CcfRearPassMemDrSwtchPk m83 : 23|2@0+ (1,0) [0|3] "" Vector__XXX
 SG_ CcfSpdoCalkmhOffset m83 : 11|4@0+ (1,0) [0|15] "" Vector__XXX
 SG_ CcfSpdoCalPercentScale m83 : 28|5@0+ (1,0) [0|31] "" Vector__XXX
 SG_ CcfSteerWlhlSwtchType m83 : 34|3@0+ (1,0) [0|7] "" Vector__XXX
 SG_ CcfTowAssist m83 : 42|3@0+ (1,0) [0|7] ""  HVAC
 SG_ CcfTPMSCalibration m83 : 63|8@0+ (1,0) [0|255] "" Vector__XXX
 SG_ CcfActSndDesignPwrlvl m84 : 39|8@0+ (1,0) [0|255] "" Vector__XXX
 SG_ CcfDoorBodyStyle m84 : 45|3@0+ (1,0) [0|7] "" Vector__XXX
 SG_ CcfDrivenWheels m84 : 42|3@0+ (1,0) [0|7] "" Vector__XXX
 SG_ CcfFinalDriveRatioComp m84 : 15|16@0+ (1,0) [1|65534] "See Signal description" Vector__XXX
 SG_ CcfNextGenPwrTrnSQ m84 : 31|8@0+ (1,0) [0|255] "" Vector__XXX
 SG_ CcfNextGenPwrTrnSQCalNo m84 : 63|8@0+ (1,0) [0|255] "" Vector__XXX
 SG_ CcfPanoramicRoof m84 : 47|2@0+ (1,0) [0|3] ""  HVAC
 SG_ CcfPetrolEMSEmissMkt m84 : 55|8@0+ (1,0) [0|255] "" Vector__XXX
 SG_ CcfBrakeDiscMaterial m85 : 26|3@0+ (1,0) [0|7] "" Vector__XXX
 SG_ CcfBrakeDiscSizeFront m85 : 19|4@0+ (1,0) [0|15] "" Vector__XXX
 SG_ CcfBrakeDiscSizeRear m85 : 23|4@0+ (1,0) [0|15] "" Vector__XXX
 SG_ CcfElectricFan m85 : 29|3@0+ (1,0) [0|7] ""  HVAC
 SG_ CcfRearDriverLinSWP m85 : 11|4@0+ (1,0) [0|15] "" Vector__XXX
 SG_ CcfRearPassLinSWP m85 : 15|4@0+ (1,0) [0|15] "" Vector__XXX
 SG_ CcfServiceInterval m85 : 39|16@0+ (1,0) [1|65533] "Km" Vector__XXX
 SG_ CcfSportbrake m85 : 31|2@0+ (1,0) [0|3] "" Vector__XXX
 SG_ CcfTyreDynamicRollRad m85 : 55|16@0+ (1,0) [0|65535] "" Vector__XXX
 SG_ CcfEnginePowerOutputkW m86 : 31|16@0+ (1,0) [1|65534] "kW" Vector__XXX
 SG_ CcfFuelTimeToService m86 : 47|16@0+ (1,0) [1|2045] "Days" Vector__XXX
 SG_ CcfHybridType m86 : 63|4@0+ (1,0) [0|15] ""  HVAC
 SG_ CcfPDC m86 : 59|4@0+ (1,0) [0|15] "" Vector__XXX
 SG_ CcfTyreSizeCorrnFac m86 : 15|16@0+ (1,0) [1|65534] "" Vector__XXX
 SG_ CcfBrakeWarningSymbol m87 : 18|3@0+ (1,0) [0|7] "" Vector__XXX
 SG_ CcfChassisDescription m87 : 15|4@0+ (1,0) [0|15] "" Vector__XXX
 SG_ CcfConfigDynamicMode m87 : 25|2@0+ (1,0) [0|3] "" Vector__XXX
 SG_ CcfGearboxdescription m87 : 11|4@0+ (1,0) [0|15] "" Vector__XXX
 SG_ ccfGenericWheelBase m87 : 31|4@0+ (1,0) [0|15] "" Vector__XXX
 SG_ CcfPTAODieWaterInSensr m87 : 23|2@0+ (1,0) [0|3] "" Vector__XXX
 SG_ CcfReverseGearSelStrat m87 : 27|2@0+ (1,0) [0|3] "" Vector__XXX
 SG_ CcfTransmissionSelectr m87 : 21|3@0+ (1,0) [0|7] "" Vector__XXX
 SG_ CcfVINPart1 m87 : 39|32@0+ (1,0) [0|4294967295] ""  BECM,EPICD_E,HVAC,SGCM
 SG_ CcfVINPart2 m88 : 15|56@0+ (1,0) [0|7.20575940379279E+016] ""  BECM,EPICD_E,HVAC,SGCM
 SG_ CcfFntClusterCableLgth m89 : 63|4@0+ (1,0) [0|15] "" Vector__XXX
 SG_ CcfFntDispCableLgth m89 : 59|4@0+ (1,0) [0|15] "" Vector__XXX
 SG_ CcfVINPart3 m89 : 15|48@0+ (1,0) [0|281474976710655] ""  BECM,EPICD_E,HVAC,SGCM
 SG_ CcfAdaptDrvBeam m91 : 51|2@0+ (1,0) [0|3] "" Vector__XXX
 SG_ CcfAquaBladeFitted m91 : 29|2@0+ (1,0) [0|3] "" Vector__XXX
 SG_ CcfAquaBladeWashDir m91 : 31|2@0+ (1,0) [0|3] "" Vector__XXX
 SG_ CcfAutoBlindEnabled m91 : 18|3@0+ (1,0) [0|7] "" Vector__XXX
 SG_ CcfAutolightSensorFit m91 : 27|2@0+ (1,0) [0|3] "" Vector__XXX
 SG_ CcfBodyStyleSeatLayout m91 : 42|3@0+ (1,0) [0|7] ""  HVAC
 SG_ CcfCDiffBknHalfShfDet m91 : 35|2@0+ (1,0) [0|3] "" Vector__XXX
 SG_ CcfCDiffRangeChgType m91 : 47|3@0+ (1,0) [0|7] "" Vector__XXX
 SG_ CcfDriverIDCamera m91 : 63|2@0+ (1,0) [0|3] "" Vector__XXX
 SG_ CcfFntAnimatedIndicator m91 : 53|2@0+ (1,0) [0|3] "" Vector__XXX
 SG_ CcfGestureBlindFront m91 : 61|3@0+ (1,0) [0|7] "" Vector__XXX
 SG_ CcfGrillActiveVanes m91 : 10|3@0+ (1,0) [0|7] ""  HVAC
 SG_ CcfHeatedWasherJets m91 : 20|2@0+ (1,0) [0|3] "" Vector__XXX
 SG_ CcfHeightInputSelection m91 : 58|3@0+ (1,0) [0|7] "" Vector__XXX
 SG_ CcfLaserHighBeam m91 : 49|2@0+ (1,0) [0|3] "" Vector__XXX
 SG_ CcfMovingWindows m91 : 39|4@0+ (1,0) [0|15] "" Vector__XXX
 SG_ CcfPNChargingFunction m91 : 15|2@0+ (1,0) [0|3] "" Vector__XXX
 SG_ CcfPNFuelRefill m91 : 33|2@0+ (1,0) [0|3] "" Vector__XXX
 SG_ CcfRearAnimatedIndicator m91 : 55|2@0+ (1,0) [0|3] "" Vector__XXX
 SG_ CcfSpareWheelCarrier m91 : 13|3@0+ (1,0) [0|7] "" Vector__XXX
 SG_ CcfTowing m91 : 44|2@0+ (1,0) [0|3] "" Vector__XXX
 SG_ CcfViscousFan m91 : 23|3@0+ (1,0) [0|7] ""  HVAC
 SG_ CcfWiperMotorModule m91 : 25|2@0+ (1,0) [0|3] "" Vector__XXX
 SG_ CcfDieselEMSEmissMkt m92 : 51|4@0+ (1,0) [0|15] "" Vector__XXX
 SG_ CcfDriverID m92 : 10|3@0+ (1,0) [0|7] "" Vector__XXX
 SG_ CcfDriverIDKeys m92 : 15|2@0+ (1,0) [0|3] "" Vector__XXX
 SG_ CcfDriverIDPhones m92 : 23|2@0+ (1,0) [0|3] "" Vector__XXX
 SG_ CcfDriverIDSeats m92 : 28|2@0+ (1,0) [0|3] "" Vector__XXX
 SG_ CcfEcoDataGallonType m92 : 31|3@0+ (1,0) [0|7] "" Vector__XXX
 SG_ CcfFrntLowerDispKeys m92 : 42|3@0+ (1,0) [0|7] "" Vector__XXX
 SG_ CcfFrntLowerDispVariant m92 : 35|4@0+ (1,0) [0|15] ""  HVAC
 SG_ CcfFrntUpperDeployable m92 : 44|2@0+ (1,0) [0|3] "" Vector__XXX
 SG_ CcfFrntUpperDispVariant m92 : 39|4@0+ (1,0) [0|15] "" Vector__XXX
 SG_ CcfFrontPassengerID m92 : 13|3@0+ (1,0) [0|7] "" Vector__XXX
 SG_ CcfNGICamBanStrat m92 : 55|2@0+ (1,0) [0|3] "" Vector__XXX
 SG_ CcfNonDepIllumDoorHnd m92 : 53|2@0+ (1,0) [0|3] "" Vector__XXX
 SG_ CcfPersonalisation m92 : 21|3@0+ (1,0) [0|7] "" Vector__XXX
 SG_ CcfRow2PassengerID m92 : 18|3@0+ (1,0) [0|7] "" Vector__XXX
 SG_ CcfRow3PassengerID m92 : 26|3@0+ (1,0) [0|7] "" Vector__XXX
 SG_ CcfSmartExitFntDrvDr m92 : 57|2@0+ (1,0) [0|3] "" Vector__XXX
 SG_ CcfSmartExitFntPassDoor m92 : 59|2@0+ (1,0) [0|3] "" Vector__XXX
 SG_ CcfSmartExitRrDrvDoor m92 : 61|2@0+ (1,0) [0|3] "" Vector__XXX
 SG_ CcfSmartExitRrPassDoor m92 : 63|2@0+ (1,0) [0|3] "" Vector__XXX
 SG_ CcfTransCalIndex m92 : 47|3@0+ (1,0) [0|7] "" Vector__XXX
 SG_ CcfChargingInlet1 m93 : 27|4@0+ (1,0) [0|15] "" Vector__XXX
 SG_ CcfChargingInlet2 m93 : 31|4@0+ (1,0) [0|15] "" Vector__XXX
 SG_ CcfEMMaxDurEngOff m93 : 47|8@0+ (1,0) [1|254] "Days" Vector__XXX
 SG_ CcfFMMaxFuelAge m93 : 55|8@0+ (1,0) [1|254] "Days" Vector__XXX
 SG_ CcfFntPassWdowSwtchPk m93 : 15|4@0+ (1,0) [0|15] "" Vector__XXX
 SG_ CcfFrntDrvWdowSwtchpk m93 : 11|4@0+ (1,0) [0|15] "" Vector__XXX
 SG_ CcfMicrophoneType m93 : 35|4@0+ (1,0) [0|15] "" Vector__XXX
 SG_ CcfRrDrWdowSwtchPk m93 : 19|4@0+ (1,0) [0|15] "" Vector__XXX
 SG_ CcfRrPassWdowSwtchpk m93 : 23|4@0+ (1,0) [0|15] "" Vector__XXX
 SG_ CcfSelectStateCharge m93 : 63|2@0+ (1,0) [0|3] "" Vector__XXX
 SG_ CcfTelematicsSpkrType m93 : 39|4@0+ (1,0) [0|15] "" Vector__XXX
 SG_ CcfTimedChrgFeature m93 : 58|3@0+ (1,0) [0|7] "" Vector__XXX
 SG_ CcfWirelessCharger m93 : 61|3@0+ (1,0) [0|7] "" Vector__XXX
 SG_ CcfActiveExhaustButtonType m97 : 31|3@0+ (1,0) [0|7] "" Vector__XXX
 SG_ CcfAFS123 m97 : 23|2@0+ (1,0) [0|3] "" Vector__XXX
 SG_ CcfBrakePadTypeFront m97 : 36|5@0+ (1,0) [0|31] "" Vector__XXX
 SG_ CcfBrakePadTypeRear m97 : 28|5@0+ (1,0) [0|31] "" Vector__XXX
 SG_ CcfElectricDrivePower m97 : 43|4@0+ (1,0) [0|15] "" Vector__XXX
 SG_ CcfEMSMktCal m97 : 21|3@0+ (1,0) [0|7] "" Vector__XXX
 SG_ CcfHeadlightsVariant m97 : 63|8@0+ (1,0) [0|255] "" Vector__XXX
 SG_ CcfHitchAssistTowbar m97 : 55|8@0+ (1,0) [0|255] "" Vector__XXX
 SG_ CcfMildHybridType m97 : 47|4@0+ (1,0) [0|15] ""  SGCM
 SG_ CcfSlcCallList m97 : 18|3@0+ (1,0) [0|7] "" Vector__XXX
 SG_ CcfSlcDeviceReminder m97 : 13|3@0+ (1,0) [0|7] "" Vector__XXX
 SG_ CcfSlcMediaSource m97 : 10|3@0+ (1,0) [0|7] "" Vector__XXX
 SG_ CcfSurroundMode m97 : 39|3@0+ (1,0) [0|7] "" Vector__XXX
 SG_ CcfTRUserInputMethod m97 : 15|2@0+ (1,0) [0|3] "" Vector__XXX
 SG_ CcfAskOnExit m98 : 35|2@0+ (1,0) [0|3] "" Vector__XXX
 SG_ CcfBacklightStratSel m98 : 23|2@0+ (1,0) [0|3] "" Vector__XXX
 SG_ CcfBodyKitStyle m98 : 11|4@0+ (1,0) [0|15] "" Vector__XXX
 SG_ CcfClearExitDetectionSystem m98 : 13|2@0+ (1,0) [0|3] "" Vector__XXX
 SG_ CcfDriveAssist m98 : 21|2@0+ (1,0) [0|3] "" Vector__XXX
 SG_ CcfDriverHeatedCalfRest m98 : 52|2@0+ (1,0) [0|3] ""  HVAC
 SG_ CcfDynamicLiteMode m98 : 31|3@0+ (1,0) [0|7] "" Vector__XXX
 SG_ CcfEngineNoiseCancel m98 : 37|2@0+ (1,0) [0|3] "" Vector__XXX
 SG_ CcfFront23BuckSwitch m98 : 33|2@0+ (1,0) [0|3] "" Vector__XXX
 SG_ CcfHeatedDoorArmrest m98 : 42|3@0+ (1,0) [0|7] ""  HVAC
 SG_ CcfHeatedMapPocket m98 : 57|2@0+ (1,0) [0|3] ""  HVAC
 SG_ CcfHtdFrntCntreArmrst m98 : 45|3@0+ (1,0) [0|7] ""  HVAC
 SG_ CcfHtdRearCntreArmrst m98 : 50|3@0+ (1,0) [0|7] ""  HVAC
 SG_ CcfIntelEmrgBrkingCAEB m98 : 39|2@0+ (1,0) [0|3] "" Vector__XXX
 SG_ CcfLowerGloveBox m98 : 63|3@0+ (1,0) [0|7] "" Vector__XXX
 SG_ CcfRow3BuckleSwitch m98 : 47|2@0+ (1,0) [0|3] "" Vector__XXX
 SG_ CcfSAPServerType m98 : 26|3@0+ (1,0) [0|7] "" Vector__XXX
 SG_ CcfSeatTherm2ndRowHMIControl m98 : 28|2@0+ (1,0) [0|3] "" Vector__XXX
 SG_ CcfSuspensionType m98 : 19|4@0+ (1,0) [0|15] ""  HVAC
 SG_ CcfTaskLightingTLMA m98 : 15|2@0+ (1,0) [0|3] "" Vector__XXX
 SG_ CcfUpperGloveBox m98 : 60|3@0+ (1,0) [0|7] "" Vector__XXX
 SG_ CcfUWBPEPSRANGEADJUSTUSEVSA m98 : 55|3@0+ (1,0) [0|7] "" Vector__XXX
 SG_ CcfATCMAirSusSwitches m100 : 35|2@0+ (1,0) [0|3] "" Vector__XXX
 SG_ CcfATCMATPCSwitch m100 : 37|2@0+ (1,0) [0|3] "" Vector__XXX
 SG_ CcfATCMAutoTRMdSwitch m100 : 27|2@0+ (1,0) [0|3] "" Vector__XXX
 SG_ CcfATCMDSCOffSwitch m100 : 31|2@0+ (1,0) [0|3] "" Vector__XXX
 SG_ CcfATCMEVSwitch m100 : 41|2@0+ (1,0) [0|3] "" Vector__XXX
 SG_ CcfATCMHDCSwitch m100 : 33|2@0+ (1,0) [0|3] "" Vector__XXX
 SG_ CcfATCMLoRangeSwitch m100 : 39|2@0+ (1,0) [0|3] "" Vector__XXX
 SG_ CcfATCMRotarySwitch m100 : 25|2@0+ (1,0) [0|3] "" Vector__XXX
 SG_ CcfATCMTA2Switch m100 : 29|2@0+ (1,0) [0|3] "" Vector__XXX
 SG_ CcfCamForwardAlert m100 : 15|3@0+ (1,0) [0|7] "" Vector__XXX
 SG_ CcfCDMDynamicHandling m100 : 12|2@0+ (1,0) [0|3] "" Vector__XXX
 SG_ CcfChgPortFlpInhibit m100 : 43|2@0+ (1,0) [0|3] "" Vector__XXX
 SG_ CcfClimateZonalControl m100 : 45|2@0+ (1,0) [0|3] ""  HVAC
 SG_ CcfDisplay2ndRowBlowerSpeed m100 : 53|3@0+ (1,0) [0|7] "" Vector__XXX
 SG_ CcfDisplayFrontBlowerSpeed m100 : 50|3@0+ (1,0) [0|7] "" Vector__XXX
 SG_ CcfEHznLongHznImpl m100 : 58|3@0+ (1,0) [0|7] "" Vector__XXX
 SG_ CcfELKARE m100 : 55|2@0+ (1,0) [0|3] "" Vector__XXX
 SG_ CcfGearRatioSpread m100 : 23|8@0+ (1,0) [0|255] "" Vector__XXX
 SG_ CcfRadarForwardAlert m100 : 10|3@0+ (1,0) [0|7] "" Vector__XXX
 SG_ CcfRHSWSBusSelection m100 : 47|2@0+ (1,0) [0|3] "" Vector__XXX
 SG_ CcfSpoilerSpecialFunc m100 : 61|3@0+ (1,0) [0|7] "" Vector__XXX
 SG_ CcfUWBPEPSENDISONLYUSEVSA m100 : 63|2@0+ (1,0) [0|3] "" Vector__XXX
 SG_ CcfACCAccelProfileSelect m102 : 45|2@0+ (1,0) [0|3] "" Vector__XXX
 SG_ CcfACCLeadCarDistDisp m102 : 41|2@0+ (1,0) [0|3] "" Vector__XXX
 SG_ CcfACCStopGapSelect m102 : 43|2@0+ (1,0) [0|3] "" Vector__XXX
 SG_ CcfAdasDCR m102 : 51|2@0+ (1,0) [0|3] "" Vector__XXX
 SG_ CcfAdasLongCRA m102 : 9|2@0+ (1,0) [0|3] "" Vector__XXX
 SG_ CcfAdasLongRPC m102 : 11|2@0+ (1,0) [0|3] "" Vector__XXX
 SG_ CcfAdasNCapCyclistAEB m102 : 19|2@0+ (1,0) [0|3] "" Vector__XXX
 SG_ CcfAdasTJP m102 : 21|2@0+ (1,0) [0|3] "" Vector__XXX
 SG_ CcfAutoHold m102 : 35|2@0+ (1,0) [0|3] "" Vector__XXX
 SG_ CcfDSMFitment m102 : 23|2@0+ (1,0) [0|3] "" Vector__XXX
 SG_ CcfESSCalNo m102 : 63|8@0+ (1,0) [0|255] "" Vector__XXX
 SG_ CcfIntMirrorVariant m102 : 39|4@0+ (1,0) [0|15] "" Vector__XXX

CM_ SG_ 1024 CcfTyreCircumference "Car Configruation Parameter - TYRE CIRCUMFERENCE

Payload MDF = 0x0837";
CM_ SG_ 1024 CcfBrand "CCF Parameter Name - Brand

Payload MDF = 0x0977";
CM_ SG_ 1024 CcfFreqRemoteControls "CCF Parameter - FREQUENCY- REMOTE CONTROLS

MDF - 0x0987";
CM_ SG_ 1024 CcfHeatedWindscreen "Car Configuration - HEATED WINDSCREEN

Payload MDF = 0x0937";
CM_ SG_ 1024 CcfHillDescentControl "CCF Parameter - HILL DESCENT CONTROL

MDF - 0x0957";
CM_ SG_ 1024 CcfParkingAssistance "Car Configuration - ParkingAssistance.

MDF = 0x0947";
CM_ SG_ 1024 CcfParkingBrakeType "CCF - PARKING BRAKE TYPE  

MDF 0x0927
";
CM_ SG_ 1024 CcfSafetyBeltReminder "CCF Parameter - SAFETY BELT REMINDER

MDF - 0x0867";
CM_ SG_ 1024 CcfBodyStyle "CCF Parameter - Body Style

MDF - 0x0A77";
CM_ SG_ 1024 CcfEmissionStandard "CCF Parameter - EMISSION STANDARD

MDF - 0x0A67";
CM_ SG_ 1024 CcfGlassType "Car Configuration - Glass Type

Payload MDF = 0x0A37";
CM_ SG_ 1024 CcfOctaneRating "CCF Parameter - OCTANE RATING

MDF - 0x0A57";
CM_ SG_ 1024 CcfRearAirConditioning "Car Configuration - AIR CONDITION, REAR

Payload MDF = 0x0A27";
CM_ SG_ 1024 CcfRoofTyp "CCF Parameter - ROOF TYPE

MDF - 0x0A47";
CM_ SG_ 1024 CcfTyreDimension "CCF Parameter - TYRE DIMENSION

MDF -  0x0A87";
CM_ SG_ 1024 Ccf12VoltOutletLuggage "CCF Parameter - 12 VOLT OUTLET LUGGAGE

MDF - 0x0F37";
CM_ SG_ 1024 CcfELVacuumPumpRrBooster "CCF Parameter - EL VACUUM PUMP REAR BOOSTER

MDF - 0x0F77";
CM_ SG_ 1024 CcfOilLevelSensor "CCF Parameter - OIL LEVEL SENSOR

MDF - 0x0F57";
CM_ SG_ 1024 CcfParkAssistCamera "Car Configuration - Park Assist Camera

PayLoad MDF = 0x0F27";
CM_ SG_ 1024 CcfRollStabilityControl "CCF Parameter - ROLL STABILITY CONTROL

MDF - 0x0F67";
CM_ SG_ 1024 CcfTyrePressureModeSystem "CCF Parameter - TYRE PRESSURE MODE SYSTEM

MDF - 0x0F47";
CM_ SG_ 1024 CcfWheelBrakesTypeRear "CCF Parameter - WHEEL BRAKES TYPE REAR

MDF - 0x0F87";
CM_ SG_ 1024 CcfAudibleMislockFeedback "CCF Parameter - AUDIBLE MISLOCK FEEDBACK

MDF - 0x1587";
CM_ SG_ 1024 CcfAutoRelocking "CCF Parameter - AUTO RELOCKING

MDF - 0x1567";
CM_ SG_ 1024 CcfPowerHeatedMirrors "CCF - POWER /HEATED MIRRORS

MDF - 0x1557";
CM_ SG_ 1024 CcfRearGlazing "Car Configuration - Rear Glazing

Payload MDF = 0x1527";
CM_ SG_ 1024 CcfRearWashWipe "CCF Parameter - REAR WASH WIPE

MDF - 0x1547";
CM_ SG_ 1024 CcfRoofHeight "CCF Parameter - ROOF HEIGHT

MDF - 0x1537";
CM_ SG_ 1024 CcfZonalOppositeDoorRelock "CCF Parameter - ZONAL OPPOSITE DOOR RELOCKING

MDF - 0x1577";
CM_ SG_ 1024 CcfAccessoryUSBUnit "CCF Parameter - Accessory USB Unit

MDF - 0x1687";
CM_ SG_ 1024 CcfAirQualitySensor "Car Configuration - Air Quality Sensor

Payload MDF = 0x1647";
CM_ SG_ 1024 CcfConfigurableUnlocking "CCF Parameter - CONFIGURABLE UNLOCKING

MDF - 0x1627";
CM_ SG_ 1024 CcfEmissionEvaporationSys "CCF Parameter - EMISSION EVAPORATION SYSTEM

MDF - 0x1657";
CM_ SG_ 1024 CcfExternalAlarmUnitSupply "CCF Parameter - EXTERNAL ALARM UNIT SUPPLY

MDF - 0x1677";
CM_ SG_ 1024 CcfHeadrestsRearFolding "CCF Parameter - HEADRESTS REAR FOLDING

MDF - 0x1667";
CM_ SG_ 1024 CcfHomesafeLighting "CCF Parameter - HOMESAFE LIGHTING

MDF - 0x1637";
CM_ SG_ 1024 CcfACCompressorType "Car Configuration - A/C Compressor Type

Payload MDF = 0x1737";
CM_ SG_ 1024 CcfAdaptiveLoadLimiterFnt "CCF Parameter - ADAPTIVE LOAD LIMITER FRONT

MDF - 0x1787";
CM_ SG_ 1024 CcfBluetoothHandsfree "CCF Parameter - Bluetooth Handsfree

MDF - 0x1747";
CM_ SG_ 1024 CcfOccupantWeightSensor "CCF Parameter - OCCUPANT WEIGHT SENSOR (OWS)

MDF - 0x1757";
CM_ SG_ 1024 CcfPyroTechSteeringColumn "CCF Parameter - PYRO TECHNICAL STEERING COLUMN

MDF - 0x1777";
CM_ SG_ 1024 CcfRearBeltDetection "CCF Parameter - REAR BELT DETECTION

MDF - 0x1767";
CM_ SG_ 1024 CcfTrafficInformation "CCF Parameter - TRAFFIC INFORMATION

MDF - 0x1727";
CM_ SG_ 1024 CcfAsthmaAndAllergy "CCF Parameter - ASTHMA AND ALLERGY

MDF - 0x1A87";
CM_ SG_ 1024 CcfDampSensor "Car Configuration - Damp Sensor

Payload MDF = 0x1A77";
CM_ SG_ 1024 CcfDoorHandleTechnology "CCF - DOOR HANDLE TECHNOLOGY

MDF - 0x1A27";
CM_ SG_ 1024 CcfNeutralControlAutoGear "CCF Parameter - NEUTRAL CONTROL AUTO. GEAR

MDF - 0x1A57";
CM_ SG_ 1024 CcfRPMSpeedController "CCF Parameter - RPM SPEED CONTROLLER

MDF - 0x1A67";
CM_ SG_ 1024 CcfSelfOpeningBootlid "CCF Parameter - SELF OPENING BOOTLID/TAILGATE

MDF - 0x1A37";
CM_ SG_ 1024 CcfShiftIndication "CCF Parameter - SHIFT INDICATION

MDF - 0x1A47";
CM_ SG_ 1024 CcfClimateZoneUserLayout "CCF Parameter - Climate Zone User Layout

MDF - 0x1D27";
CM_ SG_ 1024 CcfEcoInfoSystem "CCF Parameter - Eco Info System

MDF - 0x1D37";
CM_ SG_ 1024 CcfNightVision "CCF Parameter - NIGHTVISION

MDF - 0x1D47";
CM_ SG_ 1024 CcfReverseGearChime "CCF Parameter - REVERSE GEAR CHIME

MDF - 0x1D67";
CM_ SG_ 1024 CcfSolarSensor "Car Configuration - Solar Sensor

Payload MDF = 0x1D77";
CM_ SG_ 1024 CcfTelematics "Car Configuration - Telematics 1

MDF - 0x1D57";
CM_ SG_ 1024 CcfTelematicsProtection "CCF Parameter - Telematics Protection

MDF - 0x1D87";
CM_ SG_ 1024 CcfAutoSpeedLimiter "CCF Parameter Name - ADJUSTABLE SPEED LIMITER

Payload MDF = 0x2087";
CM_ SG_ 1024 CcfHeadUpDisplay "CCF Parameter - Head Up Display

MDF - 0x2077";
CM_ SG_ 1024 CcfIGORSystemDescription "CCF Parameter - IGOR System Description

MDF - 0x2027";
CM_ SG_ 1024 CcfLanguageRegion "CCF Parameter - LANGUAGE REGION

MDF - 0x2037";
CM_ SG_ 1024 CcfSideCamera "Car Configuration - SideCamera

Payload MDF = 0x2047";
CM_ SG_ 1024 CcfStopStart "Car Configuration - Stop/Start

Payload MDF = 0x2067";
CM_ SG_ 1024 CcfTrailerTyrePressMonSys "CCF Parameter - Trailer Tyre Press Monitoring System

MDF - 0x2057";
CM_ SG_ 1024 Ccf4x4InfoDisplay "Car Configuration - 4x4 Information Display
MDF =  0x2147";
CM_ SG_ 1024 CcfAdvancedChauffeurFunc "CCF Parameter - Advanced Chauffeur Function

MDF - 0x2127";
CM_ SG_ 1024 CcfAudibleAlarmMode "CCF Parameter - Audible Alarm Mode

MDF - 0x2157";
CM_ SG_ 1024 CcfCrashEventDataRec "CCF Parameter - Crash Event Data Recording

MDF - 0x2177";
CM_ SG_ 1024 CcfDoorLatchType "Car Configuration - Door Latch Type

Payload MDF = 0x2187";
CM_ SG_ 1024 CcfLowSpdIntEmergBrake "Car Configuration - Low Speed Intelligent Emergency Braking

Payload MDF = 0x2137";
CM_ SG_ 1024 CcfModelYear "Car Configuration - Model Year

Payload MDF = 0x2167";
CM_ SG_ 1024 CcfActiveRollControl "CCF Parameter - Active Roll Control

MDF - 0x2287";
CM_ SG_ 1024 CcfAuxillaryWaterPump "CCF Parameter Name - Auxillary Water Pump

Payload MDF = 0x2227";
CM_ SG_ 1024 CcfConversationAssist "CCF Parameter - Conversation Assist

MDF - 0x2247";
CM_ SG_ 1024 CcfNavECORouteExtraUrban "CCF Parameter - Navigation ECO Route - EXTRA URBAN data

MDF - 0x2267";
CM_ SG_ 1024 CcfNavECORouteUrban "CCF Parameter - Navigation ECO Route - URBAN data

MDF - 0x2257";
CM_ SG_ 1024 CcfPartNumberFormat "CCF Parameter - Part Number Format

MDF - 0x2237";
CM_ SG_ 1024 CcfTrsferBxCntrllrType "Car Configuration - Transfer Box Controller Type

Payload MDF = 0x2277";
CM_ SG_ 1024 CcfCameraHMIStrategy "Car Configuration - CameraHMIStrategy

Payload MDF = 0x4122";
CM_ SG_ 1024 CcfDeplBatterySystem "CCF Parameter Name - DeplBatterySystem

Payload MDF = 0x4177";
CM_ SG_ 1024 CcfDriverBuckleSwitch "CCF Parameter Name - DriverBuckleSwitch

Payload MDF = 0x4181";
CM_ SG_ 1024 CcfDriverKneeAirbag "CCF Parameter Name - DriverKneeAirbag

Payload MDF = 0x4155";
CM_ SG_ 1024 CcfDriverPassBeltPret "CCF Parameter Name - DriverPassBeltPret

Payload MDF = 0x4144";
CM_ SG_ 1024 CcfDriverSwtchLdLimit "CCF Parameter Name - DriverSwtchLdLimit

Payload MDF = 0x4187";
CM_ SG_ 1024 CcfEventDataRecorder "CCF Parameter Name - EventDataRecorder

Payload MDF = 0x4185";
CM_ SG_ 1024 CcfFntDIFbdkMech "CCF Parameter - FntDIFbdkMech

MDF - 0x4141";
CM_ SG_ 1024 CcfInfotainmentType "CCF Parameter Name - InfotainmentType

Payload MDF = 0x4125";
CM_ SG_ 1024 CcfLeftCurtainAirbag "CCF Parameter Name - LeftCurtainAirbag

Payload MDF = 0x4173";
CM_ SG_ 1024 CcfLeftRearHeadAbag "CCF Parameter Name - LeftRearHeadAbag

Payload MDF = 0x4167";
CM_ SG_ 1024 CcfLeftSideAirbag "CCF Parameter Name - LeftSideAirbag

Payload MDF = 0x4153";
CM_ SG_ 1024 CcfmPACOS "CCF Parameter Name - mPACOS

Payload MDF = 0x4147";
CM_ SG_ 1024 CcfPADLamp "CCF Parameter Name - PADLamp

Payload MDF = 0x4162";
CM_ SG_ 1024 CcfPassBuckleSwitch "CCF Parameter Name - PassBuckleSwitch

Payload MDF = 0x4183";
CM_ SG_ 1024 CcfPassOccWghtSensor "CCF Parameter Name - PassOccWghtSensor

Payload MDF = 0x4157";
CM_ SG_ 1024 CcfRightCurtainAirbag "CCF Parameter Name - RightCurtainAirbag
Payload MDF = 0x4175";
CM_ SG_ 1024 CcfRightRearHeadAbag "CCF Parameter Name - RightRearHeadAbag

Payload MDF = 0x4171";
CM_ SG_ 1024 CcfRightSideAirbag "CCF Parameter Name - RightSideAirbag

Payload MDF = 0x4151";
CM_ SG_ 1024 CcfRollOverSensing "CCF Parameter Name - RollOverSensing

Payload MDF = 0x4165";
CM_ SG_ 1024 CcfThirdRowChiller "Car Configuration - Thrid Row Chiller

Payload MDF = 0x4127";
CM_ SG_ 1024 CcfTrunkLmpOutput "CCF Parameter - TrunkLmpOutput

MDF - 0x4137";
CM_ SG_ 1024 CcfWindowCalibration "CCF Parameter - WindowCalibration

MDF - 0x4132";
CM_ SG_ 1024 CcfWindowOpFeedback "CCF Parameter - WindowOpFeedback

MDF - 0x4135";
CM_ SG_ 1024 CcfATPC "Car Configuration - ATPC

Payload MDF = 0x4487";
CM_ SG_ 1024 CcfBCMCtrlAmbLitSet "CCF Parameter - BCMCtrlAmbLitSet

MDF - 0x4442";
CM_ SG_ 1024 CcfBumperType "CCF Parameter Name - BumperType

Payload MDF = 0x4463";
CM_ SG_ 1024 CcfDLNAStatus "CCF Parameter - DLNAStatus

MDF - 0x4473";
CM_ SG_ 1024 CcfDriverFrontAirbag "CCF Parameter Name - DriverFrontAirbag

Payload MDF = 0x4454";
CM_ SG_ 1024 CcfDriverPassRetractor "CCF Parameter Name - DriverPassRetractor

Payload MDF = 0x4445";
CM_ SG_ 1024 CcfDRLMLSInteraction "CCF Parameter - DRLMLSInteraction

MDF - 0x4424";
CM_ SG_ 1024 CcfDRLTransInteraction "CCF Parameter - DRLTransInteraction

MDF - 0x4427";
CM_ SG_ 1024 CcfGracenotes "CCF Parameter - Gracenotes

MDF - 0x4477";
CM_ SG_ 1024 CcfLowBeamFdbkMech "CCF Parameter - LowBeamFdbkMech

MDF - 0x4432";
CM_ SG_ 1024 CcfMainBeamFdbkMech "CCF Parameter - MainBeamFdbkMech

MDF - 0x4435";
CM_ SG_ 1024 CcfPassFrontAirbag "CCF Parameter Name - PassFrontAirbag

Payload MDF = 0x4457";
CM_ SG_ 1024 CcfPwrTailProxSenPAM "CCF Parameter - PwrTailProxSenPAM

MDF - 0x4437";
CM_ SG_ 1024 CcfQRBPowerPAM "CCF Parameter - QRBPowerPAM

MDF - 0x4451";
CM_ SG_ 1024 CcfRemoteStartCapable "Car Configuration - RemoteStartCapable

Payload MDF = 0x4421";
CM_ SG_ 1024 CcfStealthMode "CCF Parameter - StealthMode

MDF - 0x4447";
CM_ SG_ 1024 CcfTPMSVariant "CCF Parameter - TPMSVariant

MDF - 0x4467";
CM_ SG_ 1024 CcfCHMSLProfile "CCF Parameter - CHMSLProfile

MDF - 0x4725";
CM_ SG_ 1024 CcfDrvDrowsyMonDDM "CCF Parameter - DrvDrowsyMonDDM

MDF - 0x4785";
CM_ SG_ 1024 CcfExtSyntheticSounder "CCF Parameter - ExtSyntheticSounder

MDF - 0x4737";
CM_ SG_ 1024 CcfFntDIProfile "CCF Parameter - FntDIProfile

MDF - 0x4765";
CM_ SG_ 1024 CcfFntDRLProfile "CCF Parameter - FntDRLProfile

MDF - 0x4735";
CM_ SG_ 1024 CcfFntPosProfile "CCF Parameter - FntPosProfile

MDF - 0x4755";
CM_ SG_ 1024 CcfFntSMProfile "CCF Parameter - FntSMProfile

MDF - 0x4745";
CM_ SG_ 1024 CcfFwdCollWarnAEB "CCF Parameter - FwdCollWarnAEB

MDF - 0x4781";
CM_ SG_ 1024 CcfIntelEmerBrkingCUIEB "Car Configuration - indicates CUIEB fitment.

MDF = 0x4783";
CM_ SG_ 1024 CcfISLFitment "Car Configuration - IntelCruiseCtrl

Payload MDF = 0x4787";
CM_ SG_ 1024 CcfNavBtnFCIM "Car Configuration - NavBtnFCIM
MDF = 0x4727";
CM_ SG_ 1024 CcfNLIAudioAmp "CCF Parameter - NLIAudioAmp

MDF - 0x4747";
CM_ SG_ 1024 CcfP4UBtnFACP "Car Configuration - P4UBtnFACP

Payload MDF = 0x4767";
CM_ SG_ 1024 CcfPassAirbagVent "CCF Parameter Name - PassAirbagVent

Payload MDF = 0x4777";
CM_ SG_ 1024 CcfPCMEWULine "CCF Parameter - PCMEWULine

MDF - 0x4772";
CM_ SG_ 1024 CcfRowTwoSquabRelAct "CCF Parameter - RowTwoSquabRelAct

MDF - 0x4775";
CM_ SG_ 1024 CcfTrajectoryLines "CCF Parameter - TrajectoryLines

MDF - 0x4757";
CM_ SG_ 1024 CcfCDiffType "CCF Parameter Name: CDiffType

MDF: 0x4857";
CM_ SG_ 1024 CcfChauPersonalisation "CCF Parameter - ChauPersonalisation

MDF - 0x4825";
CM_ SG_ 1024 CcfConnectInfoStatus "CCF Parameter - ConnectInfoStatus

MDF - 0x4875";
CM_ SG_ 1024 CcfDistribPlayback "CCF Parameter - DistribPlayback

MDF - 0x4843";
CM_ SG_ 1024 CcfEDTType "CCF Parameter - EDTType

MDF - 0x4867";
CM_ SG_ 1024 CcfElecDepTowBar "Ccf - ElecDepTowBar

MDF - 0x4881";
CM_ SG_ 1024 CcfFntOptDiskDrive "CCF Parameter - FntOptDiskDrive

MDF - 0x4853";
CM_ SG_ 1024 CcfFuelPumpType "Car Configuration - Fuel Pump type
MDF=0x4863";
CM_ SG_ 1024 CcfGliding "Car Configuration - Gliding

Payload MDF = 0x4827";
CM_ SG_ 1024 CcfICCFitment "Car Configuration - IntelCruiseCtrl

Payload MDF = 0x4877";
CM_ SG_ 1024 CcfIntStoreIMC "CCF Parameter - IntStoreIMC

MDF - 0x4845";
CM_ SG_ 1024 CcfIntStoreISC "CCF Parameter - IntStoreISC

MDF - 0x4847";
CM_ SG_ 1024 CcfLaneKeepAssistLKA "CCF - LaneKeepAssistLKA

MDF - 0x4821";
CM_ SG_ 1024 CcfNGINLIDigRadRecSys "CCF Parameter - NGINLIDigRadRecSys

MDF - 0x4837";
CM_ SG_ 1024 CcfNoseLoadMeasure "CCF Parameter - NoseLoadMeasure

MDF - 0x4885";
CM_ SG_ 1024 CcfPDCBtnFCIM "Car Configuration - PDCBtnFCIM
Payload  0x4841 ";
CM_ SG_ 1024 CcfTCUConnectivity "CCF Parameter - ExternalConnectivity

MDF - 0x4872";
CM_ SG_ 1024 CcfTrailerLightMod "CCF Parameter - TrailerLightMod

MDF - 0x4883";
CM_ SG_ 1024 CcfTRMFitment "CCF Parameter - TRMFitment

MDF - 0x4887";
CM_ SG_ 1024 CcfAirIonizer "Car Configuration - Air Ionizer

Payload MDF = 0x4972";
CM_ SG_ 1024 CcfAutoAccessHeight "CCF Parameter - AutoAccessHeight

MDF - 0x4954";
CM_ SG_ 1024 CcfCameraBtnFCIM "Car Configuration - CameraBtnFCIM

Payload MDF = 0x4943
";
CM_ SG_ 1024 CcfClusterAlertGFX "CCF Parameter - ClusterAlertGFX

MDF - 0x4937";
CM_ SG_ 1024 CcfDepSideSteps "CCF Parameter - DepSideSteps

MDF - 0x4925";
CM_ SG_ 1024 CcfDriverDoorLock "CCF Parameter - DriverDoorLock

MDF - 0x4952";
CM_ SG_ 1024 CcfDSSOffRoadOperation "CCF Parameter - DSSOffRoadOperation

MDF - 0x4923



";
CM_ SG_ 1024 CcfDualViewBtnFCIM "Car Configuration - DualViewBtnFCIM

Payload MDF = 0x4945

";
CM_ SG_ 1024 CcfECOmodeText "CCF Parameter - ECOmodeText

MDF - 0x4961";
CM_ SG_ 1024 CcfKeyFobTechnology "CCF Parameter - KeyFobTechnology

MDF - 0x4932";
CM_ SG_ 1024 CcfPassDoorLock "CCF Parameter - PassDoorLock

MDF - 0x4957";
CM_ SG_ 1024 CcfPedProtectSystem "CCF Parameter - PedProtectSystem

Payload MDF = 0x4941";
CM_ SG_ 1024 CcfRearExitDetect "CCF Parameter - RearExitDetect

MDF - 0x4947";
CM_ SG_ 1024 CcfRestrictSunroofOpen "CCF Parameter - RestrictSunroofOpen

MDF - 0x4934";
CM_ SG_ 1024 CcfRLPassDoorLock "CCF Parameter - RLPassDoorLock

MDF - 0x4964";
CM_ SG_ 1024 CcfRRPassDoorLock "CCF Parameter - RRPassDoorLock

MDF - 0x4967";
CM_ SG_ 1024 CcfSoftCloseDoors "CCF Parameter - SoftCloseDoors

MDF - 0x4975";
CM_ SG_ 1024 CcfSunGblClTelLock "CCF Parameter - SunGblClTelLock

MDF - 0x4985";
CM_ SG_ 1024 CcfTelLock "CCF Parameter - TelLock

MDF - 0x4981";
CM_ SG_ 1024 CcfTelUnlock "CCF Parameter - TelUnlock

MDF - 0x4987";
CM_ SG_ 1024 CcfTrailerLightTest "CCF Parameter - TrailerLightTest

MDF - 0x4921";
CM_ SG_ 1024 CcfVehicleLocator "CCF Parameter - VehicleLocator

MDF - 0x4977";
CM_ SG_ 1024 CcfWalkAwayLocking "CCF Parameter - WalkAwayLocking

MDF - 0x4927";
CM_ SG_ 1024 CcfWinGblClTelLock "CCF Parameter - WinGblClTelLock

MDF - 0x4983";
CM_ SG_ 1024 CcfColmnRetractOpenLoad "CCF Parameter - ColmnRetractOpenLoad

MDF - 0x4F22";
CM_ SG_ 1024 CcfColmnUpRetractOpenLoad "CCF Parameter - ColmnUpRetractOpenLoad

MDF - 0x4F25";
CM_ SG_ 1024 CcfComfortPlus "CCF Parameter - ComfortPlus

MDF - 0x4F87";
CM_ SG_ 1024 CcfEasyEntExtSetMenu "CCF Parameter - EasyEntExtSetMenu

MDF - 0x4F67";
CM_ SG_ 1024 CcfeCallhydrogenStorage "CCF Parameter - eCallhydrogenStorage

MDF - 0x4F27";
CM_ SG_ 1024 CcfeCallotherPropStorage "CCF Parameter - eCallotherPropStorage

MDF - 0x4F37";
CM_ SG_ 1024 CcfEcoModeButtonFit "Car Configuration - Economy Mode Button Fitment

Payload MDF = 0x4F57";
CM_ SG_ 1024 CcfExtLghtTellTaleCol "CCF Parameter - LampSupplyLeftOpenLoad

MDF - 0x4F32";
CM_ SG_ 1024 CcfHeatWasherOpenLoad "CCF Parameter - HeatWasherOpenLoad

MDF - 0x4F42";
CM_ SG_ 1024 CcfIgnition1OpenLoad "CCF Parameter - Ignition1OpenLoad

MDF - 0x4F52";
CM_ SG_ 1024 CcfIgnition2OpenLoad "CCF Parameter - Ignition2OpenLoad

MDF - 0x4F55";
CM_ SG_ 1024 CcfIgnition3OpenLoad "CCF Parameter - Ignition3OpenLoad

MDF - 0x4F62";
CM_ SG_ 1024 CcfIgnition4OpenLoad "CCF Parameter - Ignition4OpenLoad

MDF - 0x4F65";
CM_ SG_ 1024 CcfIgnition5OpenLoad "CCF Parameter - Ignition5OpenLoad

MDF - 0x4F52";
CM_ SG_ 1024 CcfIgnition6OpenLoad "CCF Parameter - Ignition6OpenLoad

MDF - 0x4F55";
CM_ SG_ 1024 CcfIgnition7OpenLoad "CCF Parameter - Ignition7OpenLoad

MDF - 0x4F82";
CM_ SG_ 1024 CcfIgnition8OpenLoad "CCF Parameter - Ignition8OpenLoad

MDF - 0x4F85";
CM_ SG_ 1024 CcfIMCFanAssyAuxCooling "CCF Parameter - IMCFanAssyAuxCooling

MDF - 0x4F47";
CM_ SG_ 1024 CcfLampSupplyRightOpenLoad "CCF Parameter - LampSupplyRightOpenLoad

MDF - 0x4F35";
CM_ SG_ 1024 CcfParkAidECUOpenLoad "CCF Parameter - ParkAidECUOpenLoad

MDF - 0x4F45";
CM_ SG_ 1024 CcfScreenSurroundSwitch "Car Configuration - Screen Surround Fitted
MDF = 0x4F77
";
CM_ SG_ 1024 CcfAutoAccess "CCF Parameter - AutoAccess

MDF - 0x5365";
CM_ SG_ 1024 CcfCoolingFanFitment "Car Configuration - CoolingFanFitment
Payload MDF = 0x5347";
CM_ SG_ 1024 CcfDriverMemDrSwtchPk "CCF Parameter - DriverMemDrSwtchPk

MDF - 0x5331";
CM_ SG_ 1024 CcfEDiffType "Car configuration Parameter - EDiff Type

Payload MDF = 0x5327";
CM_ SG_ 1024 CcfGenericEngPwrOut "Car Configuration - Generic Engine Power Output (owned by TCM)
Payload MDF = 0x5374
";
CM_ SG_ 1024 CcfHdlampLvlSensPos "CCF Parameter - HdlampLvlSensPos

MDF - 0x5367";
CM_ SG_ 1024 CcfLRTerrainJGAllRdLaunch "CCF Parameter - LRTerrainJGAllRdLaunch

MDF - 0x5357";
CM_ SG_ 1024 CcfPassMemDrSwtchPk "CCF Parameter - PassMemDrSwtchPk

MDF - 0x5333";
CM_ SG_ 1024 CcfPTCruiseFitment "Car Configuration - Powertrain Cruise fitment (owned by PCM)

Payload MDF = 0x5377";
CM_ SG_ 1024 CcfRearDriverMemDrSwtchPk "CCF Parameter - RearDriverMemDrSwtchPk

MDF - 0x5335";
CM_ SG_ 1024 CcfRearlampType "CCF Parameter - RearlampType

MDF - 0x5355";
CM_ SG_ 1024 CcfRearPassMemDrSwtchPk "CCF Parameter - RearPassMemDrSwtchPk

MDF - 0x5337";
CM_ SG_ 1024 CcfSpdoCalkmhOffset "Car Configuration - Jaguar Speedo calibration - km/h Offset

Payload MDF = 0x5323";
CM_ SG_ 1024 CcfSpdoCalPercentScale "Car Configuration - Jaguar Speedo calibration - Percentage Scaling

Payload MDF = 0x5344";
CM_ SG_ 1024 CcfSteerWlhlSwtchType "CCF Parameter - SteerWlhlSwtchType

MDF - 0x5352";
CM_ SG_ 1024 CcfTowAssist "CCF Parameter Name - TowAssist

Payload MDF = 0x5362";
CM_ SG_ 1024 CcfTPMSCalibration "CCF Parameter - TPMSCalibration

MDF - 0x5387";
CM_ SG_ 1024 CcfActSndDesignPwrlvl "CCF Parameter - ActSndDesignPwrlvl

MDF - 0x5457";
CM_ SG_ 1024 CcfDoorBodyStyle "Car Configuration - Door Body Style

MDF = 0x5465 ";
CM_ SG_ 1024 CcfDrivenWheels "Car Configuration - Driver Wheels

MDF = 0x5462";
CM_ SG_ 1024 CcfFinalDriveRatioComp "Car Configuration - Final Drive Ratio Computed

Payload MDF = 0x5427 & 0x5437";
CM_ SG_ 1024 CcfNextGenPwrTrnSQ "Car Configuration - Next generation Powertrain Sound Quality - 0x5447
";
CM_ SG_ 1024 CcfNextGenPwrTrnSQCalNo "CCF Parameter - NextGenPwrTrnSQCalNo

MDF - 0x5487";
CM_ SG_ 1024 CcfPanoramicRoof "Car Configuration - PanoramicRoof
Payload MDF = 0x5467";
CM_ SG_ 1024 CcfPetrolEMSEmissMkt "Car Configuration - Petrol EMS Emissions Market 

Payload MDF = 0x5477
";
CM_ SG_ 1024 CcfBrakeDiscMaterial "Car Configuration - BrakeDiscMaterial
Payload MDF = 0x5542";
CM_ SG_ 1024 CcfBrakeDiscSizeFront "Car Configuration - BrakeDiscSizeFront

Payload MDF = 0x5533";
CM_ SG_ 1024 CcfBrakeDiscSizeRear "Car Configuration - BrakeDiscSizeRear
Payload MDF = 0x5537";
CM_ SG_ 1024 CcfElectricFan "Car Configuration - Electric Fan

Payload MDF = 0x5545";
CM_ SG_ 1024 CcfRearDriverLinSWP "CCF Parameter - RearDriverLinSWP

MDF - 0x5523";
CM_ SG_ 1024 CcfRearPassLinSWP "CCF Parameter - RearPassLinSWP

MDF - 0x5527";
CM_ SG_ 1024 CcfServiceInterval "Car Configuration - Service Interval

Payload MDF = 0x5557 & 0x5567";
CM_ SG_ 1024 CcfSportbrake "Car Configuration - Sportbrake

MDF = 0x5547";
CM_ SG_ 1024 CcfTyreDynamicRollRad "Car Configuration - Tyre Dynamic Rolling Radius signal

Payload MDF = 0x5577 & 0x5587";
CM_ SG_ 1024 CcfEnginePowerOutputkW "Car Configuration - Engine Power Output [kW]

Payload MDF = 0x5647 & 0x5657";
CM_ SG_ 1024 CcfFuelTimeToService "Car Configuration - Fuel / Time to Service

Payload MDF = 0x5667 & 0x5677";
CM_ SG_ 1024 CcfHybridType "Car Configuration - Hybrid Type

Payload MDF = 0x5687";
CM_ SG_ 1024 CcfPDC "Car Configuration - Parking Distance Control

Payload MDF = 0x5683";
CM_ SG_ 1024 CcfTyreSizeCorrnFac "Car Configuration - Tyre Size Correction Factor

Payload MDF = 0x5627 & 0x5637";
CM_ SG_ 1024 CcfBrakeWarningSymbol "CCF Parameter - BrakeWarningSymbol

MDF - 0x5732";
CM_ SG_ 1024 CcfChassisDescription "Car Configuration - ChassisDescription

Payload MDF = 0x5727";
CM_ SG_ 1024 CcfConfigDynamicMode "Car Configuration - ConfigDynamicMode
Payload MDF = 0x5741
";
CM_ SG_ 1024 CcfGearboxdescription "Car Configuration - Gearbox description

Payload MDF = 0x5723";
CM_ SG_ 1024 ccfGenericWheelBase "Car Configuration - Generic Wheel Base

Payload MDF = 0x5747";
CM_ SG_ 1024 CcfPTAODieWaterInSensr "Car Configuration - Powertrain Accessory options - Diesel Water in Fuel Sensor

Payload MDF = 0x5737";
CM_ SG_ 1024 CcfReverseGearSelStrat "Car Configuration - Reverse Gear Selection Strategy

Payload MDF = 0x5743";
CM_ SG_ 1024 CcfTransmissionSelectr "Car Configuration - Transmission Selector

Payload MDF = 0x5735";
CM_ SG_ 1024 CcfVINPart1 "Car Configuration - VIN Part 1

VIN Character 1 (Geographic Area) 
VIN Character 2 (Country) 
VIN Character 3 (Manufacturer) 
VIN Character 4 (Market/Specification) 

Payload MDF = 0x5757, 0x5767, 0x5777, 0x5787
";
CM_ SG_ 1024 CcfVINPart2 "Car Configuration - VIN Part 2

VIN Character 5 (Transmission & Steering) 
VIN Character 6 (Model Range) 
VIN Character 7 (Model Range) 
VIN Character 8 (Emission Control System) 
VIN Character 9 (Check Digit) 
VIN Character 10 (Model Year) 
VIN Character 11 (Assembly Plant & Model Line) 

Payload MDF = 0x0x5827, 0x5837, 0x5847, 0x5857, 0x5867, 0x5877, 0x5887";
CM_ SG_ 1024 CcfFntClusterCableLgth "CCF Parameter - FntClusterCableLgth

MDF - 0x5987";
CM_ SG_ 1024 CcfFntDispCableLgth "CCF Parameter - FntDispCableLgth

MDF - 0x5983";
CM_ SG_ 1024 CcfVINPart3 "Car Configuration - VIN Part 3

VIN Character 12 (Serial Number 1) 
VIN Character 13 (Serial Number 2) 
VIN Character 14 (Serial Number 3) 
VIN Character 15 (Serial Number 4) 
VIN Character 16 (Serial Number 5) 
VIN Character 17 (Serial Number 6)

Payload MDF = 0x5927,  0x5937, 0x5947, 0x5957, 0x5967, 0x5977
";
CM_ SG_ 1024 CcfAdaptDrvBeam "CCF Parameter - AdaptDrvBeam

MDF - 0x5B73";
CM_ SG_ 1024 CcfAquaBladeFitted "CCF Parameter - AquaBladeFitted

MDF - 0x5B45";
CM_ SG_ 1024 CcfAquaBladeWashDir "CCF Parameter - AquaBladeWashDir

MDF - 0x5B47";
CM_ SG_ 1024 CcfAutoBlindEnabled "CCF Parameter - AutoBlindEnabled

MDF - 0x5B32";
CM_ SG_ 1024 CcfAutolightSensorFit "CCF Parameter - AutolightSensorFit

MDF - 0x5B43";
CM_ SG_ 1024 CcfBodyStyleSeatLayout "Car Configuration - BodyStyleSeatLayout

MDF = 0x5B62
";
CM_ SG_ 1024 CcfCDiffBknHalfShfDet "CCF Parameter Name: CDiffBknHalfShfDet

MDF: 0x5B53";
CM_ SG_ 1024 CcfCDiffRangeChgType "CCF Parameter name: CDiffRangeChgType

MDF = 0x5B67";
CM_ SG_ 1024 CcfDriverIDCamera "CCF Parameter - DriverIDCamera

MDF - 0x5B87";
CM_ SG_ 1024 CcfFntAnimatedIndicator "CCF Parameter - FntAnimatedIndicator

MDF - 0x5B75";
CM_ SG_ 1024 CcfGestureBlindFront "CCF Parameter - GestureBlindFront

MDF - 0x5B85";
CM_ SG_ 1024 CcfGrillActiveVanes "Car Configuration Grill Active Vanes.
Payload MDF = 0x5B22";
CM_ SG_ 1024 CcfHeatedWasherJets "CCF Parameter - HeatedWasherJets

MDF - 0x5B34";
CM_ SG_ 1024 CcfHeightInputSelection "CCF Parameter - HeightInputSelection

MDF - 0x5B82";
CM_ SG_ 1024 CcfLaserHighBeam "CCF Parameter - LaserHighBeam

MDF - 0x5B71";
CM_ SG_ 1024 CcfMovingWindows "CCF Parameter - MovingWindows

MDF - 0x5B57";
CM_ SG_ 1024 CcfPNChargingFunction "Car Configuration - PNChargingFunction

MDF = 0x5B27";
CM_ SG_ 1024 CcfPNFuelRefill "CCF Parameter - PNFuelRefill

MDF - 0x5B51";
CM_ SG_ 1024 CcfRearAnimatedIndicator "CCF Parameter - RearAnimatedIndicator

MDF - 0x5B77";
CM_ SG_ 1024 CcfSpareWheelCarrier "CCF Parameter - SpareWheelCarrier

MDF - 0x5B25";
CM_ SG_ 1024 CcfTowing "Car Config - Towing

MDF = 0x5B64";
CM_ SG_ 1024 CcfViscousFan "Car Configuration - Viscous Fan 

Payload MDF = 0x5B37";
CM_ SG_ 1024 CcfWiperMotorModule "CCF Parameter - WiperMotorModule

MDF - 0x5B41";
CM_ SG_ 1024 CcfDieselEMSEmissMkt "Car Configuration - DieselEMSEmissMkt

Payload MDF = 0x5C73";
CM_ SG_ 1024 CcfDriverID "CCF Parameter - DriverID

MDF - 0x5C22";
CM_ SG_ 1024 CcfDriverIDKeys "CCF Parameter - DriverIDKeys

MDF - 0x5C27";
CM_ SG_ 1024 CcfDriverIDPhones "CCF Parameter - DriverIDPhones

MDF - 0x5C37";
CM_ SG_ 1024 CcfDriverIDSeats "CCF Parameter - DriverIDSeats

MDF - 0x5C44";
CM_ SG_ 1024 CcfEcoDataGallonType "CCF Parameter - EcoDataGallonType

MDF - 0x5C47";
CM_ SG_ 1024 CcfFrntLowerDispKeys "CCF Parameter - FrntLowerDispKeys

MDF - 0x5C62";
CM_ SG_ 1024 CcfFrntLowerDispVariant "CCF Parameter - FrntLowerDispVariant

MDF - 0x5C53";
CM_ SG_ 1024 CcfFrntUpperDeployable "CCF Parameter - FrntUpperDeployable

MDF - 0x5C64";
CM_ SG_ 1024 CcfFrntUpperDispVariant "CCF Parameter - FrntUpperDispVariant

MDF - 0x5C57";
CM_ SG_ 1024 CcfFrontPassengerID "CCF Parameter - FrontPassengerID

MDF - 0x5C25";
CM_ SG_ 1024 CcfNGICamBanStrat "CCF Parameter - NGICamBanStrat

MDF - 0x5C77";
CM_ SG_ 1024 CcfNonDepIllumDoorHnd "CCF Parameter - NonDepIllumDoorHnd

MDF - 0x5C75";
CM_ SG_ 1024 CcfPersonalisation "Car COnfiguration Parameter 639 - Personalisation

Payload MDF: 0x5C35
";
CM_ SG_ 1024 CcfRow2PassengerID "CCF Parameter - Row2PassengerID

MDF - 0x5C32";
CM_ SG_ 1024 CcfRow3PassengerID "CCF Parameter - Row3PassengerID

MDF - 0x5C42";
CM_ SG_ 1024 CcfSmartExitFntDrvDr "CCF - SmartExitFntDrvDr 

MDF 0x5C81
";
CM_ SG_ 1024 CcfSmartExitFntPassDoor "CCF - SmartExitFntPassDoor 

 MDF 0x5C83
";
CM_ SG_ 1024 CcfSmartExitRrDrvDoor "CCF - SmartExitRrDrvDoor 

MDF 0x5C85
";
CM_ SG_ 1024 CcfSmartExitRrPassDoor "CCF - SmartExitRrPassDoor 

MDF 0x5C87
";
CM_ SG_ 1024 CcfTransCalIndex "Car Configuration Parameter - TransCalibrationIndex

Payload MDF = 0x5C67";
CM_ SG_ 1024 CcfChargingInlet1 "CCF Parameter - ChargingInlet1

MDF - 0x5D43";
CM_ SG_ 1024 CcfChargingInlet2 "CCF Parameter - ChargingInlet2

MDF - 0x5D47";
CM_ SG_ 1024 CcfEMMaxDurEngOff "Car Configuration - EMMaxDurEngOff

MDF: 0x5D67";
CM_ SG_ 1024 CcfFMMaxFuelAge "Car Configuration - FMMaxFuelAge

MDF = 0x5D77";
CM_ SG_ 1024 CcfFntPassWdowSwtchPk "CCF Parameter Name - FntPassWdowSwtchpk

Payload MDF = 0x5D27";
CM_ SG_ 1024 CcfFrntDrvWdowSwtchpk "CCF Parameter - FrntDrvWdowSwtchpk

MDF - 0x5D23";
CM_ SG_ 1024 CcfMicrophoneType "CCF Parameter - MicrophoneType

MDF - 0x5D53";
CM_ SG_ 1024 CcfRrDrWdowSwtchPk "CCF Parameter - RrDrvWdowSwtchpk

MDF - 0x5D33";
CM_ SG_ 1024 CcfRrPassWdowSwtchpk "CCF Parameter - RrPassWdowSwtchpk

MDF - 0x5D37";
CM_ SG_ 1024 CcfSelectStateCharge "CCF Parameter - SelectStateCharge

MDF - 0x5D87";
CM_ SG_ 1024 CcfTelematicsSpkrType "CCF Parameter - TelematicsSpkrType

MDF - 0x5D57";
CM_ SG_ 1024 CcfTimedChrgFeature "CCF Parameter - TimedChrgFeature

MDF - 0x5D82";
CM_ SG_ 1024 CcfWirelessCharger "Car Configuration Parameter - WirelessCharger
MDF = 0x5D85";
CM_ SG_ 1024 CcfActiveExhaustButtonType "CCF Parameter - ActiveExhaustButtonType

MDF - 0x6147";
CM_ SG_ 1024 CcfAFS123 "CCF Parameter - AFS123

MDF - 0x6137";
CM_ SG_ 1024 CcfBrakePadTypeFront "Car Configuration - BrakePadTypeFront

MDF = 0x6154";
CM_ SG_ 1024 CcfBrakePadTypeRear "Car Configuration - BrakePadTypeRear

MDF = 0x6144";
CM_ SG_ 1024 CcfElectricDrivePower "Car configuration Parameter - Electric Drive Power

Payload MDF = 0x6163";
CM_ SG_ 1024 CcfEMSMktCal "Car configuration - EMSMktCal

Payload MDF = 0x6135";
CM_ SG_ 1024 CcfHeadlightsVariant "CCF Parameter - HeadlightsVariant

MDF - 0x6187";
CM_ SG_ 1024 CcfHitchAssistTowbar "CCF Parameter Name - HitchAssistTowbar

MDF 0x6177";
CM_ SG_ 1024 CcfMildHybridType "Car Configuration Parameter - Mild Hybrid Type

Payload MDF = 0x6167";
CM_ SG_ 1024 CcfSlcCallList "CCF Parameter - SlcCallList

MDF - 0x6132";
CM_ SG_ 1024 CcfSlcDeviceReminder "CCF Parameter - SlcDeviceReminder

MDF - 0x6125";
CM_ SG_ 1024 CcfSlcMediaSource "CCF Parameter - SlcMediaSource

MDF - 0x6122";
CM_ SG_ 1024 CcfSurroundMode "CCF Parameter - SurroundMode

MDF - 0x6157";
CM_ SG_ 1024 CcfTRUserInputMethod "CCF Parameter - TRUserInputMethod

MDF - 0x6127";
CM_ SG_ 1024 CcfAskOnExit "CCF Parameter - AskOnExit

MDF - 0x6253";
CM_ SG_ 1024 CcfBacklightStratSel "CCF Parameter - BacklightStratSel

MDF - 0x6237";
CM_ SG_ 1024 CcfBodyKitStyle "CCF Parameter - BodyKitStyle

MDF - 0x6223";
CM_ SG_ 1024 CcfClearExitDetectionSystem "CCF Parameter - ClearExitDetectionSystem

MDF - 0x6225";
CM_ SG_ 1024 CcfDriveAssist "CCF Parameter - DriveAssist

MDF - 0x6235";
CM_ SG_ 1024 CcfDriverHeatedCalfRest "CCF for Heated Calf rest fittment
MDF = 0x6274";
CM_ SG_ 1024 CcfDynamicLiteMode "CCF Parameter - DynamicLiteMode

MDF - 0x6247";
CM_ SG_ 1024 CcfEngineNoiseCancel "CCF Parameter - EngineNoiseCancel

MDF - 0x6255";
CM_ SG_ 1024 CcfFront23BuckSwitch "Car Configuration - Front23BuckSwitch

Payload MDF = 0x6251";
CM_ SG_ 1024 CcfHeatedDoorArmrest "CCF for Heated Door Armrests

Payload MDF value = 0x6262";
CM_ SG_ 1024 CcfHeatedMapPocket "CCF for Heated Map pocket

MDF value = 0x6281";
CM_ SG_ 1024 CcfHtdFrntCntreArmrst "Car Configuration - HtdFntCntreArmrst

MDF 0x6265";
CM_ SG_ 1024 CcfHtdRearCntreArmrst "Car Configuration - HtdRearCntreArmrst

MDF value = 0x6272";
CM_ SG_ 1024 CcfIntelEmrgBrkingCAEB "CCF Parameter - IntelEmrgBrkingCAEB

MDF - 0x6257";
CM_ SG_ 1024 CcfLowerGloveBox "CCF Parameter - LowerGloveBox

MDF - 0x6287";
CM_ SG_ 1024 CcfRow3BuckleSwitch "CCF Parameter - Row3BuckleSwitch

MDF - 0x6267";
CM_ SG_ 1024 CcfSAPServerType "CCF Parameter - SAPServerType

MDF - 0x6242";
CM_ SG_ 1024 CcfSeatTherm2ndRowHMIControl "CCF Parameter - SeatTherm2ndRowHMIControl

MDF - 0x6244";
CM_ SG_ 1024 CcfSuspensionType "CCF Parameter - SuspensionType

MDF - 0x6233";
CM_ SG_ 1024 CcfTaskLightingTLMA "CCF Parameter - TaskLightingTLMA

MDF - 0x6227";
CM_ SG_ 1024 CcfUpperGloveBox "CCF Parameter - UpperGloveBox

MDF - 0x6284";
CM_ SG_ 1024 CcfUWBPEPSRANGEADJUSTUSEVSA "CCF Parameter - UWBPEPSRANGEADJUSTUSEVSA

MDF - 0x6277";
CM_ SG_ 1024 CcfATCMAirSusSwitches "CCF Parameter - ATCMAirSusSwitches

MDF - 0x6453";
CM_ SG_ 1024 CcfATCMATPCSwitch "CCF Parameter - ATCMATPCSwitch

MDF - 0x6455";
CM_ SG_ 1024 CcfATCMAutoTRMdSwitch "CCF Parameter - ATCMAutoTRMdSwitch

MDF - 0x6443";
CM_ SG_ 1024 CcfATCMDSCOffSwitch "CCF Parameter - ATCMDSCOffSwitch

MDF - 0x6447";
CM_ SG_ 1024 CcfATCMEVSwitch "CCF Parameter - ATCMEVSwitch

MDF - 0x6461";
CM_ SG_ 1024 CcfATCMHDCSwitch "CCF Parameter - ATCMHDCSwitch

MDF - 0x6451";
CM_ SG_ 1024 CcfATCMLoRangeSwitch "CCF Parameter - ATCMLoRangeSwitch

MDF - 0x6457";
CM_ SG_ 1024 CcfATCMRotarySwitch "CCF Parameter - ATCMRotarySwitch

MDF - 0x6441";
CM_ SG_ 1024 CcfATCMTA2Switch "CCF Parameter Name - ATCMTA2Switch

MDF 0x6445";
CM_ SG_ 1024 CcfCamForwardAlert "CCF Parameter - CamForwardAlert

MDF - 0x6427";
CM_ SG_ 1024 CcfCDMDynamicHandling "CCF Parameter - CDMDynamicHandling

MDF - 0x6424";
CM_ SG_ 1024 CcfChgPortFlpInhibit "CCF Parameter - ChgPortFlpInhibit

MDF - 0x6463";
CM_ SG_ 1024 CcfClimateZonalControl "CCF Parameter for Climate Zonal Control

Payload MDF = 0x6465";
CM_ SG_ 1024 CcfDisplay2ndRowBlowerSpeed "CCF Parameter - Display2ndRowBlowerSpeed

MDF - 0x6475";
CM_ SG_ 1024 CcfDisplayFrontBlowerSpeed "CCF Parameter - DisplayFrontBlowerSpeed

MDF - 0x6472";
CM_ SG_ 1024 CcfEHznLongHznImpl "CCF Parameter - EHznLongHznImpl

MDF - 0x6482";
CM_ SG_ 1024 CcfELKARE "CCF Parameter - ELKARE

MDF - 0x6477";
CM_ SG_ 1024 CcfGearRatioSpread "Car Configuration - Gear Ratio Spread

MDF 0x6437";
CM_ SG_ 1024 CcfRadarForwardAlert "CCF Parameter - RadarForwardAlert

MDF - 0x6422";
CM_ SG_ 1024 CcfRHSWSBusSelection "CCF Parameter - RHSWSBusSelection

MDF - 0x6467";
CM_ SG_ 1024 CcfSpoilerSpecialFunc "CCF Parameter - SpoilerSpecialFunc

MDF - 0x6485";
CM_ SG_ 1024 CcfUWBPEPSENDISONLYUSEVSA "CCF Parameter - UWBPEPSENDISONLYUSEVSA

MDF - 0x6487";
CM_ SG_ 1024 CcfACCAccelProfileSelect "CCF Parameter - ACCAccelProfileSelect

MDF - 0x6665";
CM_ SG_ 1024 CcfACCLeadCarDistDisp "CCF Parameter - ACCLeadCarDistDisp

MDF - 0x6661";
CM_ SG_ 1024 CcfACCStopGapSelect "CCF Parameter - ACCStopGapSelect

MDF - 0x6663";
CM_ SG_ 1024 CcfAdasDCR "CCF Parameter - AdasDCR

MDF - 0x6673";
CM_ SG_ 1024 CcfAdasLongCRA "CCF Parameter - AdasLongCRA

MDF - 0x6621";
CM_ SG_ 1024 CcfAdasLongRPC "CCF Parameter - AdasLongRPC

MDF - 0x6623";
CM_ SG_ 1024 CcfAdasNCapCyclistAEB "CCF Parameter - AdasNCapCyclistAEB

MDF - 0x6633";
CM_ SG_ 1024 CcfAdasTJP "CCF Parameter - AdasTJP

MDF - 0x6635";
CM_ SG_ 1024 CcfAutoHold "CCF Parameter to enable or disable Hydraulic Vehicle Hold

MDF = 0x6653";
CM_ SG_ 1024 CcfDSMFitment "CCF Parameter - DSMFitment

MDF - 0x6637";
CM_ SG_ 1024 CcfESSCalNo "CCF Parameter - ESSCalNo

MDF - 0x6687";
CM_ SG_ 1024 CcfIntMirrorVariant "CCF Parameter - IntMirrorVariant

MDF - 0x6657";
BA_DEF_ BO_  "GenMsgCycleTime" FLOAT 0 300000;
BA_DEF_ BO_  "GenMsgDelayTime" FLOAT 0 300000;
BA_DEF_ BO_  "GenMsgSendType" ENUM  "cyclic","spontaneous","cyclicIfActive","spontaneousWithDelay","cyclicAndSpontaneous","cyclicAndSpontaneousWithDelay","IfActive","NoMsgSendType";
BA_DEF_ BO_  "GenMsgStartDelayTime" FLOAT 0 300000;
BA_DEF_ SG_  "GenSigSendType" ENUM  "Cyclic","OnWrite","OnWriteWithRepetition","OnChange","OnChangeWithRepetition","IfActive","IfActiveWithRepetition","NoSigSendType";
BA_DEF_ SG_  "GenSigStartValue" FLOAT -1.79769313486232E+308 1.84467440737096E+019;
BA_DEF_ BO_  "SystemMessageLongSymbol" STRING ;
BA_DEF_DEF_  "GenMsgCycleTime" 0;
BA_DEF_DEF_  "GenMsgDelayTime" 0;
BA_DEF_DEF_  "GenMsgSendType" "cyclic";
BA_DEF_DEF_  "GenMsgStartDelayTime" 0;
BA_DEF_DEF_  "GenSigSendType" "Cyclic";
BA_DEF_DEF_  "GenSigStartValue" 0;
BA_DEF_DEF_  "SystemMessageLongSymbol" "";
BA_ "GenSigSendType" SG_ 1024 CcfTyreCircumference 1;
BA_ "GenSigSendType" SG_ 1024 CcfBrand 1;
BA_ "GenSigSendType" SG_ 1024 CcfFreqRemoteControls 1;
BA_ "GenSigSendType" SG_ 1024 CcfHeatedWindscreen 1;
BA_ "GenSigSendType" SG_ 1024 CcfHillDescentControl 1;
BA_ "GenSigSendType" SG_ 1024 CcfParkingAssistance 1;
BA_ "GenSigSendType" SG_ 1024 CcfParkingBrakeType 1;
BA_ "GenSigSendType" SG_ 1024 CcfSafetyBeltReminder 1;
BA_ "GenSigSendType" SG_ 1024 CcfBodyStyle 1;
BA_ "GenSigSendType" SG_ 1024 CcfEmissionStandard 1;
BA_ "GenSigSendType" SG_ 1024 CcfGlassType 1;
BA_ "GenSigSendType" SG_ 1024 CcfOctaneRating 1;
BA_ "GenSigSendType" SG_ 1024 CcfRearAirConditioning 1;
BA_ "GenSigSendType" SG_ 1024 CcfRoofTyp 1;
BA_ "GenSigSendType" SG_ 1024 CcfTyreDimension 1;
BA_ "GenSigSendType" SG_ 1024 Ccf12VoltOutletLuggage 1;
BA_ "GenSigSendType" SG_ 1024 CcfELVacuumPumpRrBooster 1;
BA_ "GenSigSendType" SG_ 1024 CcfOilLevelSensor 1;
BA_ "GenSigSendType" SG_ 1024 CcfParkAssistCamera 1;
BA_ "GenSigSendType" SG_ 1024 CcfRollStabilityControl 1;
BA_ "GenSigSendType" SG_ 1024 CcfTyrePressureModeSystem 1;
BA_ "GenSigSendType" SG_ 1024 CcfWheelBrakesTypeRear 1;
BA_ "GenSigSendType" SG_ 1024 CcfAudibleMislockFeedback 1;
BA_ "GenSigSendType" SG_ 1024 CcfAutoRelocking 1;
BA_ "GenSigSendType" SG_ 1024 CcfPowerHeatedMirrors 1;
BA_ "GenSigSendType" SG_ 1024 CcfRearGlazing 1;
BA_ "GenSigSendType" SG_ 1024 CcfRearWashWipe 1;
BA_ "GenSigSendType" SG_ 1024 CcfRoofHeight 1;
BA_ "GenSigSendType" SG_ 1024 CcfZonalOppositeDoorRelock 1;
BA_ "GenSigSendType" SG_ 1024 CcfAccessoryUSBUnit 1;
BA_ "GenSigSendType" SG_ 1024 CcfAirQualitySensor 1;
BA_ "GenSigSendType" SG_ 1024 CcfConfigurableUnlocking 1;
BA_ "GenSigSendType" SG_ 1024 CcfEmissionEvaporationSys 1;
BA_ "GenSigSendType" SG_ 1024 CcfExternalAlarmUnitSupply 1;
BA_ "GenSigSendType" SG_ 1024 CcfHeadrestsRearFolding 1;
BA_ "GenSigSendType" SG_ 1024 CcfHomesafeLighting 1;
BA_ "GenSigSendType" SG_ 1024 CcfACCompressorType 1;
BA_ "GenSigSendType" SG_ 1024 CcfAdaptiveLoadLimiterFnt 1;
BA_ "GenSigSendType" SG_ 1024 CcfBluetoothHandsfree 1;
BA_ "GenSigSendType" SG_ 1024 CcfOccupantWeightSensor 1;
BA_ "GenSigSendType" SG_ 1024 CcfPyroTechSteeringColumn 1;
BA_ "GenSigSendType" SG_ 1024 CcfRearBeltDetection 1;
BA_ "GenSigSendType" SG_ 1024 CcfTrafficInformation 1;
BA_ "GenSigSendType" SG_ 1024 CcfAsthmaAndAllergy 1;
BA_ "GenSigSendType" SG_ 1024 CcfDampSensor 1;
BA_ "GenSigSendType" SG_ 1024 CcfDoorHandleTechnology 1;
BA_ "GenSigSendType" SG_ 1024 CcfNeutralControlAutoGear 1;
BA_ "GenSigSendType" SG_ 1024 CcfRPMSpeedController 1;
BA_ "GenSigSendType" SG_ 1024 CcfSelfOpeningBootlid 1;
BA_ "GenSigSendType" SG_ 1024 CcfShiftIndication 1;
BA_ "GenSigSendType" SG_ 1024 CcfClimateZoneUserLayout 1;
BA_ "GenSigSendType" SG_ 1024 CcfEcoInfoSystem 1;
BA_ "GenSigSendType" SG_ 1024 CcfNightVision 1;
BA_ "GenSigSendType" SG_ 1024 CcfReverseGearChime 1;
BA_ "GenSigSendType" SG_ 1024 CcfSolarSensor 1;
BA_ "GenSigSendType" SG_ 1024 CcfTelematics 1;
BA_ "GenSigSendType" SG_ 1024 CcfTelematicsProtection 1;
BA_ "GenSigSendType" SG_ 1024 CcfAutoSpeedLimiter 1;
BA_ "GenSigSendType" SG_ 1024 CcfHeadUpDisplay 1;
BA_ "GenSigSendType" SG_ 1024 CcfIGORSystemDescription 1;
BA_ "GenSigSendType" SG_ 1024 CcfLanguageRegion 1;
BA_ "GenSigSendType" SG_ 1024 CcfSideCamera 1;
BA_ "GenSigSendType" SG_ 1024 CcfStopStart 1;
BA_ "GenSigSendType" SG_ 1024 CcfTrailerTyrePressMonSys 1;
BA_ "GenSigSendType" SG_ 1024 Ccf4x4InfoDisplay 1;
BA_ "GenSigSendType" SG_ 1024 CcfAdvancedChauffeurFunc 1;
BA_ "GenSigSendType" SG_ 1024 CcfAudibleAlarmMode 1;
BA_ "GenSigSendType" SG_ 1024 CcfCrashEventDataRec 1;
BA_ "GenSigSendType" SG_ 1024 CcfDoorLatchType 1;
BA_ "GenSigSendType" SG_ 1024 CcfLowSpdIntEmergBrake 1;
BA_ "GenSigSendType" SG_ 1024 CcfModelYear 1;
BA_ "GenSigSendType" SG_ 1024 CcfActiveRollControl 1;
BA_ "GenSigSendType" SG_ 1024 CcfAuxillaryWaterPump 1;
BA_ "GenSigSendType" SG_ 1024 CcfConversationAssist 1;
BA_ "GenSigSendType" SG_ 1024 CcfNavECORouteExtraUrban 1;
BA_ "GenSigSendType" SG_ 1024 CcfNavECORouteUrban 1;
BA_ "GenSigSendType" SG_ 1024 CcfPartNumberFormat 1;
BA_ "GenSigSendType" SG_ 1024 CcfTrsferBxCntrllrType 1;
BA_ "GenSigSendType" SG_ 1024 CcfCameraHMIStrategy 1;
BA_ "GenSigSendType" SG_ 1024 CcfDeplBatterySystem 1;
BA_ "GenSigSendType" SG_ 1024 CcfDriverBuckleSwitch 1;
BA_ "GenSigSendType" SG_ 1024 CcfDriverKneeAirbag 1;
BA_ "GenSigSendType" SG_ 1024 CcfDriverPassBeltPret 1;
BA_ "GenSigSendType" SG_ 1024 CcfDriverSwtchLdLimit 1;
BA_ "GenSigSendType" SG_ 1024 CcfEventDataRecorder 1;
BA_ "GenSigSendType" SG_ 1024 CcfFntDIFbdkMech 1;
BA_ "GenSigSendType" SG_ 1024 CcfInfotainmentType 1;
BA_ "GenSigSendType" SG_ 1024 CcfLeftCurtainAirbag 1;
BA_ "GenSigSendType" SG_ 1024 CcfLeftRearHeadAbag 1;
BA_ "GenSigSendType" SG_ 1024 CcfLeftSideAirbag 1;
BA_ "GenSigSendType" SG_ 1024 CcfmPACOS 1;
BA_ "GenSigSendType" SG_ 1024 CcfPADLamp 1;
BA_ "GenSigSendType" SG_ 1024 CcfPassBuckleSwitch 1;
BA_ "GenSigSendType" SG_ 1024 CcfPassOccWghtSensor 1;
BA_ "GenSigSendType" SG_ 1024 CcfRightCurtainAirbag 1;
BA_ "GenSigSendType" SG_ 1024 CcfRightRearHeadAbag 1;
BA_ "GenSigSendType" SG_ 1024 CcfRightSideAirbag 1;
BA_ "GenSigSendType" SG_ 1024 CcfRollOverSensing 1;
BA_ "GenSigSendType" SG_ 1024 CcfThirdRowChiller 1;
BA_ "GenSigSendType" SG_ 1024 CcfTrunkLmpOutput 1;
BA_ "GenSigSendType" SG_ 1024 CcfWindowCalibration 1;
BA_ "GenSigSendType" SG_ 1024 CcfWindowOpFeedback 1;
BA_ "GenSigSendType" SG_ 1024 CcfATPC 1;
BA_ "GenSigSendType" SG_ 1024 CcfBCMCtrlAmbLitSet 1;
BA_ "GenSigSendType" SG_ 1024 CcfBumperType 1;
BA_ "GenSigSendType" SG_ 1024 CcfDLNAStatus 1;
BA_ "GenSigSendType" SG_ 1024 CcfDriverFrontAirbag 1;
BA_ "GenSigSendType" SG_ 1024 CcfDriverPassRetractor 1;
BA_ "GenSigSendType" SG_ 1024 CcfDRLMLSInteraction 1;
BA_ "GenSigSendType" SG_ 1024 CcfDRLTransInteraction 1;
BA_ "GenSigSendType" SG_ 1024 CcfGracenotes 1;
BA_ "GenSigSendType" SG_ 1024 CcfLowBeamFdbkMech 1;
BA_ "GenSigSendType" SG_ 1024 CcfMainBeamFdbkMech 1;
BA_ "GenSigSendType" SG_ 1024 CcfPassFrontAirbag 1;
BA_ "GenSigSendType" SG_ 1024 CcfPwrTailProxSenPAM 1;
BA_ "GenSigSendType" SG_ 1024 CcfQRBPowerPAM 1;
BA_ "GenSigSendType" SG_ 1024 CcfRemoteStartCapable 1;
BA_ "GenSigSendType" SG_ 1024 CcfStealthMode 1;
BA_ "GenSigSendType" SG_ 1024 CcfTPMSVariant 1;
BA_ "GenSigSendType" SG_ 1024 CcfCHMSLProfile 1;
BA_ "GenSigSendType" SG_ 1024 CcfDrvDrowsyMonDDM 1;
BA_ "GenSigSendType" SG_ 1024 CcfExtSyntheticSounder 1;
BA_ "GenSigSendType" SG_ 1024 CcfFntDIProfile 1;
BA_ "GenSigSendType" SG_ 1024 CcfFntDRLProfile 1;
BA_ "GenSigSendType" SG_ 1024 CcfFntPosProfile 1;
BA_ "GenSigSendType" SG_ 1024 CcfFntSMProfile 1;
BA_ "GenSigSendType" SG_ 1024 CcfFwdCollWarnAEB 1;
BA_ "GenSigSendType" SG_ 1024 CcfIntelEmerBrkingCUIEB 1;
BA_ "GenSigSendType" SG_ 1024 CcfISLFitment 1;
BA_ "GenSigSendType" SG_ 1024 CcfNavBtnFCIM 1;
BA_ "GenSigSendType" SG_ 1024 CcfNLIAudioAmp 1;
BA_ "GenSigSendType" SG_ 1024 CcfP4UBtnFACP 1;
BA_ "GenSigSendType" SG_ 1024 CcfPassAirbagVent 1;
BA_ "GenSigSendType" SG_ 1024 CcfPCMEWULine 1;
BA_ "GenSigSendType" SG_ 1024 CcfRowTwoSquabRelAct 1;
BA_ "GenSigSendType" SG_ 1024 CcfTrajectoryLines 1;
BA_ "GenSigSendType" SG_ 1024 CcfCDiffType 1;
BA_ "GenSigSendType" SG_ 1024 CcfChauPersonalisation 1;
BA_ "GenSigSendType" SG_ 1024 CcfConnectInfoStatus 1;
BA_ "GenSigSendType" SG_ 1024 CcfDistribPlayback 1;
BA_ "GenSigSendType" SG_ 1024 CcfEDTType 1;
BA_ "GenSigSendType" SG_ 1024 CcfElecDepTowBar 1;
BA_ "GenSigSendType" SG_ 1024 CcfFntOptDiskDrive 1;
BA_ "GenSigSendType" SG_ 1024 CcfFuelPumpType 1;
BA_ "GenSigSendType" SG_ 1024 CcfGliding 1;
BA_ "GenSigSendType" SG_ 1024 CcfICCFitment 1;
BA_ "GenSigSendType" SG_ 1024 CcfIntStoreIMC 1;
BA_ "GenSigSendType" SG_ 1024 CcfIntStoreISC 1;
BA_ "GenSigSendType" SG_ 1024 CcfLaneKeepAssistLKA 1;
BA_ "GenSigSendType" SG_ 1024 CcfNGINLIDigRadRecSys 1;
BA_ "GenSigSendType" SG_ 1024 CcfNoseLoadMeasure 1;
BA_ "GenSigSendType" SG_ 1024 CcfPDCBtnFCIM 1;
BA_ "GenSigSendType" SG_ 1024 CcfTCUConnectivity 1;
BA_ "GenSigSendType" SG_ 1024 CcfTrailerLightMod 1;
BA_ "GenSigSendType" SG_ 1024 CcfTRMFitment 1;
BA_ "GenSigSendType" SG_ 1024 CcfAirIonizer 1;
BA_ "GenSigSendType" SG_ 1024 CcfAutoAccessHeight 1;
BA_ "GenSigSendType" SG_ 1024 CcfCameraBtnFCIM 1;
BA_ "GenSigSendType" SG_ 1024 CcfClusterAlertGFX 1;
BA_ "GenSigSendType" SG_ 1024 CcfDepSideSteps 1;
BA_ "GenSigSendType" SG_ 1024 CcfDriverDoorLock 1;
BA_ "GenSigSendType" SG_ 1024 CcfDSSOffRoadOperation 1;
BA_ "GenSigSendType" SG_ 1024 CcfDualViewBtnFCIM 1;
BA_ "GenSigSendType" SG_ 1024 CcfECOmodeText 1;
BA_ "GenSigSendType" SG_ 1024 CcfKeyFobTechnology 1;
BA_ "GenSigSendType" SG_ 1024 CcfPassDoorLock 1;
BA_ "GenSigSendType" SG_ 1024 CcfPedProtectSystem 1;
BA_ "GenSigSendType" SG_ 1024 CcfRearExitDetect 1;
BA_ "GenSigSendType" SG_ 1024 CcfRestrictSunroofOpen 1;
BA_ "GenSigSendType" SG_ 1024 CcfRLPassDoorLock 1;
BA_ "GenSigSendType" SG_ 1024 CcfRRPassDoorLock 1;
BA_ "GenSigSendType" SG_ 1024 CcfSoftCloseDoors 1;
BA_ "GenSigSendType" SG_ 1024 CcfSunGblClTelLock 1;
BA_ "GenSigSendType" SG_ 1024 CcfTelLock 1;
BA_ "GenSigSendType" SG_ 1024 CcfTelUnlock 1;
BA_ "GenSigSendType" SG_ 1024 CcfTrailerLightTest 1;
BA_ "GenSigSendType" SG_ 1024 CcfVehicleLocator 1;
BA_ "GenSigSendType" SG_ 1024 CcfWalkAwayLocking 1;
BA_ "GenSigSendType" SG_ 1024 CcfWinGblClTelLock 1;
BA_ "GenSigSendType" SG_ 1024 CcfColmnRetractOpenLoad 1;
BA_ "GenSigSendType" SG_ 1024 CcfColmnUpRetractOpenLoad 1;
BA_ "GenSigSendType" SG_ 1024 CcfComfortPlus 1;
BA_ "GenSigSendType" SG_ 1024 CcfEasyEntExtSetMenu 1;
BA_ "GenSigSendType" SG_ 1024 CcfeCallhydrogenStorage 1;
BA_ "GenSigSendType" SG_ 1024 CcfeCallotherPropStorage 1;
BA_ "GenSigSendType" SG_ 1024 CcfEcoModeButtonFit 1;
BA_ "GenSigSendType" SG_ 1024 CcfExtLghtTellTaleCol 1;
BA_ "GenSigSendType" SG_ 1024 CcfHeatWasherOpenLoad 1;
BA_ "GenSigSendType" SG_ 1024 CcfIgnition1OpenLoad 1;
BA_ "GenSigSendType" SG_ 1024 CcfIgnition2OpenLoad 1;
BA_ "GenSigSendType" SG_ 1024 CcfIgnition3OpenLoad 1;
BA_ "GenSigSendType" SG_ 1024 CcfIgnition4OpenLoad 1;
BA_ "GenSigSendType" SG_ 1024 CcfIgnition5OpenLoad 1;
BA_ "GenSigSendType" SG_ 1024 CcfIgnition6OpenLoad 1;
BA_ "GenSigSendType" SG_ 1024 CcfIgnition7OpenLoad 1;
BA_ "GenSigSendType" SG_ 1024 CcfIgnition8OpenLoad 1;
BA_ "GenSigSendType" SG_ 1024 CcfIMCFanAssyAuxCooling 1;
BA_ "GenSigSendType" SG_ 1024 CcfLampSupplyRightOpenLoad 1;
BA_ "GenSigSendType" SG_ 1024 CcfParkAidECUOpenLoad 1;
BA_ "GenSigSendType" SG_ 1024 CcfScreenSurroundSwitch 1;
BA_ "GenSigSendType" SG_ 1024 CcfAutoAccess 1;
BA_ "GenSigSendType" SG_ 1024 CcfCoolingFanFitment 1;
BA_ "GenSigSendType" SG_ 1024 CcfDriverMemDrSwtchPk 1;
BA_ "GenSigSendType" SG_ 1024 CcfEDiffType 1;
BA_ "GenSigSendType" SG_ 1024 CcfGenericEngPwrOut 1;
BA_ "GenSigSendType" SG_ 1024 CcfHdlampLvlSensPos 1;
BA_ "GenSigSendType" SG_ 1024 CcfLRTerrainJGAllRdLaunch 1;
BA_ "GenSigSendType" SG_ 1024 CcfPassMemDrSwtchPk 1;
BA_ "GenSigSendType" SG_ 1024 CcfPTCruiseFitment 1;
BA_ "GenSigSendType" SG_ 1024 CcfRearDriverMemDrSwtchPk 1;
BA_ "GenSigSendType" SG_ 1024 CcfRearlampType 1;
BA_ "GenSigSendType" SG_ 1024 CcfRearPassMemDrSwtchPk 1;
BA_ "GenSigSendType" SG_ 1024 CcfSpdoCalkmhOffset 1;
BA_ "GenSigSendType" SG_ 1024 CcfSpdoCalPercentScale 1;
BA_ "GenSigSendType" SG_ 1024 CcfSteerWlhlSwtchType 1;
BA_ "GenSigSendType" SG_ 1024 CcfTowAssist 1;
BA_ "GenSigSendType" SG_ 1024 CcfTPMSCalibration 1;
BA_ "GenSigSendType" SG_ 1024 CcfActSndDesignPwrlvl 1;
BA_ "GenSigSendType" SG_ 1024 CcfDoorBodyStyle 1;
BA_ "GenSigSendType" SG_ 1024 CcfDrivenWheels 1;
BA_ "GenSigSendType" SG_ 1024 CcfFinalDriveRatioComp 1;
BA_ "GenSigSendType" SG_ 1024 CcfNextGenPwrTrnSQ 1;
BA_ "GenSigSendType" SG_ 1024 CcfNextGenPwrTrnSQCalNo 1;
BA_ "GenSigSendType" SG_ 1024 CcfPanoramicRoof 1;
BA_ "GenSigSendType" SG_ 1024 CcfPetrolEMSEmissMkt 1;
BA_ "GenSigSendType" SG_ 1024 CcfBrakeDiscMaterial 1;
BA_ "GenSigSendType" SG_ 1024 CcfBrakeDiscSizeFront 1;
BA_ "GenSigSendType" SG_ 1024 CcfBrakeDiscSizeRear 1;
BA_ "GenSigSendType" SG_ 1024 CcfElectricFan 1;
BA_ "GenSigSendType" SG_ 1024 CcfRearDriverLinSWP 1;
BA_ "GenSigSendType" SG_ 1024 CcfRearPassLinSWP 1;
BA_ "GenSigSendType" SG_ 1024 CcfServiceInterval 1;
BA_ "GenSigSendType" SG_ 1024 CcfSportbrake 1;
BA_ "GenSigSendType" SG_ 1024 CcfTyreDynamicRollRad 1;
BA_ "GenSigSendType" SG_ 1024 CcfEnginePowerOutputkW 1;
BA_ "GenSigSendType" SG_ 1024 CcfFuelTimeToService 1;
BA_ "GenSigSendType" SG_ 1024 CcfHybridType 1;
BA_ "GenSigSendType" SG_ 1024 CcfPDC 1;
BA_ "GenSigSendType" SG_ 1024 CcfTyreSizeCorrnFac 1;
BA_ "GenSigSendType" SG_ 1024 CcfBrakeWarningSymbol 1;
BA_ "GenSigSendType" SG_ 1024 CcfChassisDescription 1;
BA_ "GenSigSendType" SG_ 1024 CcfConfigDynamicMode 1;
BA_ "GenSigSendType" SG_ 1024 CcfGearboxdescription 1;
BA_ "GenSigSendType" SG_ 1024 ccfGenericWheelBase 1;
BA_ "GenSigSendType" SG_ 1024 CcfPTAODieWaterInSensr 1;
BA_ "GenSigSendType" SG_ 1024 CcfReverseGearSelStrat 1;
BA_ "GenSigSendType" SG_ 1024 CcfTransmissionSelectr 1;
BA_ "GenSigSendType" SG_ 1024 CcfVINPart1 1;
BA_ "GenSigSendType" SG_ 1024 CcfVINPart2 1;
BA_ "GenSigSendType" SG_ 1024 CcfFntClusterCableLgth 1;
BA_ "GenSigSendType" SG_ 1024 CcfFntDispCableLgth 1;
BA_ "GenSigSendType" SG_ 1024 CcfVINPart3 1;
BA_ "GenSigSendType" SG_ 1024 CcfAdaptDrvBeam 1;
BA_ "GenSigSendType" SG_ 1024 CcfAquaBladeFitted 1;
BA_ "GenSigSendType" SG_ 1024 CcfAquaBladeWashDir 1;
BA_ "GenSigSendType" SG_ 1024 CcfAutoBlindEnabled 1;
BA_ "GenSigSendType" SG_ 1024 CcfAutolightSensorFit 1;
BA_ "GenSigSendType" SG_ 1024 CcfBodyStyleSeatLayout 1;
BA_ "GenSigSendType" SG_ 1024 CcfCDiffBknHalfShfDet 1;
BA_ "GenSigSendType" SG_ 1024 CcfCDiffRangeChgType 1;
BA_ "GenSigSendType" SG_ 1024 CcfDriverIDCamera 1;
BA_ "GenSigSendType" SG_ 1024 CcfFntAnimatedIndicator 1;
BA_ "GenSigSendType" SG_ 1024 CcfGestureBlindFront 1;
BA_ "GenSigSendType" SG_ 1024 CcfGrillActiveVanes 1;
BA_ "GenSigSendType" SG_ 1024 CcfHeatedWasherJets 1;
BA_ "GenSigSendType" SG_ 1024 CcfHeightInputSelection 1;
BA_ "GenSigSendType" SG_ 1024 CcfLaserHighBeam 1;
BA_ "GenSigSendType" SG_ 1024 CcfMovingWindows 1;
BA_ "GenSigSendType" SG_ 1024 CcfPNChargingFunction 1;
BA_ "GenSigSendType" SG_ 1024 CcfPNFuelRefill 1;
BA_ "GenSigSendType" SG_ 1024 CcfRearAnimatedIndicator 1;
BA_ "GenSigSendType" SG_ 1024 CcfSpareWheelCarrier 1;
BA_ "GenSigSendType" SG_ 1024 CcfTowing 1;
BA_ "GenSigSendType" SG_ 1024 CcfViscousFan 1;
BA_ "GenSigSendType" SG_ 1024 CcfWiperMotorModule 1;
BA_ "GenSigSendType" SG_ 1024 CcfDieselEMSEmissMkt 1;
BA_ "GenSigSendType" SG_ 1024 CcfDriverID 1;
BA_ "GenSigSendType" SG_ 1024 CcfDriverIDKeys 1;
BA_ "GenSigSendType" SG_ 1024 CcfDriverIDPhones 1;
BA_ "GenSigSendType" SG_ 1024 CcfDriverIDSeats 1;
BA_ "GenSigSendType" SG_ 1024 CcfEcoDataGallonType 1;
BA_ "GenSigSendType" SG_ 1024 CcfFrntLowerDispKeys 1;
BA_ "GenSigSendType" SG_ 1024 CcfFrntLowerDispVariant 1;
BA_ "GenSigSendType" SG_ 1024 CcfFrntUpperDeployable 1;
BA_ "GenSigSendType" SG_ 1024 CcfFrntUpperDispVariant 1;
BA_ "GenSigSendType" SG_ 1024 CcfFrontPassengerID 1;
BA_ "GenSigSendType" SG_ 1024 CcfNGICamBanStrat 1;
BA_ "GenSigSendType" SG_ 1024 CcfNonDepIllumDoorHnd 1;
BA_ "GenSigSendType" SG_ 1024 CcfPersonalisation 1;
BA_ "GenSigSendType" SG_ 1024 CcfRow2PassengerID 1;
BA_ "GenSigSendType" SG_ 1024 CcfRow3PassengerID 1;
BA_ "GenSigSendType" SG_ 1024 CcfSmartExitFntDrvDr 1;
BA_ "GenSigSendType" SG_ 1024 CcfSmartExitFntPassDoor 1;
BA_ "GenSigSendType" SG_ 1024 CcfSmartExitRrDrvDoor 1;
BA_ "GenSigSendType" SG_ 1024 CcfSmartExitRrPassDoor 1;
BA_ "GenSigSendType" SG_ 1024 CcfTransCalIndex 1;
BA_ "GenSigSendType" SG_ 1024 CcfChargingInlet1 1;
BA_ "GenSigSendType" SG_ 1024 CcfChargingInlet2 1;
BA_ "GenSigSendType" SG_ 1024 CcfEMMaxDurEngOff 1;
BA_ "GenSigSendType" SG_ 1024 CcfFMMaxFuelAge 1;
BA_ "GenSigSendType" SG_ 1024 CcfFntPassWdowSwtchPk 1;
BA_ "GenSigSendType" SG_ 1024 CcfFrntDrvWdowSwtchpk 1;
BA_ "GenSigSendType" SG_ 1024 CcfMicrophoneType 1;
BA_ "GenSigSendType" SG_ 1024 CcfRrDrWdowSwtchPk 1;
BA_ "GenSigSendType" SG_ 1024 CcfRrPassWdowSwtchpk 1;
BA_ "GenSigSendType" SG_ 1024 CcfSelectStateCharge 1;
BA_ "GenSigSendType" SG_ 1024 CcfTelematicsSpkrType 1;
BA_ "GenSigSendType" SG_ 1024 CcfTimedChrgFeature 1;
BA_ "GenSigSendType" SG_ 1024 CcfWirelessCharger 1;
BA_ "GenSigSendType" SG_ 1024 CcfActiveExhaustButtonType 1;
BA_ "GenSigSendType" SG_ 1024 CcfAFS123 1;
BA_ "GenSigSendType" SG_ 1024 CcfBrakePadTypeFront 1;
BA_ "GenSigSendType" SG_ 1024 CcfBrakePadTypeRear 1;
BA_ "GenSigSendType" SG_ 1024 CcfElectricDrivePower 1;
BA_ "GenSigSendType" SG_ 1024 CcfEMSMktCal 1;
BA_ "GenSigSendType" SG_ 1024 CcfHeadlightsVariant 1;
BA_ "GenSigSendType" SG_ 1024 CcfHitchAssistTowbar 1;
BA_ "GenSigSendType" SG_ 1024 CcfMildHybridType 1;
BA_ "GenSigSendType" SG_ 1024 CcfSlcCallList 1;
BA_ "GenSigSendType" SG_ 1024 CcfSlcDeviceReminder 1;
BA_ "GenSigSendType" SG_ 1024 CcfSlcMediaSource 1;
BA_ "GenSigSendType" SG_ 1024 CcfSurroundMode 1;
BA_ "GenSigSendType" SG_ 1024 CcfTRUserInputMethod 1;
BA_ "GenSigSendType" SG_ 1024 CcfAskOnExit 1;
BA_ "GenSigSendType" SG_ 1024 CcfBacklightStratSel 1;
BA_ "GenSigSendType" SG_ 1024 CcfBodyKitStyle 1;
BA_ "GenSigSendType" SG_ 1024 CcfClearExitDetectionSystem 1;
BA_ "GenSigSendType" SG_ 1024 CcfDriveAssist 1;
BA_ "GenSigSendType" SG_ 1024 CcfDriverHeatedCalfRest 1;
BA_ "GenSigSendType" SG_ 1024 CcfDynamicLiteMode 1;
BA_ "GenSigSendType" SG_ 1024 CcfEngineNoiseCancel 1;
BA_ "GenSigSendType" SG_ 1024 CcfFront23BuckSwitch 1;
BA_ "GenSigSendType" SG_ 1024 CcfHeatedDoorArmrest 1;
BA_ "GenSigSendType" SG_ 1024 CcfHeatedMapPocket 1;
BA_ "GenSigSendType" SG_ 1024 CcfHtdFrntCntreArmrst 1;
BA_ "GenSigSendType" SG_ 1024 CcfHtdRearCntreArmrst 1;
BA_ "GenSigSendType" SG_ 1024 CcfIntelEmrgBrkingCAEB 1;
BA_ "GenSigSendType" SG_ 1024 CcfLowerGloveBox 1;
BA_ "GenSigSendType" SG_ 1024 CcfRow3BuckleSwitch 1;
BA_ "GenSigSendType" SG_ 1024 CcfSAPServerType 1;
BA_ "GenSigSendType" SG_ 1024 CcfSeatTherm2ndRowHMIControl 1;
BA_ "GenSigSendType" SG_ 1024 CcfSuspensionType 1;
BA_ "GenSigSendType" SG_ 1024 CcfTaskLightingTLMA 1;
BA_ "GenSigSendType" SG_ 1024 CcfUpperGloveBox 1;
BA_ "GenSigSendType" SG_ 1024 CcfUWBPEPSRANGEADJUSTUSEVSA 1;
BA_ "GenSigSendType" SG_ 1024 CcfATCMAirSusSwitches 1;
BA_ "GenSigSendType" SG_ 1024 CcfATCMATPCSwitch 1;
BA_ "GenSigSendType" SG_ 1024 CcfATCMAutoTRMdSwitch 1;
BA_ "GenSigSendType" SG_ 1024 CcfATCMDSCOffSwitch 1;
BA_ "GenSigSendType" SG_ 1024 CcfATCMEVSwitch 1;
BA_ "GenSigSendType" SG_ 1024 CcfATCMHDCSwitch 1;
BA_ "GenSigSendType" SG_ 1024 CcfATCMLoRangeSwitch 1;
BA_ "GenSigSendType" SG_ 1024 CcfATCMRotarySwitch 1;
BA_ "GenSigSendType" SG_ 1024 CcfATCMTA2Switch 1;
BA_ "GenSigSendType" SG_ 1024 CcfCamForwardAlert 1;
BA_ "GenSigSendType" SG_ 1024 CcfCDMDynamicHandling 1;
BA_ "GenSigSendType" SG_ 1024 CcfChgPortFlpInhibit 1;
BA_ "GenSigSendType" SG_ 1024 CcfClimateZonalControl 1;
BA_ "GenSigSendType" SG_ 1024 CcfDisplay2ndRowBlowerSpeed 1;
BA_ "GenSigSendType" SG_ 1024 CcfDisplayFrontBlowerSpeed 1;
BA_ "GenSigSendType" SG_ 1024 CcfEHznLongHznImpl 1;
BA_ "GenSigSendType" SG_ 1024 CcfELKARE 1;
BA_ "GenSigSendType" SG_ 1024 CcfGearRatioSpread 1;
BA_ "GenSigSendType" SG_ 1024 CcfRadarForwardAlert 1;
BA_ "GenSigSendType" SG_ 1024 CcfRHSWSBusSelection 1;
BA_ "GenSigSendType" SG_ 1024 CcfSpoilerSpecialFunc 1;
BA_ "GenSigSendType" SG_ 1024 CcfUWBPEPSENDISONLYUSEVSA 1;
BA_ "GenSigSendType" SG_ 1024 CcfACCAccelProfileSelect 1;
BA_ "GenSigSendType" SG_ 1024 CcfACCLeadCarDistDisp 1;
BA_ "GenSigSendType" SG_ 1024 CcfACCStopGapSelect 1;
BA_ "GenSigSendType" SG_ 1024 CcfAdasDCR 1;
BA_ "GenSigSendType" SG_ 1024 CcfAdasLongCRA 1;
BA_ "GenSigSendType" SG_ 1024 CcfAdasLongRPC 1;
BA_ "GenSigSendType" SG_ 1024 CcfAdasNCapCyclistAEB 1;
BA_ "GenSigSendType" SG_ 1024 CcfAdasTJP 1;
BA_ "GenSigSendType" SG_ 1024 CcfAutoHold 1;
BA_ "GenSigSendType" SG_ 1024 CcfDSMFitment 1;
BA_ "GenSigSendType" SG_ 1024 CcfESSCalNo 1;
BA_ "GenSigSendType" SG_ 1024 CcfIntMirrorVariant 1;
VAL_ 1024 CcfTyreCircumference 0 "Not supported" 1 "Rolling Circumference 1980mm" 2 "Rolling Circumference 1985mm" 3 "Rolling Circumference 1990mm" 4 "Rolling Circumference 1995mm" 5 "Rolling Circumference 2000mm" 6 "Rolling Circumference 2005mm" 7 "Rolling Circumference 2010mm" 8 "Rolling Circumference 2015mm" 9 "Rolling Circumference 2020mm" 10 "Rolling Circumference 2465mm" 11 "Rolling Circumference 2470mm" 14 "Rolling Circumference 2475mm" 15 "Rolling Circumference 2480mm" 16 "Rolling Circumference 2025mm" 17 "Rolling Circumference 2030mm" 18 "Rolling Circumference 2035mm" 19 "Rolling Circumference 2040mm" 20 "Rolling Circumference 2045mm" 21 "Rolling Circumference 2050mm" 22 "Rolling Circumference 2055mm" 23 "Rolling Circumference 2060mm" 24 "Rolling Circumference 2065mm" 25 "Rolling Circumference 2070mm" 32 "Rolling Circumference 2075mm" 33 "Rolling Circumference 2080mm" 34 "Rolling Circumference 2085mm" 35 "Rolling Circumference 2090mm" 36 "Rolling Circumference 2095mm" 37 "Rolling Circumference 2100mm" 38 "Rolling Circumference 2105mm" 39 "Rolling Circumference 2110mm" 40 "Rolling Circumference 2115mm" 41 "Rolling Circumference 2120mm" 48 "Rolling Circumference 2125mm" 49 "Rolling Circumference 2130mm" 50 "Rolling Circumference 2135mm" 51 "Rolling Circumference 2140mm" 52 "Rolling Circumference 2145mm" 53 "Rolling Circumference 2150mm" 54 "Rolling Circumference 2155mm" 55 "Rolling Circumference 2160mm" 56 "Rolling Circumference 2165mm" 57 "Rolling Circumference 2170mm" 64 "Rolling Circumference 2175mm" 65 "Rolling Circumference 2180mm" 66 "Rolling Circumference 2185mm" 67 "Rolling Circumference 2190mm" 68 "Rolling Circumference 2195mm" 69 "Rolling Circumference 2200mm" 70 "Rolling Circumference 2205mm" 71 "Rolling Circumference 2210mm" 72 "Rolling Circumference 2215mm" 73 "Rolling Circumference 2220mm" 80 "Rolling Circumference 2225mm" 81 "Rolling Circumference 2230mm" 82 "Rolling Circumference 2235mm" 83 "Rolling Circumference 2240mm" 84 "Rolling Circumference 2245mm" 85 "Rolling Circumference 2250mm" 86 "Rolling Circumference 2255mm" 87 "Rolling Circumference 2260mm" 88 "Rolling Circumference 1930mm" 89 "Rolling Circumference 1935mm" 96 "Rolling Circumference 1940mm" 97 "Rolling Circumference 1945mm" 98 "Rolling Circumference 1950mm" 99 "Rolling Circumference 1955mm" 100 "Rolling Circumference 1960mm" 101 "Rolling Circumference 1965mm" 102 "Rolling Circumference 1970mm" 103 "Rolling Circumference 1975mm" 104 "Rolling Circumference 1700mm" 105 "Rolling Circumference 1705mm" 112 "Rolling Circumference 1710mm" 113 "Rolling Circumference 1715mm" 114 "Rolling Circumference 1720mm" 115 "Rolling Circumference 1725mm" 116 "Rolling Circumference 1730mm" 117 "Rolling Circumference 1735mm" 118 "Rolling Circumference 1740mm" 119 "Rolling Circumference 1745mm" 120 "Rolling Circumference 1750mm" 121 "Rolling Circumference 1755mm" 128 "Rolling Circumference 1760mm" 129 "Rolling Circumference 1765mm" 130 "Rolling Circumference 1770mm" 131 "Rolling Circumference 1775mm" 132 "Rolling Circumference 1780mm" 133 "Rolling Circumference 1785mm" 134 "Rolling Circumference 1790mm" 135 "Rolling Circumference 1795mm" 136 "Rolling Circumference 1800mm" 137 "Rolling Circumference 1805mm" 144 "Rolling Circumference 1810mm" 145 "Rolling Circumference 1815mm" 146 "Rolling Circumference 1820mm" 147 "Rolling Circumference 1825mm" 148 "Rolling Circumference 1830mm" 149 "Rolling Circumference 1835mm" 150 "Rolling Circumference 1840mm" 151 "Rolling Circumference 1845mm" 152 "Rolling Circumference 1850mm" 153 "Rolling Circumference 1855mm" 160 "Rolling Circumference 1860mm" 161 "Rolling Circumference 1865mm" 162 "Rolling Circumference 1870mm" 163 "Rolling Circumference 1875mm" 164 "Rolling Circumference 1880mm" 165 "Rolling Circumference 1885mm" 166 "Rolling Circumference 1890mm" 167 "Rolling Circumference 1895mm" 168 "Rolling Circumference 1900mm" 169 "Rolling Circumference 1905mm" 170 "Rolling Circumference 2445mm" 171 "Rolling Circumference 2450mm" 174 "Rolling Circumference 2455mm" 175 "Rolling Circumference 2460mm" 176 "Rolling Circumference 1910mm" 177 "Rolling Circumference 1915mm" 178 "Rolling Circumference 1920mm" 179 "Rolling Circumference 1925mm" 180 "Rolling Circumference 2265mm" 181 "Rolling Circumference 2270mm" 182 "Rolling Circumference 2275mm" 183 "Rolling Circumference 2280mm" 184 "Rolling Circumference 2285mm" 185 "Rolling Circumference 2290mm" 186 "Rolling Circumference 2295mm" 187 "Rolling Circumference 2300mm" 190 "Rolling Circumference 2305mm" 191 "Rolling Circumference 2310mm" 224 "Rolling Circumference 2440mm" 225 "Rolling Circumference 2315mm" 226 "Rolling Circumference 2320mm" 227 "Rolling Circumference 2325mm" 228 "Rolling Circumference 2330mm" 229 "Rolling Circumference 2335mm" 230 "Rolling Circumference 2340mm" 231 "Rolling Circumference 2345mm" 232 "Rolling Circumference 2350mm" 233 "Rolling Circumference 2355mm" 234 "Rolling Circumference 2360mm" 235 "Rolling Circumference 2365mm" 238 "Rolling Circumference 2370mm" 239 "Rolling Circumference 2375mm" 240 "Rolling Circumference 2435mm" 241 "Rolling Circumference 2380mm" 242 "Rolling Circumference 2385mm" 243 "Rolling Circumference 2390mm" 244 "Rolling Circumference 2395mm" 245 "Rolling Circumference 2400mm" 246 "Rolling Circumference 2405mm" 247 "Rolling Circumference 2410mm" 248 "Rolling Circumference 2415mm" 249 "Rolling Circumference 2420mm" 250 "Rolling Circumference 2425mm" 251 "Rolling Circumference 2430mm" 255 "Error" ;
VAL_ 1024 CcfBrand 0 "Not supported" 3 "Land Rover" 4 "Jaguar" 255 "Error" ;
VAL_ 1024 CcfFreqRemoteControls 0 "Not supported" 1 "Frequency 315 MHz" 24 "Frequency 868 MHz" 33 "Frequency 915 MHz" 34 "Frequency 447 MHz" 35 "Frequency 426 MHz" 36 "Frequency 434 MHz" 37 "315 MHz Low Power" 38 "Frequency 868 MHz Single Channel" 255 "Error" ;
VAL_ 1024 CcfHeatedWindscreen 0 "Not supported" 1 "No Heated Frontscreen/wiper park/heated jets" 2 "Heated Frontscreen only" 3 "Heated Frontscreen & heated jets only" 4 "Heated Wiper Park & heated jets only" 5 "Heated Frontscreen & wiper park & heated jets" 255 "Error" ;
VAL_ 1024 CcfHillDescentControl 0 "Not supported" 1 "Without Hill Descent Control" 2 "Hill Descent Control" 255 "Error" ;
VAL_ 1024 CcfParkingAssistance 0 "Not supported" 1 "Without Parking Assistance" 2 "PDC (Rear)" 3 "PDC (Front, Rear)" 4 "PDC (360)" 5 "PDC (Front, Rear) - Parking (Parallel)" 6 "PDC (Front, Rear) - Parking (Parallel, Exit)" 7 "PDC (Front, Rear) - Parking (Parallel, Perpendicular)" 8 "PDC (Front, Rear) - Parking (Parallel, Perpendicular, Exit)" 9 "PDC (360) - Parking (Parallel, Perpendicular)" 10 "PDC (360) - Parking (Parallel, Perpendicular, Exit)" 255 "Error" ;
VAL_ 1024 CcfParkingBrakeType 0 "Not Supported" 2 "Electrical Parking Brake" 3 "Mechanical Parking Brake" 255 "Error" ;
VAL_ 1024 CcfSafetyBeltReminder 0 "Not supported" 1 "EU type" 2 "US type incl. key warning" 3 "EU type -5 star EURO-NCAP" 4 "EU type -5 star logic front system" 7 "US type US logic" 8 "US type US logic front system" 16 "EU type all seats gen. 4 logic" 17 "EU type front seats gen. 4 logic" 18 "US type all seats gen. 4 logic" 19 "US type front seats gen. 4 logic" 20 "EU Type All Seats Gen. 3D Logic" 21 "US Type All Seats Gen. 3D Logic" 255 "Error" ;
VAL_ 1024 CcfBodyStyle 0 "Not supported" 1 "Single cab" 2 "Double cab" 3 "Bus M2" 4 "Kombi M1" 5 "Kombi van M1" 6 "Regular cargo van Lcf" 7 "Kombi van M1 Lcf" 8 "Kombi M1 Lcf" 9 "Bus M1 Lrf" 16 "Regular cargo van" 17 "4 door sedan" 18 "4 door station wagon" 19 "5 door sedan" 20 "Regular 5 door Mac" 21 "Extended 5 door Mac" 22 "3 door sedan" 23 "Convertable" 24 "Coupe" 25 "Kombi N1" 32 "Kombi N1 LCF" 33 "Kombi Van N1" 34 "Kombi Van N1 LCF" 35 "Double Cab In Van" 36 "Double Cab In Van LCF" 37 "Cab Van Floor LCF" 38 "FWD Bus M2" 39 "2 Door Sedan" 40 "B6 Level Armouring" 41 "Compact MAV" 48 "Grand MAV" 49 "Back to Back Cab" 50 "Cutaway" 51 "4 door sedan 6 lite" 52 "4 door sedan stretch 6-lite" 53 "SPORT UTILITY VEHICLE" 54 "Rap Cab" 55 "SWB VAN" 56 "LWB VAN" 57 "SWB KOMBI" 58 "LWB KOMBI" 59 "LWB SUV" 255 "Error" ;
VAL_ 1024 CcfEmissionStandard 0 "Not supported" 1 "2000 EEC stage III (car)" 2 "2000 EEC stage III (LDT)" 3 "97 EEC LDT" 4 "96 EEC car/96 EEC M1 (stage III)" 5 "95 EEC LDT" 6 "93 EEC car (Turkish 91/441/EEC)" 7 "LDT stage II" 8 "Mexico requirements" 9 "87 US diesel/83 US" 10 "49 STATE/NON GREEN STATE REQ." 11 "CALIFORNIA/GREEN STATE REQ." 12 "TIER 2 BIN 5" 13 "ZERO EVAPORATED EMISSIONS" 16 "D3" 17 "D4" 18 "Stage IV" 19 "Stage V" 20 "EUR 1504" 21 "LEV" 22 "ULEV requirements" 23 "US 49 states" 24 "California" 25 "Lt Dty Truck Stage 4 Requirement" 32 "Stage IV + Diesel Particulate Filter" 33 "STAGE V LDT3 EMISSIONS" 34 "Stage I Rqmts - Lt duty Truck" 35 "Stage 3 Requirements" 36 "PROCONVE L5 Brazilian Emissions" 37 "ENGINE PERFORMANCE LEVEL-LOW (FWD)" 38 "EU6 (SCR compatible)" 255 "Error" ;
VAL_ 1024 CcfGlassType 0 "Not supported" 1 "Standard windscreen glass" 2 "IR protected windscreen glass" 3 "Tinted glass" 4 "Privacy glass" 5 "Standard Windscreen Glass With Blue Banner" 255 "Error" ;
VAL_ 1024 CcfOctaneRating 0 "Not supported" 1 "91 RON" 2 "95 RON" 3 "RON Rating Not Required" 255 "Error" ;
VAL_ 1024 CcfRearAirConditioning 0 "Not supported" 1 "Without Rear Air Condition 1" 2 "With Rear Air Condition 1" 3 "Without Rear Air Condition 2" 4 "With Rear Air Condition 2" 5 "Without Rear Air Condition 3" 6 "With Rear Air Condition 3" 7 "Without Rear Air Condition 4" 8 "Rear End Console without vents" 9 "Rear End Console with Stowage (No rear face vents)" 10 "Rear End Console with vents" 11 "Rear HeVAC Auxiliary Unit" 12 "Additional Rear Blower" 13 "Rear 7-state Temperature Controller" 14 "Rear Chiller" 255 "Error" ;
VAL_ 1024 CcfRoofTyp 0 "Not supported" 1 "Coupe" 2 "Panorama roof" 3 "Convertible & Disable All Global Close" 4 "Convertible & Enable Global Close on Roof Close only" 5 "Convertible & Enable All Global Close" 255 "Error" ;
VAL_ 1024 CcfTyreDimension 0 "Not supported" 1 "225/55 R16 W" 2 "205/60 R16 V" 3 "225/50 R17 W" 4 "245/45 R17 W" 5 "245/40 R18 Y" 6 "245/35 R19 W (Accessory)" 7 "225/55 R16 V A/S" 8 "225/50 R17 V A/S" 9 "245/45 R17 V A/S" 10 "235/40R 18 95W XL" 11 "T125/90R16 98" 12 "195/65R 15 91V" 13 "195/65R 15 95V XL" 14 "195/65R15 91V" 16 "245/40 R18 V A/S" 17 "225/50 R17 W SST" 18 "225/50 R17 V A/S SST" 19 "215/55 R16 97W" 20 "215/55 R16 93V" 21 "215/55 R16 93W" 22 "215/55 R16 97V" 23 "235/45 R17 97W" 24 "235/45 R18 98W" 25 "235/40 R18 95Y" 26 "205/55R16 W" 27 "205/50R17 W" 28 "245/50 & 275/45 R18" 29 "205/60 R15 for Mazda only" 30 "225/45R17 W" 31 "225/40R18 W" 32 "215/60 R16 99H" 33 "215/60 R16 99V" 34 "215/60 R16 99W" 35 "225/50 R17 98W" 36 "235/45 R17 97W 'Run Flat'" 37 "185/75 R16" 38 "205/75 R16" 39 "205/65 R16" 41 "175/75 R16" 42 "235/45 R19" 43 "225/50R17 A/S H" 44 "225/45R18 H" 45 "225/45R18 A/S H" 46 "235/45 R19 99V" 47 "255/45 R20 105V" 48 "195/70R 15C Li 100/98 Bsw" 49 "195/70R 15C Li 104/102 Bsw" 50 "215/75 R16 113/111" 51 "215/75 R16" 52 "235/65 R17" 53 "235/60 R18" 54 "235/55 R19" 55 "215/75 R16C 116/114 R" 56 "215/55 R16 93H" 57 "195/75-16" 58 "175/55 R15" 59 "205/65 R15" 60 "225/50R17 V" 61 "235/55 R19 V" 62 "235/55 R19 W" 63 "P225/50R17 LRR" 64 "215/65 R16 V" 65 "235/55 R17 V" 67 "235/50 R18 V" 71 "245/40 R18 W SST" 82 "235/55 R19 V SST" 83 "205/55 R16 91V" 84 "205/55 R16 91H" 85 "205/55 R16 94V" 86 "215/55 R16 W SST" 87 "215/50 R17 W" 88 "235/45 R17 Y" 89 "165/70 R14" 96 "175/65 R14" 97 "185/55 R15" 98 "185/60 R14" 99 "185/65 R14" 100 "185/65 R15" 101 "195/45 R16" 102 "195/50 R15" 103 "195/50 R16" 104 "195/55 R16" 105 "195/60 R15" 112 "205/40 R17" 113 "235/50 R18 V SST" 114 "195/65 R15 89H" 115 "205/55 R16 89H" 116 "215/45 R17 87W" 117 "255/40 R18" 118 "185/60 R15" 119 "235/70R17 AT" 120 "255/60R18 AT" 121 "255/55R19 AT" 128 "255/50R20 AT" 129 "275/40R20 AT" 130 "255/55R18 AT" 131 "255/50R19 AT" 132 "255/55R19 AT B" 133 "245/45ZR19 102Y & 275/40ZR19 105Y (Summer tyre)" 134 "245/40R20 & 275/35R20 Summer tyre Y" 135 "235/65 R17 H" 136 "235/60 R18 H" 137 "225/65R17" 144 "245/45R20" 145 "235/65R19 V" 146 "255/55R20 V" 147 "255/55R20 W" 148 "275/45R21 V" 149 "275/45R21 W" 150 "275/40R22 Y" 151 "245/40R20 & 275/35R20 All Season tyre W" 152 "245/45R19 102H & 275/40R19 105H (All Season tyre)" 153 "245/45 R18 & 275/40 R18" 154 "245/40 R19 & 275/35 R19" 155 "255/35 R20 & 295/30 R20" 156 "205/55 R17" 157 "225/55 R17" 158 "225/40 R19 & 245/35R19" 159 "X351: 265/35 ZR20 & 295/30 ZR20 D7u: 20(255/55R20)" 160 "X760: 235 35 R 20 / 265 30 R 20 D7u Core: 21 (275/45R21)" 161 "275/45R21 L494 RS" 162 "295/40 R22" 163 "245/45 R20 V" 164 "245/45 R20 W" 165 "235_65R18" 166 "255_60R18" 167 "255_55R19" 168 "255_50R20" 169 "265_40R22" 170 "265_45R21" 171 "265/35 R20 & 305/30 R20 " 249 "Use customer tyre dimension" 255 "Error" ;
VAL_ 1024 Ccf12VoltOutletLuggage 0 "Not supported" 1 "Without 12V Outlet In Luggage" 2 "12V Outlet In Luggage" 255 "Error" ;
VAL_ 1024 CcfELVacuumPumpRrBooster 0 "Not supported" 1 "Without Vacuum Pump" 2 "Electrical Vacuum Pump" 3 "Mechanical Vacuum Pump" 255 "Error" ;
VAL_ 1024 CcfOilLevelSensor 0 "Not supported" 1 "Less Oil Level Sensor" 2 "Oil Level Sensor" 3 "Oil Level Sensor And Static Measurement" 255 "Error" ;
VAL_ 1024 CcfParkAssistCamera 0 "Not supported" 1 "Without Park Assist Camera" 2 "With Park Assist Camera" 3 "With LIN Park Assist Camera" 4 "With CAN Park Assist Camera" 5 "With LIN FMVSS111 Park Assist Camera" 6 "With CAN FMVSS111 Park Assist Camera" 255 "Error" ;
VAL_ 1024 CcfRollStabilityControl 0 "Not supported" 1 "Without Roll Stability Control" 2 "Roll Stability Control" 255 "Error" ;
VAL_ 1024 CcfTyrePressureModeSystem 0 "Not supported" 1 "Without Monitoring System TPMS" 2 "Monitoring System TPMS Without WBL" 3 "Monitoring System TPMS With WBL" 5 "TPMS with TIRE PRESSURE SENSORS-4WHL, NOT FOR VCC" 16 "TPMS L Without WBL, No ICM function" 17 "TPMS L Without WBL, ICM reset" 18 "TPMS L Without WBL, ICM shut-off" 19 "TPMS L Without WBL, Full ICM function" 32 "PWS S Without WBL, No ICM function" 33 "PWS S Without WBL, ICM reset" 34 "PWS S Without WBL, ICM shut-off" 35 "PWS S Without WBL, Full ICM function" 48 "PWS N Without WBL, No ICM function" 49 "PWS N Without WBL, ICM reset" 50 "PWS N Without WBL, ICM shut-off" 51 "PWS N Without WBL, Full ICM function" 64 "TPMS H With WBL, No ICM function" 65 "TPMS H With WBL, ICM reset" 66 "TPMS H With WBL, ICM shut-off" 67 "TPMS H With WBL, Full ICM function" 68 "DDS (Deflation Detection System)" 134 "TPMS With WBL, HSPA & No WT & No DLS (NAS Legislation)" 135 "TPMS With WBL, HSPA & WT & No DLS (NAS Legislation)" 136 "TPMS With WBL, WT & No HSPA & No DLS (NAS Legislation)" 137 "TPMS With WBL, No HSPA & No WT & No DLS (NAS Legislation)" 150 "TPMS With WBL, DLS & HSPA & No WT (NAS Legislation)" 151 "TPMS With WBL, DLS & HSPA & WT (NAS Legislation)" 152 "TPMS With WBL, DLS & WT & No HSPA (NAS Legislation)" 153 "TPMS With WBL, DLS & No HSPA & No WT (NAS Legislation)" 160 "TPMS With WBL, HSPA & No WT & No DLS (EU Legislation)" 161 "TPMS With WBL, HSPA & WT & No DLS (EU Legislation)" 162 "TPMS With WBL, WT & No HSPA & No DLS (EU Legislation)" 163 "TPMS With WBL, No HSPA & No WT & No DLS (EU Legislation)" 164 "TPMS With WBL, DLS & HSPA & No WT (EU Legislation)" 165 "TPMS With WBL, DLS & HSPA & WT (EU Legislation)" 166 "TPMS With WBL, DLS & WT & No HSPA (EU Legislation)" 167 "TPMS With WBL, DLS & No HSPA & No WT (EU Legislation)" 168 "TPMS With WBL, DLS (Heavy Default) & HSPA & No WT US" 169 "TPMS With WBL, DLS (Heavy Default) & HSPA & WT US" 176 "TPMS With WBL, DLS (Heavy Default) & WT & No HSPA US" 177 "TPMS With WBL, DLS (Heavy Default) & No HSPA & No WT US" 178 "EU approved LTDS" 179 "NAS approved LTDS" 180 "ROW LTDS" 181 "EU approved LTDS with DLS" 182 "NAS approved LTDS with DLS (Heavy Default)" 183 "ROW LTDS with DLS" 192 "TPMS With WBL, HSPA & No WT & No DLS with FSA (NAS Legislation)" 193 "TPMS With WBL, No HSPA & No WT & No DLS with FSA (NAS Legislation)" 194 "TPMS With WBL, DLS & HSPA & No WT with FSA (NAS Legislation)" 195 "TPMS With WBL, DLS & No HSPA & No WT with FSA (NAS Legislation)" 196 "TPMS With WBL, HSPA & No WT & No DLS with FSA (EU Legislation)" 197 "TPMS With WBL, No HSPA & No WT & No DLS with FSA (EU Legislation)" 198 "TPMS With WBL, DLS & HSPA & No WT with FSA (EU Legislation)" 199 "TPMS With WBL, DLS & No HSPA & No WT with FSA (EU Legislation)" 200 "TPMS With WBL, DLS (Heavy Default) & HSPA & No WT US with FSA (NAS Legislation)" 201 "TPMS With WBL, DLS (Heavy Default) & No HSPA & No WT US with FSA (NAS Legislation)" 252 "(X250 only) Driver Switchable Load Disabled" 253 "(X250 only) Driver Switchable Load Enabled ROW" 254 "(X250 only) Driver Switchable Load Enabled NAS" 255 "Error" ;
VAL_ 1024 CcfWheelBrakesTypeRear 0 "Not supported" 1 "Small Integrated Brake Calliper Solid Disc (HOPB)" 2 "Big Integrated Brake Calliper Ventilated Disc (HOPB)" 3 "Small EPB (Electrical Parking Brake) Calliper Solid Disc" 4 "Big EPD (Electrical Parking Brake) Calliper Ventilated Disc" 5 "FOPB (Foot Operated Parking Brake) With DIH (Drum In Hat) Calliper Solid Disc" 6 "HOPB (Hand Operated Parking Brake) With Small Integrated Brake Calliper Drum Brake" 7 "HOPB (Hand Operated Parking Brake) With Big Integrated Brake Calliper Drum Brake" 8 "Ceramic Brake Disc fitted with EPB fitment" 255 "Error" ;
VAL_ 1024 CcfAudibleMislockFeedback 0 "Not supported" 1 "Without Audible Mislock Feedback" 2 "With Audible Mislock Feedback" 3 "Audible Lock Feedback" 4 "Audible Mislock and Lock Feedback" 5 "2nd Press Audible Lock Feedback" 6 "Audible Mislock And 2nd Press Lock Feedback" 255 "Error" ;
VAL_ 1024 CcfAutoRelocking 0 "Not supported" 1 "Without Auto Relocking" 2 "With Auto Relocking" 3 "With Auto Relocking Of Cargo & Passangers Doors After 3 Seconds Drivers Door After 30 Seconds" 4 "With Auto Relocking Of All Doors After 30 Seconds" 255 "Error" ;
VAL_ 1024 CcfPowerHeatedMirrors 0 "Not supported" 1 "Short Arm Manual Mirror" 2 "Short Arm Power/Heated Mirror" 3 "Long Arm Manual Mirror" 4 "Long Arm Power/Heated Mirror" 5 "Short Arm Power/Not Heated" 255 "Error" ;
VAL_ 1024 CcfRearGlazing 0 "Not supported" 1 "No Rear Glass" 2 "Plain Rear Glass" 3 "Heated Rear Glass" 255 "Error" ;
VAL_ 1024 CcfRearWashWipe 0 "Not supported" 1 "Less Rear Wash Wipe" 2 "Intemittent Rear Wash Wipe" 3 "Dual Intemittent Wash Wipe" 4 "Rear Wash Wipe Linked To Transmission" 255 "Error" ;
VAL_ 1024 CcfRoofHeight 0 "Not supported" 1 "Low" 2 "Medium" 3 "High" 255 "Error" ;
VAL_ 1024 CcfZonalOppositeDoorRelock 0 "Not supported" 1 "Without Zonal Opposite Door Relocking" 2 "With Zonal Opposite Door Relocking" 255 "Error" ;
VAL_ 1024 CcfAccessoryUSBUnit 0 "Not supported" 1 "Without Accessory USB Unit" 2 "With USB Function" 3 "With iPod Function" 4 "With USB And iPod Function" 5 "With USB Function In IAM" 6 "With iPod Function In IAM" 7 "With USB And iPod Function In IAM" 255 "Error" ;
VAL_ 1024 CcfAirQualitySensor 0 "Not supported" 1 "Without Air Quality Sensor" 2 "With Air Quality Sensor fitted with hardwired communication" 3 "With Air Quality Sensor fitted with LIN communication" 255 "Error" ;
VAL_ 1024 CcfConfigurableUnlocking 0 "Not supported" 1 "Without Configurable Unlocking" 2 "With Configurable Unlocking Configuration One" 3 "With Configurable Unlocking Configuration Two" 4 "With Configurable Unlocking Configuration Three" 5 "With Configurable Unlocking Configuration Four" 6 "With Configurable Unlocking Configuration Five" 7 "With Configurable Unlocking Configuration Six" 8 "With Configuration Unlocking Configuration Seven" 255 "Error" ;
VAL_ 1024 CcfEmissionEvaporationSys 0 "Not supported" 1 "Without Evaporation System" 2 "El Control Evaporation System" 3 "Running Losses Onboard Refuelling Vapour Recovery" 4 "Partiell Zero Emission Vehicle Evaporation" 5 "Evaporator System ULEV Prim DIAGNOS SYSTEM" 255 "Error" ;
VAL_ 1024 CcfExternalAlarmUnitSupply 0 "Not supported" 1 "Without External Alarm Unit" 2 "External Alarm Unit Supply Accessory Only" 255 "Error" ;
VAL_ 1024 CcfHeadrestsRearFolding 0 "Not supported" 1 "Manually Foldable Rear Headrests" 2 "El Folding Rear Headrests" 3 "Fixed Rear Headrests" 255 "Error" ;
VAL_ 1024 CcfHomesafeLighting 0 "Not supported" 1 "Without Homesafe Lighting" 2 "With Homesafe Lighting Duration 30sec" 3 "With Homesafe Lighting Duration 60sec" 4 "With Homesafe Lighting Duration 90sec" 5 "With Homesafe Lighting Duration 120sec" 6 "With Homesafe Lighting Duration 150sec" 7 "With Homesafe Lighting Duration 180sec" 255 "Error" ;
VAL_ 1024 CcfACCompressorType 0 "Not supported" 1 "Fixed displacement clutched (FDC)" 2 "Internally controlled variable displacement clutched (ICVDC)" 3 "Externally controlled variable displacement clutchless (ECVD)" 4 "Externally controlled variable displacement clutched (ECVDC)" 5 "Electric controlled (EC)" 255 "Error" ;
VAL_ 1024 CcfAdaptiveLoadLimiterFnt 0 "Not supported" 1 "Without Adaptive Load Limiter Front" 2 "Adaptive Load Limiter Front Driver Seat" 3 "Adaptive Load Limiter Front Passanger Seat" 4 "Adaptive Load Limiter Front Driver & Passenger Seat" 255 "Error" ;
VAL_ 1024 CcfBluetoothHandsfree 0 "Not supported" 1 "Without Bluetooth Handsfree" 2 "Bluetooth Handsfree" 3 "Bluetooth Handsfree With SMS Support" 4 "Bluetooth Handsfree And Audiostreaming" 5 "BT/VC Phone Interface +USB Connection" 6 "BT/VC + Info + Navigation" 7 "Bluetooth Audiostreaming" 8 "SYNC G1 BT-Phone BT-Audio, NOT FOR VCC" 9 "SYNC G1 BT-Phone BT-Audio BT-Nav, NOT FOR VCC" 10 "BT/VC with USB, and BTAudio for NAV only (Not for VCC)" 11 "Bluetooth Handsfree + Audio streaming + SMS" 255 "Error" ;
VAL_ 1024 CcfOccupantWeightSensor 0 "Not supported" 1 "Without Occupant Weight Sensor" 2 "Occupant Weight Sensor" 255 "Error" ;
VAL_ 1024 CcfPyroTechSteeringColumn 0 "Not supported" 1 "Without PYRO Technical Steering Column" 2 "With PYRO Technical Steering Column" 255 "Error" ;
VAL_ 1024 CcfRearBeltDetection 0 "Not supported" 1 "Without Rear Belt Detection" 2 "Rear Belt Detection Left & Right Belts" 3 "Rear Belt Detection Left Right & Middle Belts" 4 "Rear Belt Detection All Seats" 255 "Error" ;
VAL_ 1024 CcfTrafficInformation 0 "Not supported" 1 "Without Traffic Information" 2 "TMC" 3 "VICS Not For Volvo" 255 "Error" ;
VAL_ 1024 CcfAsthmaAndAllergy 0 "Not supported" 1 "Without Clean Zone Interior" 2 "Clean Zone Interior" 255 "Error" ;
VAL_ 1024 CcfDampSensor 0 "Not supported" 1 "Without Damp Sensor" 2 "Damp Sensor (direct to climate control ECU)" 3 "Damp Sensor (combined sensor, CAN to climate control ECU)" 255 "Error" ;
VAL_ 1024 CcfDoorHandleTechnology 0 "Not supported" 1 "not Passive entry fitted" 2 "fully microswitch handle (lock and unlock)" 3 "touch sensor unlock microswitch lock" 4 "single button strap handle" 5 "fully touch sensor (lock and unlock)" 6 "deployable handle (front only)" 7 "deployable handle (front and rear)" 255 "Error" ;
VAL_ 1024 CcfNeutralControlAutoGear 0 "Not supported" 1 "Without Neutral Control Function" 2 "With Neutral Control Function" 255 "Error" ;
VAL_ 1024 CcfRPMSpeedController 0 "Not supported" 1 "Less RPM Speed Controller" 2 "RPM Speed Controller" 255 "Error" ;
VAL_ 1024 CcfSelfOpeningBootlid 0 "Not supported" 1 "Manual Single Piece Tailgate" 2 "Manual Split (Upper & Lower) Tailgate" 3 "Single piece Power Open/Close Tailgate with Soft Close - Full System" 4 "Manual Side Opening Rear Door" 5 "Powered Side Opening Rear Door" 6 "Soft Close Tailgate - Dedicated module control" 7 "Soft Close Tailgate - Body Control Module control" 8 "Split Gate Dual Power Open/Close (Upper & Lower) Tailgate with Soft Close - Full System" 9 "Single piece Power Open/Close Tailgate with Deployable Load Floor - Full System" 255 "Error" ;
VAL_ 1024 CcfShiftIndication 0 "Not supported" 1 "Without Shift Indication" 2 "With Shift Indication" 255 "Error" ;
VAL_ 1024 CcfClimateZoneUserLayout 0 "Undefined error state" 1 "1 Temperature, 1 Distribution, 1 Blower" 2 "2 Temperature, 1 Distribution, 1 Blower" 3 "3 Temperature, 1 Distribution, 1 Blower" 4 "4 Temperature, 1 Distribution, 1 Blower" 5 "5 Temperature, 1 Distribution, 1 Blower" 6 "6 Temperature, 1 Distribution, 1 Blower" 7 "1 Temperature, 2 Distribution, 1 Blower" 8 "2 Temperature, 2 Distribution, 1 Blower" 9 "3 Temperature, 2 Distribution, 1 Blower" 10 "4 Temperature, 2 Distribution, 1 Blower" 11 "5 Temperature, 2 Distribution, 1 Blower" 12 "6 Temperature, 2 Distribution, 1 Blower" 13 "1 Temperature, 3 Distribution, 1 Blower" 14 "2 Temperature, 3 Distribution, 1 Blower" 15 "3 Temperature, 3 Distribution, 1 Blower" 16 "4 Temperature, 3 Distribution, 1 Blower" 17 "5 Temperature, 3 Distribution, 1 Blower" 18 "6 Temperature, 3 Distribution, 1 Blower" 19 "1 Temperature, 4 Distribution, 1 Blower" 20 "2 Temperature, 4 Distribution, 1 Blower" 21 "3 Temperature, 4 Distribution, 1 Blower" 22 "4 Temperature, 4 Distribution, 1 Blower" 23 "5 Temperature, 4 Distribution, 1 Blower" 24 "6 Temperature, 4 Distribution, 1 Blower" 25 "1 Temperature, 5 Distribution, 1 Blower" 26 "2 Temperature, 5 Distribution, 1 Blower" 27 "3 Temperature, 5 Distribution, 1 Blower" 28 "4 Temperature, 5 Distribution, 1 Blower" 29 "5 Temperature, 5 Distribution, 1 Blower" 30 "6 Temperature, 5 Distribution, 1 Blower" 31 "1 Temperature, 6 Distribution, 1 Blower" 32 "2 Temperature, 6 Distribution, 1 Blower" 33 "3 Temperature, 6 Distribution, 1 Blower" 34 "4 Temperature, 6 Distribution, 1 Blower" 35 "5 Temperature, 6 Distribution, 1 Blower" 36 "6 Temperature, 6 Distribution, 1 Blower" 37 "1 Temperature, 1 Distribution, 2 Blower" 38 "2 Temperature, 1 Distribution, 2 Blower" 39 "3 Temperature, 1 Distribution, 2 Blower" 40 "4 Temperature, 1 Distribution, 2 Blower" 41 "5 Temperature, 1 Distribution, 2 Blower" 42 "6 Temperature, 1 Distribution, 2 Blower" 43 "1 Temperature, 2 Distribution, 2 Blower" 44 "2 Temperature, 2 Distribution, 2 Blower" 45 "3 Temperature, 2 Distribution, 2 Blower" 46 "4 Temperature, 2 Distribution, 2 Blower" 47 "5 Temperature, 2 Distribution, 2 Blower" 48 "6 Temperature, 2 Distribution, 2 Blower" 49 "1 Temperature, 3 Distribution, 2 Blower" 50 "2 Temperature, 3 Distribution, 2 Blower" 51 "3 Temperature, 3 Distribution, 2 Blower" 52 "4 Temperature, 3 Distribution, 2 Blower" 53 "5 Temperature, 3 Distribution, 2 Blower" 54 "6 Temperature, 3 Distribution, 2 Blower" 55 "4Temperature, 3Distribution, 1Blower + Additional booster blw" 56 "4 Temperature 4 Distribution 2 Blower" 255 "Error" ;
VAL_ 1024 CcfEcoInfoSystem 0 "Undefined error condition if used" 21 "Normal Vehicle - Imperial Gallon - 5 Seats" 23 "Normal Vehicle - Imperial Gallon - 7 Seats" 29 "Normal Vehicle - US Gallon - 5 Seats" 31 "Normal Vehicle - US Gallon - 7 Seats" 69 "Full Hybrid (CIMG) - Imperial Gallon - 5 Seats" 71 "Full Hybrid (CIMG) - Imperial Gallon - 7 Seats" 77 "Full Hybrid (CIMG) - US Gallon - 5 Seats" 79 "Full Hybrid (CIMG) - US Gallon - 7 Seats" 255 "Error" ;
VAL_ 1024 CcfNightVision 0 "Not Configured" 1 "Without Night Vision" 2 "With Night Vision" 255 "Error" ;
VAL_ 1024 CcfReverseGearChime 0 "Not supported" 1 "Less Reverse Gear Chime" 2 "Reverse Gear Chime" 255 "Error" ;
VAL_ 1024 CcfSolarSensor 0 "Not supported" 1 "Front - Not Fitted : Rear - Not Fitted" 2 "Front - Single Zone : Rear - Not fitted" 3 "Front - Dual Zone : Rear - Not Fitted" 4 "Front - Dual Zone : Rear - Single Zone" 5 "Front - Dual Zone : Rear - 2 x Single Zone" 6 "Front - Dual Zone : Rear - Dual Zone" 255 "Error" ;
VAL_ 1024 CcfTelematics 0 "TCU not fitted" 2 "Data Only TCU3 fitted" 31 "Telematics TCU fitted" 32 "Data Only TCU fitted without microphone connection" 34 "Data Only TCU fitted with microphone connection" 95 "Telematics TCU fitted with fault LED " 255 "Error" ;
VAL_ 1024 CcfTelematicsProtection 0 "Not supported" 1 "Less Telematics Protection" 3 "Telematics Protected" 4 "Telematics Protection Plus" 5 "Telematics Protected - Encryption 2" 6 "Telematics Protection Plus - Encryption 2" 255 "Error" ;
VAL_ 1024 CcfAutoSpeedLimiter 0 "Not Supported" 1 "ASL Not Fitted" 2 "ASL Fitted" 3 "ASL Fitted With Persistent Kickdown Chime" 4 "ASL Fitted With Single Kickdown Chime" 5 "ASL Fitted With Kickdown Visual Alert" 255 "Error" ;
VAL_ 1024 CcfHeadUpDisplay 0 "Not Supported" 1 "HUD Not fitted" 2 "HUD Fitted with ON/OFF Hard Switch w/o indicator" 3 "HUD Fitted with ON/OFF Hard Switch with indicator" 4 "HUD Fitted with ON/OFF Cluster Menu" 255 "Error" ;
VAL_ 1024 CcfIGORSystemDescription 0 "Not Supported" 1 "2 Relay with Dumb logic" 2 "4 Relay with Dumb logic" 3 "QRB/BCM Latch Relays not fitted" 4 "1 Relay with Dumb logic" 5 "3 Relay with Dumb logic" 6 "PDM with Intelligent logic" 255 "Error" ;
VAL_ 1024 CcfLanguageRegion 0 "Not supported" 1 "Without Language Region" 2 "Language Region for Europe" 3 "Language Region for North America" 4 "Language Region for South America" 5 "Language Region for Africa" 6 "Language Region for South East Asia" 7 "Language Region for Pacific" 8 "Language Region for Russia" 9 "Language Region for Middle East" 16 "Language Region for China" 17 "Language Region for Taiwan" 18 "Language Region for Japan" 19 "Language Region for Korea" 255 "Error" ;
VAL_ 1024 CcfSideCamera 0 "Not supported" 1 "Without Side Camera" 2 "Right Side Camera" 3 "Left Side Camera" 4 "Both Sides Cameras, without Japanese functionality" 5 "Both Sides Cameras, with Japanese functionality" 255 "Error" ;
VAL_ 1024 CcfStopStart 0 "Not supported" 1 "Without Stop/Start" 2 "Stop/Start" 255 "Error" ;
VAL_ 1024 CcfTrailerTyrePressMonSys 0 "Not supported" 1 "Trailer TPMS not fitted" 2 "Trailer TPMS fitted" 255 "Error" ;
VAL_ 1024 Ccf4x4InfoDisplay 0 "Not Supported" 1 "Not Enabled" 2 "Enabled" 255 "Error" ;
VAL_ 1024 CcfAdvancedChauffeurFunc 0 "Undefined error condition if used" 1 "AFC not Fitted" 2 "Base Level AFC Fitted" 3 "Mid Level AFC Fitted" 4 "High Level AFC Fitted" 255 "Error" ;
VAL_ 1024 CcfAudibleAlarmMode 0 "Undefined error condition if used" 1 "Disabled (Silent)" 2 "Enabled (Use available sounder)" 255 "error" ;
VAL_ 1024 CcfCrashEventDataRec 0 "Undefined error condition if used" 1 "Without Crash Event Data Recording" 2 "With Crash Event Data Recording" 255 "Error" ;
VAL_ 1024 CcfDoorLatchType 0 "Not configured" 1 "C1 Latch" 2 "Unilatch" 3 "Unilatch-EVO" 255 "Error" ;
VAL_ 1024 CcfLowSpdIntEmergBrake 0 "Not Supported" 1 "Without LSIEB" 2 "With Rear only LSIEB" 3 "With Front and Rear LSIEB" 255 "Error" ;
VAL_ 1024 CcfModelYear 0 "Undefined error condition if used" 255 "Error" ;
VAL_ 1024 CcfActiveRollControl 0 "Undefined error condition if used" 1 "ARC Not Fitted" 2 "ARC Fitted" 255 "Error" ;
VAL_ 1024 CcfAuxillaryWaterPump 0 "Not supported" 1 "Auxillary Water Pump not fitted" 2 "Auxillary Water Pump fitted" 255 "Error" ;
VAL_ 1024 CcfConversationAssist 0 "Undefined error condition if used" 1 "Without Conversation Assist" 2 "With Conversation Assist" 255 "Error" ;
VAL_ 1024 CcfNavECORouteExtraUrban 0 "Undefined error condition if used" 1 "1g/km (1bit = 1g/km)" 50 "50g/km (1bit = 1g/km)" 100 "100g/km (1bit = 1g/km)" 150 "150g/km (1bit = 1g/km)" 200 "200g/km (1bit = 1g/km)" 250 "250g/km (1bit = 1g/km)" 254 "Do not display Navigation ECO Route data" 255 "Error" ;
VAL_ 1024 CcfNavECORouteUrban 0 "Undefined error condition if used" 1 "1g/km (1bit = 1g/km)" 50 "50g/km (1bit = 1g/km)" 100 "100g/km (1bit = 1g/km)" 150 "150g/km (1bit = 1g/km)" 200 "200g/km (1bit = 1g/km)" 250 "250g/km (1bit = 1g/km)" 254 "Do not display Navigation ECO Route data" 255 "Error" ;
VAL_ 1024 CcfPartNumberFormat 0 "Undefined error condition if used" 1 "KDP Format" 2 "WERS Format" 255 "Error" ;
VAL_ 1024 CcfTrsferBxCntrllrType 0 "Undefined error condition if used" 1 "Single Speed without controller / Not Fitted" 2 "Single Speed with controller" 3 "Twin Speed with Controller (low range gearbox)" 255 "Error" ;
VAL_ 1024 CcfCameraHMIStrategy 0 "Not Supported" 1 "HMI hosted by Infotainment System" 2 "HMI hosted by Camera System" 3 "Shared HMI" 7 "Error" ;
VAL_ 1024 CcfDeplBatterySystem 0 "Not Supported" 1 "Without Deployable Battery System" 2 "With Deployable Battery System" 3 "Error" ;
VAL_ 1024 CcfDriverBuckleSwitch 0 "Not Supported" 1 "Without Driver Buckle Switch" 2 "With Driver Buckle Switch" 3 "Error" ;
VAL_ 1024 CcfDriverKneeAirbag 0 "Not Supported" 1 "Without Driver Knee Airbag" 2 "With Driver Knee Airbag" 3 "Error" ;
VAL_ 1024 CcfDriverPassBeltPret 0 "Not supported" 1 "Without Drv and Pass Belt Buckle Pretensioners" 2 "With Drv Belt Buckle Pretensioners only" 3 "With Pass Belt Buckle Pretensioners only" 4 "With Drv and Pass Belt Buckle Pretensioners" 5 "Reserved" 6 "Reserved" 7 "Error" ;
VAL_ 1024 CcfDriverSwtchLdLimit 0 "Not Supported" 1 "Without Driver Load Limit" 2 "With Driver Load Limit" 3 "Error" ;
VAL_ 1024 CcfEventDataRecorder 0 "Not Supported" 1 "Without Event Data Recorder" 2 "With Event Data Recorder" 3 "Error" ;
VAL_ 1024 CcfFntDIFbdkMech 0 "Not Supported" 1 "BCM detects fault directly" 2 "BCM receives fault data via LIN" 3 "Error" ;
VAL_ 1024 CcfInfotainmentType 0 "Not Supported" 1 "Gen 2.1" 2 "NGI Low Line" 3 "NGI Mid Line" 4 "NGI High Line" 5 "NLI Low Line" 6 "NLI High Line" 7 "Error" ;
VAL_ 1024 CcfLeftCurtainAirbag 0 "Not Supported" 1 "Without Left Curtain Airbag" 2 "With Left Curtain Airbag" 3 "Error" ;
VAL_ 1024 CcfLeftRearHeadAbag 0 "Not Supported" 1 "Without Left Rear Head Airbag" 2 "With Left Rear Head Airbag" 3 "Error" ;
VAL_ 1024 CcfLeftSideAirbag 0 "Not Supported" 1 "Without Left Side Airbag" 2 "With Left Side Airbag" 3 "Error" ;
VAL_ 1024 CcfmPACOS 0 "Not supported" 1 "Without Passenger Airbag Deactivation Switch" 2 "With Passenger Airbag Deactivation Switch" 3 "With Menu Driven Passenger Airbag Cut-off Switch (mPACOS)" 7 "Error" ;
VAL_ 1024 CcfPADLamp 0 "Not Supported" 1 "Without PAD Lamp" 2 "With PAD Lamp" 3 "With Dual PAD Lamps" 7 "Error" ;
VAL_ 1024 CcfPassBuckleSwitch 0 "Not Supported" 1 "Without Passenger Buckle Switch" 2 "With Passenger Buckle Switch" 3 "Error" ;
VAL_ 1024 CcfPassOccWghtSensor 0 "Not Supported" 1 "Without Passenger Occupant Weight Sensor" 2 "With Passenger Occupant Weight Sensor" 3 "Error" ;
VAL_ 1024 CcfRightCurtainAirbag 0 "Not Supported" 1 "Without Right Curtain Airbag" 2 "With Right Curtain Airbag" 3 "Error" ;
VAL_ 1024 CcfRightRearHeadAbag 0 "Not Supported" 1 "Without Right Rear Head Airbag" 2 "With Right Rear Head Airbag" 3 "Error" ;
VAL_ 1024 CcfRightSideAirbag 0 "Not Supported" 1 "Without Right Side Airbag" 2 "With Right Side Airbag" 3 "Error" ;
VAL_ 1024 CcfRollOverSensing 0 "Not Supported" 1 "No Roll Over Sensing (RoSe)" 2 "with RoSe 2" 3 "with RoSe 1" 4 "with RoSe 1 Slow Roll" 7 "Error" ;
VAL_ 1024 CcfThirdRowChiller 0 "Not supported" 1 "Not Fitted" 2 "Fitted" 3 "Error" ;
VAL_ 1024 CcfTrunkLmpOutput 0 "Not Supported" 1 "Courtesy Feed" 2 "Dedicated Feed" 3 "Error" ;
VAL_ 1024 CcfWindowCalibration 0 "Not Supported" 1 "UK" 2 "India" 3 "China" 7 "Error" ;
VAL_ 1024 CcfWindowOpFeedback 0 "Not Supported" 1 "Hall Sensors" 2 "Ripple Counting" 3 "PWM Function" 4 "Armoured" 5 "No Hall Sensors" 7 "Error" ;
VAL_ 1024 CcfATPC 0 "Not Supported" 5 "No HDC or LSPC" 6 "HDC only" 9 "LSPC only" 16 "HDC and LSPC" 255 "Error" ;
VAL_ 1024 CcfBCMCtrlAmbLitSet 0 "Not Supported" 1 "BCM does not control default values" 2 "BCM controls default values" 7 "Error" ;
VAL_ 1024 CcfBumperType 0 "Not Supported" 1 "Pattern 1 - (N/A)" 2 "Pattern 2 - (S/C)" 3 "Pattern 3 - Performance" 4 "Pattern 4 - Reserved" 5 "Pattern 5 - Reserved" 6 "Pattern 6 - JLR Accessory 1" 7 "Pattern 7 - Reserved" 15 "Error" ;
VAL_ 1024 CcfDLNAStatus 0 "Not Supported" 1 "Disabled" 2 "Enabled" 15 "Error" ;
VAL_ 1024 CcfDriverFrontAirbag 0 "Not Supported" 1 "Without Driver Front Airbag Stage 1 & Stage 2" 2 "With Driver Front Airbag Stage 1 only" 3 "With Driver Front Airbag Stage 1 & Stage 2" 7 "Error" ;
VAL_ 1024 CcfDriverPassRetractor 0 "Not Supported" 1 "Without Drv and Pass Retractor" 2 "With Drv Retractor only" 3 "With Pass Retractor only" 4 "With Drv and Pass Retractor" 5 "With Drv Pass and Centre Retractor" 6 "Reserved" 7 "Error" ;
VAL_ 1024 CcfDRLMLSInteraction 0 "Not Supported" 1 "Switch off with position lamps or greater" 2 "Switch off with dip beam lamps or greater" 7 "Error" ;
VAL_ 1024 CcfDRLTransInteraction 0 "Not Supported" 1 "Stay ON in park or neutral" 2 "Switch OFF in park or neutral" 7 "Error" ;
VAL_ 1024 CcfGracenotes 0 "Not Supported" 1 "No Gracenotes Database" 2 "China" 3 "Europe" 4 "Japan" 5 "Korea" 6 "Latin America" 7 "North America" 8 "Global" 15 "Error" ;
VAL_ 1024 CcfLowBeamFdbkMech 0 "Not Supported" 1 "BCM detects faults directly" 2 "BCM receives fault data via LIN" 3 "BCM detects fault directly + Tell Tale" 4 "BCM receives fault data via LIN + Tell Tale" 5 "No feedback" 7 "Error" ;
VAL_ 1024 CcfMainBeamFdbkMech 0 "Not Supported" 1 "BCM detects faults directly" 2 "BCM receives fault data via LIN" 3 "No Feedback" 7 "Error" ;
VAL_ 1024 CcfPassFrontAirbag 0 "Not Supported" 1 "Without Passenger Front Airbag Stage 1 & Stage 2" 2 "With Passenger Front Airbag Stage 1 only" 3 "With Passenger Front Airbag Stage 1 & Stage 2" 7 "Error" ;
VAL_ 1024 CcfPwrTailProxSenPAM 0 "Not Supported" 1 "Power tailgate with Proximity Sensing not fitted" 2 "Power tailgate with Proximity Sensing fitted" 3 "Error" ;
VAL_ 1024 CcfQRBPowerPAM 0 "Not Supported" 1 "PAM not powered from QRB" 2 "PAM powered from QRB" 3 "Error" ;
VAL_ 1024 CcfRemoteStartCapable 0 "Not supported" 1 "Vehicle supports RES" 2 "RES not supported" 3 "Error" ;
VAL_ 1024 CcfStealthMode 0 "Not Supported" 1 "Disabled" 2 "Enabled" 3 "Error" ;
VAL_ 1024 CcfTPMSVariant 0 "Not Supported" 1 "Standard" 2 "Convertible" 3 "R" 4 "ECO Premium Chassis" 5 "Sportbrake" 6 "AWD" 7 "Premium Chassis" 8 "ECO Car" 9 "ETO 20' Wheel" 10 "7 Seat" 11 "LWB" 12 "Speedpack" 13 "RS" 14 "Special Vehicle" 15 "Error" ;
VAL_ 1024 CcfCHMSLProfile 0 "Not Supported" 1 "Diagnostic Profile 1" 2 "Diagnostic Profile 2" 3 "Diagnostic Profile 3" 4 "Diagnostic Profile 4" 5 "Diagnostic Profile 5" 6 "Diagnostic Profile 6" 7 "Diagnostic Profile 7" 8 "Diagnostic Profile 8" 9 "Diagnostic Profile 9" 10 "Diagnostic Profile 10" 11 "Diagnostic Profile 11" 12 "Diagnostic Profile 12" 13 "Diagnostic Profile 13" 14 "Diagnostic Profile 14" 15 "Diagnostic Profile 15" 16 "Diagnostic Profile 16" 17 "Diagnostic Profile 17" 18 "Diagnostic Profile 18" 19 "Diagnostic Profile 19" 20 "Diagnostic Profile 20" 21 "Diagnostic Profile 21" 22 "Diagnostic Profile 22" 23 "Diagnostic Profile 23" 24 "Diagnostic Profile 24" 25 "Diagnostic Profile 25" 26 "Diagnostic Profile 26" 27 "Diagnostic Profile 27" 28 "Diagnostic Profile 28" 29 "Diagnostic Profile 29" 30 "Diagnostic Profile 30" 31 "Diagnostic Profile 31" 32 "Diagnostic Profile 32" 63 "Error" ;
VAL_ 1024 CcfDrvDrowsyMonDDM 0 "Not supported" 1 "DDM not fitted" 2 "DDM fitted" 3 "Error" ;
VAL_ 1024 CcfExtSyntheticSounder 0 "Not Supported" 1 "ESS Not Fitted" 2 "ESS Fitted" 3 "Error" ;
VAL_ 1024 CcfFntDIProfile 0 "Not Supported" 1 "Diagnostic Profile 1" 2 "Diagnostic Profile 2" 3 "Diagnostic Profile 3" 4 "Diagnostic Profile 4" 5 "Diagnostic Profile 5" 6 "Diagnostic Profile 6" 7 "Diagnostic Profile 7" 8 "Diagnostic Profile 8" 9 "Diagnostic Profile 9" 10 "Diagnostic Profile 10" 11 "Diagnostic Profile 11" 12 "Diagnostic Profile 12" 13 "Diagnostic Profile 13" 14 "Diagnostic Profile 14" 15 "Diagnostic Profile 15" 16 "Diagnostic Profile 16" 17 "Diagnostic Profile 17" 18 "Diagnostic Profile 18" 19 "Diagnostic Profile 19" 20 "Diagnostic Profile 20" 21 "Diagnostic Profile 21" 22 "Diagnostic Profile 22" 23 "Diagnostic Profile 23" 24 "Diagnostic Profile 24" 25 "Diagnostic Profile 25" 26 "Diagnostic Profile 26" 27 "Diagnostic Profile 27" 28 "Diagnostic Profile 28" 29 "Diagnostic Profile 29" 30 "Diagnostic Profile 30" 31 "Diagnostic Profile 31" 32 "Diagnostic Profile 32" 63 "Error" ;
VAL_ 1024 CcfFntDRLProfile 0 "Not Supported" 1 "Diagnostic Profile 1" 2 "Diagnostic Profile 2" 3 "Diagnostic Profile 3" 4 "Diagnostic Profile 4" 5 "Diagnostic Profile 5" 6 "Diagnostic Profile 6" 7 "Diagnostic Profile 7" 8 "Diagnostic Profile 8" 9 "Diagnostic Profile 9" 10 "Diagnostic Profile 10" 11 "Diagnostic Profile 11" 12 "Diagnostic Profile 12" 13 "Diagnostic Profile 13" 14 "Diagnostic Profile 14" 15 "Diagnostic Profile 15" 16 "Diagnostic Profile 16" 17 "Diagnostic Profile 17" 18 "Diagnostic Profile 18" 19 "Diagnostic Profile 19" 20 "Diagnostic Profile 20" 21 "Diagnostic Profile 21" 22 "Diagnostic Profile 22" 23 "Diagnostic Profile 23" 24 "Diagnostic Profile 24" 25 "Diagnostic Profile 25" 26 "Diagnostic Profile 26" 27 "Diagnostic Profile 27" 28 "Diagnostic Profile 28" 29 "Diagnostic Profile 29" 30 "Diagnostic Profile 30" 31 "Diagnostic Profile 31" 32 "Diagnostic Profile 32" 63 "Error" ;
VAL_ 1024 CcfFntPosProfile 0 "Not Supported" 1 "Diagnostic Profile 1" 2 "Diagnostic Profile 2" 3 "Diagnostic Profile 3" 4 "Diagnostic Profile 4" 5 "Diagnostic Profile 5" 6 "Diagnostic Profile 6" 7 "Diagnostic Profile 7" 8 "Diagnostic Profile 8" 9 "Diagnostic Profile 9" 10 "Diagnostic Profile 10" 11 "Diagnostic Profile 11" 12 "Diagnostic Profile 12" 13 "Diagnostic Profile 13" 14 "Diagnostic Profile 14" 15 "Diagnostic Profile 15" 16 "Diagnostic Profile 16" 17 "Diagnostic Profile 17" 18 "Diagnostic Profile 18" 19 "Diagnostic Profile 19" 20 "Diagnostic Profile 20" 21 "Diagnostic Profile 21" 22 "Diagnostic Profile 22" 23 "Diagnostic Profile 23" 24 "Diagnostic Profile 24" 25 "Diagnostic Profile 25" 26 "Diagnostic Profile 26" 27 "Diagnostic Profile 27" 28 "Diagnostic Profile 28" 29 "Diagnostic Profile 29" 30 "Diagnostic Profile 30" 31 "Diagnostic Profile 31" 32 "Diagnostic Profile 32" 63 "Error" ;
VAL_ 1024 CcfFntSMProfile 0 "Not Supported" 1 "Diagnostic Profile 1" 2 "Diagnostic Profile 2" 3 "Diagnostic Profile 3" 4 "Diagnostic Profile 4" 5 "Diagnostic Profile 5" 6 "Diagnostic Profile 6" 7 "Diagnostic Profile 7" 8 "Diagnostic Profile 8" 9 "Diagnostic Profile 9" 10 "Diagnostic Profile 10" 11 "Diagnostic Profile 11" 12 "Diagnostic Profile 12" 13 "Diagnostic Profile 13" 14 "Diagnostic Profile 14" 15 "Diagnostic Profile 15" 16 "Diagnostic Profile 16" 17 "Diagnostic Profile 17" 18 "Diagnostic Profile 18" 19 "Diagnostic Profile 19" 20 "Diagnostic Profile 20" 21 "Diagnostic Profile 21" 22 "Diagnostic Profile 22" 23 "Diagnostic Profile 23" 24 "Diagnostic Profile 24" 25 "Diagnostic Profile 25" 26 "Diagnostic Profile 26" 27 "Diagnostic Profile 27" 28 "Diagnostic Profile 28" 29 "Diagnostic Profile 29" 30 "Diagnostic Profile 30" 31 "Diagnostic Profile 31" 32 "Diagnostic Profile 32" 63 "Error" ;
VAL_ 1024 CcfFwdCollWarnAEB 0 "Not Supported" 1 "FCW not fitted" 2 "FCW fitted" 3 "Error" ;
VAL_ 1024 CcfIntelEmerBrkingCUIEB 0 "Not supported" 1 "IEB not fitted" 2 "IEB fitted" 3 "Error" ;
VAL_ 1024 CcfISLFitment 0 "Not supported" 1 "ISL not fitted" 2 "ISL fitted" 3 "Error" ;
VAL_ 1024 CcfNavBtnFCIM 0 "Not supported" 1 "Not Fitted" 2 "Fitted" 3 "Error" ;
VAL_ 1024 CcfNLIAudioAmp 0 "Not supported" 1 "Not Fitted" 2 "Fitted" 3 "Error" ;
VAL_ 1024 CcfP4UBtnFACP 0 "Not supported" 1 "Not Fitted" 2 "Fitted" 3 "Error" ;
VAL_ 1024 CcfPassAirbagVent 0 "Not supported" 1 "Without Passenger Airbag Adaptive Vent" 2 "With Passenger Airbag Adaptive Vent" 3 "Error" ;
VAL_ 1024 CcfPCMEWULine 0 "Not Supported" 1 "PCM Early Wake Up Line Not Fitted" 2 "PCM Early Wake Up Line Fitted" 7 "Error" ;
VAL_ 1024 CcfRowTwoSquabRelAct 0 "Not SUpported" 1 "Without Row 2 Squab release actuator" 2 "With Row 2 Squab release actuator" 7 "Error" ;
VAL_ 1024 CcfTrajectoryLines 0 "Not Supported" 1 "Enabled" 2 "Disabled" 3 "Error" ;
VAL_ 1024 CcfCDiffType 0 "Not supported" 1 "CDiff Type 1: Standard With Disconnect" 2 "CDiff Type 2: Standard Less Disconnect" 5 "CDiff Type 3: Standard With Disconnect SV" 6 "CDiff Type 4: Standard Less Disconnect SV" 15 "Error" ;
VAL_ 1024 CcfChauPersonalisation 0 "Not Supported" 1 "Chauffeur Personalisation not fitted" 2 "Chauffeur Personalisation fitted" 3 "Error" ;
VAL_ 1024 CcfConnectInfoStatus 0 "Not Supported" 1 "CI Not Active" 2 "CI Framework Active" 3 "CI Browser Active" 4 "CI Framework & Browser Active" 7 "Error" ;
VAL_ 1024 CcfDistribPlayback 0 "Not Supported" 1 "No distributed playback" 2 "Distributed playback" 3 "Error" ;
VAL_ 1024 CcfEDTType 0 "Not Supported" 1 "Brink MXe 2 Stage Motor" 2 "Westfalia EDT" 3 "Brink MXe DC" 4 "Brink MXe HD" 5 "Horizon Global single motor EDT" 15 "Error" ;
VAL_ 1024 CcfElecDepTowBar 0 "Not supported" 1 "Not Fitted" 2 "Fitted" 3 "Error" ;
VAL_ 1024 CcfFntOptDiskDrive 0 "Not Supported" 1 "No ODD" 2 "CD Audio + MP3" 3 "DVD" 4 "DVD, BluRay" 5 "CBHD - China Blue" 15 "Error" ;
VAL_ 1024 CcfFuelPumpType 0 "Not Supported" 1 "Gasoline FPDM" 2 "Gasoline FPDM Hi Flow" 3 "Clean market Diesel FPDM" 4 "Dirty market Diesel FPDM + lift pump" 5 "Diesel V-engine lift pump" 6 "Diesel I-engine lift pump" 7 "Not Fitted" 15 "Error" ;
VAL_ 1024 CcfGliding 0 "Not supported" 1 "Disabled" 2 "Enabled" 3 "Error" ;
VAL_ 1024 CcfICCFitment 0 "Not supported" 1 "Not Fitted" 2 "Fitted" 3 "Error" ;
VAL_ 1024 CcfIntStoreIMC 0 "Not supported" 1 "Not Fitted" 2 "Fitted" 3 "Error" ;
VAL_ 1024 CcfIntStoreISC 0 "Not supported" 1 "Not Fitted" 2 "Fitted" 3 "Error" ;
VAL_ 1024 CcfLaneKeepAssistLKA 0 "Not supported" 1 "LKA not fitted" 2 "LKA fitted" 3 "Error" ;
VAL_ 1024 CcfNGINLIDigRadRecSys 0 "Not Supported" 1 "Without Digital Radio, with 1 channel Analogue Radio" 2 "Without Digital Radio, with 2 channel Analogue Radio" 3 "1 channel DAB (Includes 1 channel Analogue Radio)" 4 "2 channel DAB (includes 2 channel Analogue Radio)" 5 "1 channel HD Radio (Includes 1 channel Analogue Radio)" 6 "2 channel HD Radio (includes 2 channel Analogue Radio)" 7 " 1 channel DRM30 (Includes 1 channel Analogue Radio)" 8 "2 channel DRM30 (includes 2 channel Analogue Radio)" 9 "1 channel DRM+ (includes 1 channel Analogue Radio)" 10 "2 channel DRM+ (includes 2 channel Analogue Radio)" 11 "1 channel DRM30 & DRM+ (includes 1 channel Analogue Radio)" 12 "2 channel DRM30 & 2 channel DRM+ (includes 2 channel Analogue Radio)" 13 "SDARS (includes 1 channel Analogue Radio)" 14 "1 channel HD Radio (includes 1 channel Analogue Radio) & SDARS" 15 "2 channel HD Radio (includes 2 channel Analogue Radio) & SDARS" 16 "1 channel DAB & 1 channel DRM30 (includes 1 channel Analogue Radio)" 17 "2 channel DAB & 2 channel DRM30 (includes 2 channel Analogue Radio)" 18 "1 channel DAB & 1 channel DRM+ (includes 1 channel Analogue Radio)" 19 "2 channel DAB & 2 channel DRM+ (includes 2 channel Analogue Radio)" 20 "1 channel DAB & 1 channel DRM30 & 1 channel DRM+ (includes 1 channel Analogue Radio)" 21 "2 channel DAB & 2 channel DRM30 & 2 channel DRM+ (Includes 2 channel Analogue Radio)" 22 "SDARS (includes 2 channel Analogue Radio)" 23 "Without Digital Radio, with 1 channel AM/FM & Connected Radio" 24 "1 channel DAB (Includes 1 channel AM/FM) & Connected Radio" 25 "1 channel HD Radio (Includes 1 channel AM/FM) & Connected Radio" 26 "1 channel DRM30 (Includes 1 channel AM/FM) & Connected Radio" 27 "1 channel DRM+ (includes 1 channel AM/FM) & Connected Radio" 28 "1 channel DRM30 & DRM+ (includes 1 channel AM/FM) & Connected Radio" 29 "SDARS & Connected SDARS (includes 1 channel AM/FM)" 30 "SDARS & Connected SDARS (includes 1 channel AM/FM) & Connected Radio" 31 "SDARS (includes 1 channel AM/FM) & Connected Radio" 32 "1 channel HD Radio (includes 1 channel AM/FM) & SDARS & Connected SDARS" 33 "1 channel HD Radio (includes 1 channel AM/FM) & Connected Radio & SDARS & Connected SDARS" 34 "1 channel HD Radio (includes 1 channel AM/FM) & Connected Radio & SDARS" 35 "1 channel DAB & 1 channel DRM30 (includes 1 channel AM/FM) & Connected Radio" 36 "1 channel DAB & 1 channel DRM+ (includes 1 channel AM/FM) & Connected Radio" 37 "1 channel DAB & 1 channel DRM30 & 1 channel DRM+ (includes 1 channel AM/FM) & Connected Radio" 255 "Error" ;
VAL_ 1024 CcfNoseLoadMeasure 0 "Not supported" 1 "Not Fitted" 2 "Fitted" 3 "Error" ;
VAL_ 1024 CcfPDCBtnFCIM 0 "Not supported" 1 "Not Fitted" 2 "Fitted" 3 "Error" ;
VAL_ 1024 CcfTCUConnectivity 0 "Not Supported" 1 "No Connectivity" 2 "Cellular and WiFi Connectivity" 3 "Cellular only Connectivity (without WiFi)" 4 "WiFi only Connectivity (without Cellular)" 7 "Error" ;
VAL_ 1024 CcfTrailerLightMod 0 "Not supported" 1 "Not Fitted" 2 "Fitted" 3 "Error" ;
VAL_ 1024 CcfTRMFitment 0 "Not supported" 1 "Not Fitted" 2 "Fitted" 3 "Error" ;
VAL_ 1024 CcfAirIonizer 0 "Not supported" 1 "Front and Rear Air Ionizer not fitted" 2 "Front Air Ionizer fitted" 3 "Rear Air Ionizer fitted" 4 "Front and Rear Air Ionizer fitted" 7 "Error" ;
VAL_ 1024 CcfAutoAccessHeight 0 "Not supported" 1 "Not Fitted" 2 "Fitted" 3 "Error" ;
VAL_ 1024 CcfCameraBtnFCIM 0 "Not supported" 1 "Not Fitted" 2 "Fitted" 3 "Error" ;
VAL_ 1024 CcfClusterAlertGFX 0 "Not Supported" 1 "Generic Warning Display" 2 "Market Derivative Warning Display #1" 3 "Market Derivative Warning Display #2" 4 "Market Derivative Warning Display #3" 7 "Error" ;
VAL_ 1024 CcfDepSideSteps 0 "Not supported" 1 "Not Fitted" 2 "Fitted" 3 "Error" ;
VAL_ 1024 CcfDriverDoorLock 0 "Not supported" 1 "No Switch Fitted" 2 "Lock Only" 3 "Unlock Only" 4 "Lock & Unlock Only" 7 "Error" ;
VAL_ 1024 CcfDSSOffRoadOperation 0 "Not supported" 1 "Not Fitted" 2 "Fitted" 3 "Error" ;
VAL_ 1024 CcfDualViewBtnFCIM 0 "Not supported" 1 "Not Fitted" 2 "Fitted" 3 "Error" ;
VAL_ 1024 CcfECOmodeText 0 "Not Supported" 1 "Off" 2 "On" 3 "Error" ;
VAL_ 1024 CcfKeyFobTechnology 0 "Not supported" 1 "PEPS2" 2 "PEPS" 3 "UWBPEPS" 7 "Error" ;
VAL_ 1024 CcfPassDoorLock 0 "Not supported" 1 "No Switch Fitted" 2 "Lock Only" 3 "Unlock Only" 4 "Lock & Unlock Only" 7 "Error" ;
VAL_ 1024 CcfPedProtectSystem 0 "Not supported" 1 "Not Fitted" 2 "Fitted" 3 "Error" ;
VAL_ 1024 CcfRearExitDetect 0 "Not supported" 1 "Not Fitted" 2 "Fitted" 3 "Error" ;
VAL_ 1024 CcfRestrictSunroofOpen 0 "Not Supported" 1 "Unrestricted" 2 "Restricted" 3 "Error" ;
VAL_ 1024 CcfRLPassDoorLock 0 "Not supported" 1 "No Switch Fitted" 2 "Lock Only" 3 "Unlock Only" 4 "Lock & Unlock Only" 7 "Error" ;
VAL_ 1024 CcfRRPassDoorLock 0 "Not supported" 1 "No Switch Fitted" 2 "Lock Only" 3 "Unlock Only" 4 "Lock & Unlock Only" 7 "Error" ;
VAL_ 1024 CcfSoftCloseDoors 0 "Not supported" 1 "Not Fitted" 2 "Fitted - Door Module Controlled" 3 "Fitted - Stand Alone Controlled" 7 "Error" ;
VAL_ 1024 CcfSunGblClTelLock 0 "Not Supported" 1 "Disabled" 2 "Enabled" 3 "Error" ;
VAL_ 1024 CcfTelLock 0 "Not Supported" 1 "Disabled" 2 "Enabled" 3 "Error" ;
VAL_ 1024 CcfTelUnlock 0 "Not Supported" 1 "Disabled" 2 "Enabled" 3 "Error" ;
VAL_ 1024 CcfTrailerLightTest 0 "Not supported" 1 "Not Fitted" 2 "Fitted" 3 "Error" ;
VAL_ 1024 CcfVehicleLocator 0 "Not Supported" 1 "Disabled" 2 "Enabled" 3 "Error" ;
VAL_ 1024 CcfWalkAwayLocking 0 "Not Supported" 1 "Not Enabled" 2 "Enabled" 3 "Error" ;
VAL_ 1024 CcfWinGblClTelLock 0 "Not Supported" 1 "Disabled" 2 "Enabled" 3 "Error" ;
VAL_ 1024 CcfColmnRetractOpenLoad 0 "Not supported" 1 "No OL" 2 "OL in OFF state" 3 "OL in ON state" 7 "Error" ;
VAL_ 1024 CcfColmnUpRetractOpenLoad 0 "Not supported" 1 "No OL" 2 "OL in OFF state" 3 "OL in ON state" 7 "Error" ;
VAL_ 1024 CcfComfortPlus 0 "Not Supported" 1 "Comfort Plus Not Fitted" 2 "Comfort Plus Fitted" 3 "Error" ;
VAL_ 1024 CcfEasyEntExtSetMenu 0 "Not Supported" 1 "Disabled" 2 "Enabled" 3 "Error" ;
VAL_ 1024 CcfeCallhydrogenStorage 0 "Not supported" 1 "Not Fitted" 2 "Fitted" 3 "Error" ;
VAL_ 1024 CcfeCallotherPropStorage 0 "Not supported" 1 "Not Fitted" 2 "Fitted" 3 "Error" ;
VAL_ 1024 CcfEcoModeButtonFit 0 "Not supported" 1 "Not Fitted" 2 "Fitted" 3 "Error" ;
VAL_ 1024 CcfExtLghtTellTaleCol 0 "Not supported" 1 "White Auto tell tale" 2 "Green Auto tell tale" 7 "Error" ;
VAL_ 1024 CcfHeatWasherOpenLoad 0 "Not supported" 1 "No OL" 2 "OL in OFF state" 3 "OL in ON state" 7 "Error" ;
VAL_ 1024 CcfIgnition1OpenLoad 0 "Not supported" 1 "No OL" 2 "OL in OFF state" 3 "OL in ON state" 7 "Error" ;
VAL_ 1024 CcfIgnition2OpenLoad 0 "Not supported" 1 "No OL" 2 "OL in OFF state" 3 "OL in ON state" 7 "Error" ;
VAL_ 1024 CcfIgnition3OpenLoad 0 "Not supported" 1 "No OL" 2 "OL in OFF state" 3 "OL in ON state" 7 "Error" ;
VAL_ 1024 CcfIgnition4OpenLoad 0 "Not supported" 1 "No OL" 2 "OL in OFF state" 3 "OL in ON state" 7 "Error" ;
VAL_ 1024 CcfIgnition5OpenLoad 0 "Not supported" 1 "No OL" 2 "OL in OFF state" 3 "OL in ON state" 7 "Error" ;
VAL_ 1024 CcfIgnition6OpenLoad 0 "Not supported" 1 "No OL" 2 "OL in OFF state" 3 "OL in ON state" 7 "Error" ;
VAL_ 1024 CcfIgnition7OpenLoad 0 "Not supported" 1 "No OL" 2 "OL in OFF state" 3 "OL in ON state" 7 "Error" ;
VAL_ 1024 CcfIgnition8OpenLoad 0 "Not supported" 1 "No OL" 2 "OL in OFF state" 3 "OL in ON state" 7 "Error" ;
VAL_ 1024 CcfIMCFanAssyAuxCooling 0 "Not supported" 1 "Not Fitted" 2 "Fitted" 3 "Error" ;
VAL_ 1024 CcfLampSupplyRightOpenLoad 0 "Not supported" 1 "No OL" 2 "OL in OFF state" 3 "OL in ON state" 7 "Error" ;
VAL_ 1024 CcfParkAidECUOpenLoad 0 "Not supported" 1 "No OL" 2 "OL in OFF state" 3 "OL in ON state" 7 "Error" ;
VAL_ 1024 CcfScreenSurroundSwitch 0 "Not supported" 1 "Not Fitted" 2 "Fitted" 3 "Error" ;
VAL_ 1024 CcfAutoAccess 0 "Not Supported" 1 "Feature not available" 2 "Feature available with driver configuration via IPK" 3 "Feature available with driver configuration via IMC" 7 "Error" ;
VAL_ 1024 CcfCoolingFanFitment 0 "Not supported" 1 "Single Electric fan/controller fitted" 2 "Twin electric fan/controllers fitted" 3 "Viscous & electric fan fitted" 4 "Viscous fan fitted" 7 "Error" ;
VAL_ 1024 CcfDriverMemDrSwtchPk 0 "Not supported" 1 "Not Fitted" 2 "Fitted" 3 "Error" ;
VAL_ 1024 CcfEDiffType 0 "Not supported" 1 "EDiff Type 1" 2 "EDiff Type 2" 3 "EDiff Type 3" 15 "Error" ;
VAL_ 1024 CcfGenericEngPwrOut 0 "Not supported" 1 "Eco low power engine variant" 5 "Standard low power engine variant" 7 "Market limited Mid-Power engine variant" 10 "Standard mid power engine variant" 15 "Standard standard power engine variant" 18 "Market Limited High Power Engine variant" 20 "Standard high power engine variant" 25 "Performance engine power variant" 31 "Error" ;
VAL_ 1024 CcfHdlampLvlSensPos 0 "Not Supported" 1 "Left side height sensors" 2 "Right side height sensors" 3 "Error" ;
VAL_ 1024 CcfLRTerrainJGAllRdLaunch 0 "Not Supported" 1 "Disabled" 2 "Enabled" 3 "Error" ;
VAL_ 1024 CcfPassMemDrSwtchPk 0 "Not supported" 1 "Not Fitted" 2 "Fitted" 3 "Error" ;
VAL_ 1024 CcfPTCruiseFitment 0 "Not supported" 1 "No Cruise fitted" 2 "Normal cruise fitted" 3 "ACC fitted" 4 "ACC with Queue Assist fitted" 7 "Error" ;
VAL_ 1024 CcfRearDriverMemDrSwtchPk 0 "Not supported" 1 "Not Fitted" 2 "Fitted" 3 "Error" ;
VAL_ 1024 CcfRearlampType 0 "Not Supported" 1 "Single lamp" 2 "Split lamps With LIN on both lamps" 3 "Split lamps with LIN on trunk lamps only " 4 "Split lamps with LIN on tailgate lamps only" 7 "Error" ;
VAL_ 1024 CcfRearPassMemDrSwtchPk 0 "Not supported" 1 "Not Fitted" 2 "Fitted" 3 "Error" ;
VAL_ 1024 CcfSpdoCalkmhOffset 0 "Not supported" 1 "+ 0.0 km/h" 2 "+ 0.5 km/h" 3 "+ 1.0 km/h" 4 "+ 1.5 km/h" 5 "+ 2.0 km/h" 6 "+ 2.5 km/h" 7 "+ 3.0 km/h" 8 "+ 3.5 km/h" 15 "Error" ;
VAL_ 1024 CcfSpdoCalPercentScale 0 "Not supported" 1 "0.0% Scaling" 2 "0.5% Scaling" 3 "1.0% Scaling" 4 "1.5% Scaling" 5 "2.0% Scaling" 6 "2.5% Scaling" 7 "3.0% Scaling" 8 "3.5% Scaling" 9 "4.0% Scaling" 10 "4.5% Scaling" 11 "5.0% Scaling" 12 "5.5% Scaling" 13 "6.0% Scaling" 14 "6.5% Scaling" 15 "7.0% Scaling" 16 "7.5% Scaling" 31 "Error" ;
VAL_ 1024 CcfSteerWlhlSwtchType 0 "Not Supported" 1 "SWS Dual LIN & AmbientLight (default)" 2 "SWS Single LIN" 3 "SWS CAN & LIN AmbientLight" 7 "Error" ;
VAL_ 1024 CcfTowAssist 0 "Not supported" 1 "Not Enabled" 2 "Tow Assist 2" 3 "Tow Assist 3" 4 "Tow Assist 4" 7 "Error" ;
VAL_ 1024 CcfTPMSCalibration 0 "Not Supported" 1 "TPMS Cal 1" 2 "TPMS Cal 2" 3 "TPMS Cal 3" 4 "TPMS Cal 4" 5 "TPMS Cal 5" 6 "TPMS Cal 6" 7 "TPMS Cal 7" 8 "TPMS Cal 8" 9 "TPMS Cal 9" 10 "TPMS Cal 10" 11 "TPMS Cal 11" 12 "TPMS Cal 12" 13 "TPMS Cal 13" 14 "TPMS Cal 14" 15 "TPMS Cal 15" 16 "TPMS Cal 16" 17 "TPMS Cal 17" 18 "TPMS Cal 18" 19 "TPMS Cal 19" 20 "TPMS Cal 20" 21 "TPMS Cal 21" 22 "TPMS Cal 22" 23 "TPMS Cal 23" 24 "TPMS Cal 24" 25 "TPMS Cal 25" 26 "TPMS Cal 26" 27 "TPMS Cal 27" 28 "TPMS Cal 28" 29 "TPMS Cal 29" 30 "TPMS Cal 30" 31 "TPMS Cal 31" 32 "TPMS Cal 32" 33 "TPMS Cal 33" 34 "TPMS Cal 34" 35 "TPMS Cal 35" 36 "TPMS Cal 36" 37 "TPMS Cal 37" 38 "TPMS Cal 38" 39 "TPMS Cal 39" 40 "TPMS Cal 40" 41 "TPMS Cal 41" 42 "TPMS Cal 42" 43 "TPMS Cal 43" 44 "TPMS Cal 44" 45 "TPMS Cal 45" 46 "TPMS Cal 46" 47 "TPMS Cal 47" 48 "TPMS Cal 48" 49 "TPMS Cal 49" 50 "TPMS Cal 50" 51 "TPMS Cal 51" 52 "TPMS Cal 52" 53 "TPMS Cal 53" 54 "TPMS Cal 54" 55 "TPMS Cal 55" 56 "TPMS Cal 56" 57 "TPMS Cal 57" 58 "TPMS Cal 58" 59 "TPMS Cal 59" 60 "TPMS Cal 60" 61 "TPMS Cal 61" 62 "TPMS Cal 62" 63 "TPMS Cal 63" 64 "TPMS Cal 64" 65 "TPMS Cal 65" 66 "TPMS Cal 66" 67 "TPMS Cal 67" 68 "TPMS Cal 68" 69 "TPMS Cal 69" 70 "TPMS Cal 70" 71 "TPMS Cal 71" 72 "TPMS Cal 72" 73 "TPMS Cal 73" 74 "TPMS Cal 74" 75 "TPMS Cal 75" 76 "TPMS Cal 76" 77 "TPMS Cal 77" 78 "TPMS Cal 78" 100 "TPMS Cal 100" 254 "No TPMS calibration selected" 255 "Error" ;
VAL_ 1024 CcfActSndDesignPwrlvl 0 "Not Supported" 1 "Not Fitted" 2 "NGPTSQ" 3 "PTSQ NLI" 4 "PTSQ Lo" 5 "PTSQ Hi" 6 "PTSQ Prem" 7 "PTSQ EV" 8 "PTSQ Hybrid" 9 "PTSQ V8 Cylinder De-Activation" 255 "Error" ;
VAL_ 1024 CcfDoorBodyStyle 0 "Not supported" 1 "2 Door Body style" 2 "4 Door Body style" 3 "5 Door / 4 Door estate body style" 4 "3 Door / 3 Door estate body style" 7 "Error" ;
VAL_ 1024 CcfDrivenWheels 0 "Not supported" 1 "Front Wheel Drive (permanently connected)" 2 "Rear Wheel Drive (permanently connected)" 3 "All Wheel Drive (permanently connected)" 7 "Error" ;
VAL_ 1024 CcfFinalDriveRatioComp 0 "Undefined" 65535 "Error" ;
VAL_ 1024 CcfNextGenPwrTrnSQ 0 "Not supported" 1 "Not Fitted" 2 "PTSQ NLI" 3 "PTSQ MID" 4 "PTSQ HIGH" 5 "PTSQ PREM" 6 "PTSQ EV" 7 "PTSQ Hybrid" 255 "Error" ;
VAL_ 1024 CcfNextGenPwrTrnSQCalNo 0 "Not Supported" 1 "Not Fitted" 2 "Calibration 1" 3 "Calibration 2" 4 "Calibration 3" 5 "Calibration 4" 6 "Calibration 5" 7 "Calibration 6" 8 "Calibration 7" 9 "Calibration 8" 10 "Calibration 9" 11 "Calibration 10" 12 "Calibration 11" 13 "Calibration 12" 14 "Calibration 13" 15 "Calibration 14" 16 "Calibration 15" 17 "Calibration 16" 18 "Calibration 17" 19 "Calibration 18" 20 "Calibration 19" 21 "Calibration 20" 254 "Cal Number Not Applicable" 255 "Error" ;
VAL_ 1024 CcfPanoramicRoof 0 "Not supported" 1 "Not Fitted" 2 "Fitted" 3 "Error" ;
VAL_ 1024 CcfPetrolEMSEmissMkt 0 "Not supported" 1 "Federal" 2 "Euro" 3 "Japan" 4 "Brazil" 5 "RoW" 6 "91 Octane" 7 "China" 255 "Error" ;
VAL_ 1024 CcfBrakeDiscMaterial 0 "Not supported" 1 "Iron" 2 "CCM (Carbon Ceramic Matrix)" 7 "Error" ;
VAL_ 1024 CcfBrakeDiscSizeFront 0 "Not supported" 1 "22 inch" 2 "15 inch" 3 "16 inch" 4 "17 inch" 5 "18 inch" 6 "19 inch" 7 "20 inch" 8 "16.5 inch" 9 "21 inch" 15 "Error" ;
VAL_ 1024 CcfBrakeDiscSizeRear 0 "Not supported" 1 "14 inch" 2 "15 inch" 3 "16 inch" 4 "17 inch" 5 "18 inch" 6 "19 inch" 7 "20 inch" 8 "21 inch" 9 "22 inch" 15 "Error" ;
VAL_ 1024 CcfElectricFan 0 "Not Supported" 1 "Not Fitted" 2 "Single" 3 "Double" 7 "Error" ;
VAL_ 1024 CcfRearDriverLinSWP 0 "Not Supported" 1 "Not Fitted" 2 "Dual Window" 3 "Dual Window with SeatAway" 15 "Error" ;
VAL_ 1024 CcfRearPassLinSWP 0 "Not Supported" 1 "Not Fitted" 2 "Dual Window" 3 "Dual Window with SeatAway" 15 "Error" ;
VAL_ 1024 CcfServiceInterval 0 "Undefined" 65534 "Service announcement = off" 65535 "Error" ;
VAL_ 1024 CcfSportbrake 0 "Not supported" 1 "Standard" 2 "Sportbrake" 3 "Error" ;
VAL_ 1024 CcfTyreDynamicRollRad 0 "Not supported" 2000 "X260/X260 LWB" 2050 "X360 X760" 2101 "X152" 2298 "L550 20MY+ L551 19MY+ X540 18MY+" 2300 "L560 X761" 2325 "D8 L551" 2387 "L405 L462 L494" 2463 "L460" 2471 "L663 Only" 65535 "Error" ;
VAL_ 1024 CcfEnginePowerOutputkW 0 "Undefined" 65535 "Error" ;
VAL_ 1024 CcfFuelTimeToService 0 "Not supported" 2046 "Function disabled" 65535 "Error" ;
VAL_ 1024 CcfHybridType 0 "Not supported" 1 "Normal Vehicle" 2 "Manual Transmission Stop/Start" 3 "Mild Hybrid (MHEV)" 4 "Full Hybrid (CIMG)" 5 "Auto Transmission Stop/Start" 6 "Plug-In Hybrid (PHEV)" 7 "Batttery Electric Vehicle (BEV)" 15 "Error" ;
VAL_ 1024 CcfPDC 0 "Not supported" 1 "PDC not fitted" 2 "Four Channel fitted" 3 "Eight Channel fitted" 4 "10 channel fitted(Parallel Park Assist)" 5 "12 channel fitted (Parallel and Perp park assist)" 15 "Error" ;
VAL_ 1024 CcfTyreSizeCorrnFac 0 "Not supported" 65535 "Error" ;
VAL_ 1024 CcfBrakeWarningSymbol 0 "Not Supported" 1 "ISO + text" 2 "ISO" 3 "Text" 7 "Error" ;
VAL_ 1024 CcfChassisDescription 0 "Not supported" 1 "No sub-variant" 2 "R Chassis" 3 "RS / SVR Chassis" 4 "Unused" 5 "ABB+ Chassis" 6 "Special Vehicle Operations 1 (Project 7)" 7 "Special Vehicle Operations 2" 15 "Error" ;
VAL_ 1024 CcfConfigDynamicMode 0 "Not supported" 1 "Not Fitted" 2 "Fitted" 3 "Error" ;
VAL_ 1024 CcfGearboxdescription 0 "Not supported" 1 "6 Speed Auto" 2 "8 Speed Auto (8HP70)" 3 "8 Speed Auto (8HP76)" 4 "8 Speed Auto (8HP45)" 5 "8 Speed Auto (8HP51)" 6 "9 Speed Auto (9HP50)" 7 "Hybrid 8 Speed Auto (8P70H)" 8 "Hybrid 8 Speed Auto (8P75PH)" 9 "8 Speed Auto (AW 8G30)" 10 "Electrical Drive System (No gearbox fitted)" 11 "8 Speed Auto (8HP60MH)" 12 "8 Speed Auto (8HP80MH)" 13 "8 Speed Auto (8P80PH)" 14 "8 Speed Auto (8P100PH)" 15 "Error" ;
VAL_ 1024 ccfGenericWheelBase 0 "Not supported" 4 "Short" 8 "Standard" 12 "Long" 14 "Extended" 15 "Error" ;
VAL_ 1024 CcfPTAODieWaterInSensr 0 "Not supported" 1 "Not Fitted" 2 "Fitted" 3 "Error" ;
VAL_ 1024 CcfReverseGearSelStrat 0 "Not Supported" 1 "Reverse Gear Selection Strategy Disabled" 2 "Reverse Gear Selection Strategy Enabled" 3 "Error" ;
VAL_ 1024 CcfTransmissionSelectr 0 "Not supported" 1 "Electrical Gear Selector (Shift-by-Wire)" 2 "Mechanical Gear Selector (Bowden Cable)" 3 "Stick Shifter (Shift-by-Wire)" 4 "Virtual Shifter without Tip shift function" 5 "Virtual Shifter with Tip shift function" 7 "Error" ;
VAL_ 1024 CcfFntClusterCableLgth 0 "Not Supported" 1 "Not Fitted" 2 "0 - 1.9m" 3 "2 - 2.9m" 4 "3 - 3.9m" 5 "4 - 4.9m" 6 "5 - 5.9m" 7 "6 - 6.9m" 8 "7 - 7.9m" 14 "Length Unknown - Load Default" 15 "Error" ;
VAL_ 1024 CcfFntDispCableLgth 0 "Not Supported" 1 "Not Fitted" 2 "0 - 1.9m" 3 "2 - 2.9m" 4 "3 - 3.9m" 5 "4 - 4.9m" 6 "5 - 5.9m" 7 "6 - 6.9m" 8 "7 - 7.9m" 14 "Length Unknown - Load Default" 15 "Error" ;
VAL_ 1024 CcfAdaptDrvBeam 0 "Not Supported" 1 "AdaptDrvBeam Disabled" 2 "AdaptDrvBeam Enabled" 3 "Error" ;
VAL_ 1024 CcfAquaBladeFitted 0 "Not supported" 1 "Not Fitted" 2 "Fitted" 3 "Error" ;
VAL_ 1024 CcfAquaBladeWashDir 0 "Not Supported" 1 "Wash upstroke" 2 "Wash up/down" 3 "Error" ;
VAL_ 1024 CcfAutoBlindEnabled 0 "Not Supported" 1 "Disabled" 2 "EnabledNoUserOverride" 3 "EnabledWithUserOverride" 7 "Error" ;
VAL_ 1024 CcfAutolightSensorFit 0 "Not supported" 1 "Not Fitted" 2 "Fitted" 3 "Error" ;
VAL_ 1024 CcfBodyStyleSeatLayout 0 "Not supported" 1 "2-seat style (1 row)" 2 "5-seat style (2 row)" 3 "7-seat style (3 row)" 7 "Error" ;
VAL_ 1024 CcfCDiffBknHalfShfDet 0 "Not supported" 1 "Broken Half Shaft Detection Strategy Not Fitted" 2 "Broken Half Shaft Detection Strategy Fitted" 3 "Error " ;
VAL_ 1024 CcfCDiffRangeChgType 0 "Not supported" 1 "Standard Range Change" 2 "One Touch Range Change" 7 "Error" ;
VAL_ 1024 CcfDriverIDCamera 0 "Not supported" 1 "Not Fitted" 2 "Fitted" 3 "Error" ;
VAL_ 1024 CcfFntAnimatedIndicator 0 "Not supported" 1 "Not Fitted" 2 "Fitted" 3 "Error" ;
VAL_ 1024 CcfGestureBlindFront 0 "Not Supported" 1 "Disabled" 2 "EnabledNoUserOverride" 3 "EnabledWithUserOverride" 7 "Error" ;
VAL_ 1024 CcfGrillActiveVanes 0 "Not supported" 1 "Less AGM-A AND Less AGM-B actuators" 2 "AGM-B fitted Only" 3 "AGM-A fitted Only" 4 "AGM-A and AGM-B both fitted" 7 "Error" ;
VAL_ 1024 CcfHeatedWasherJets 0 "Not supported" 1 "Not Fitted" 2 "Fitted" 3 "Error" ;
VAL_ 1024 CcfHeightInputSelection 0 "Not Supported" 1 "Headlamp levelling disabled" 2 "Height via hardwire" 3 "Height via CAN" 4 "Height via hardwire single sensor" 7 "Error" ;
VAL_ 1024 CcfLaserHighBeam 0 "Not Supported" 1 "Laser High Beam Disabled" 2 "Laser High Beam Enabled" 3 "Error" ;
VAL_ 1024 CcfMovingWindows 0 "Not Supported" 1 "No Moving Windows" 2 "Two Moving Windows" 3 "Three Moving Windows" 4 "Four Moving Windows" 5 "Five Moving Windows" 15 "Error" ;
VAL_ 1024 CcfPNChargingFunction 0 "Not Supported" 1 "Disabled" 2 "Enabled" 3 "Error" ;
VAL_ 1024 CcfPNFuelRefill 0 "Not Supported" 1 "Disabled" 2 "Enabled" 3 "Error" ;
VAL_ 1024 CcfRearAnimatedIndicator 0 "Not supported" 1 "Not Fitted" 2 "Fitted" 3 "Error" ;
VAL_ 1024 CcfSpareWheelCarrier 0 "Not Supported" 1 "No SWC" 2 "JLR Integrated SWC" 3 "Dealer fit only SWC" 7 "Error" ;
VAL_ 1024 CcfTowing 0 "Not supported" 1 "Not Fitted" 2 "Fitted" 3 "Error" ;
VAL_ 1024 CcfViscousFan 0 "Not Supported" 1 "Not fitted" 2 "Single" 3 "Double" 7 "Error" ;
VAL_ 1024 CcfWiperMotorModule 0 "Not Supported" 1 "Standard wiper motor" 2 "Smart wiper motor" 3 "Error" ;
VAL_ 1024 CcfDieselEMSEmissMkt 0 "Not supported" 1 "Federal" 2 "Euro" 3 "Japan" 4 "Brazil" 5 "RoW" 6 "Bio_Fuel" 7 "China" 15 "Error" ;
VAL_ 1024 CcfDriverID 0 "Not Supported" 1 "Not Fitted" 2 "Manual" 3 "Automatic" 7 "Error" ;
VAL_ 1024 CcfDriverIDKeys 0 "Not supported" 1 "Not Fitted" 2 "Fitted" 3 "Error" ;
VAL_ 1024 CcfDriverIDPhones 0 "Not supported" 1 "Not Fitted" 2 "Fitted" 3 "Error" ;
VAL_ 1024 CcfDriverIDSeats 0 "Not supported" 1 "Not Fitted" 2 "Fitted" 3 "Error" ;
VAL_ 1024 CcfEcoDataGallonType 0 "Not Supported" 1 "Imperial Gallons" 2 "US Gallons" 7 "Error" ;
VAL_ 1024 CcfFrntLowerDispKeys 0 "Not Supported" 1 "Not Fitted" 2 "4 Keys" 3 "2 Keys" 7 "Error" ;
VAL_ 1024 CcfFrntLowerDispVariant 0 "Not supported" 1 "Not Fitted" 2 "Panasonic 10 inch Single View" 3 "ALPS 5 inch Single View" 4 "FCCD - 7 inch Portrait" 15 "Error" ;
VAL_ 1024 CcfFrntUpperDeployable 0 "Not supported" 1 "Not Fitted" 2 "Fitted" 3 "Error" ;
VAL_ 1024 CcfFrntUpperDispVariant 0 "Not Supported" 1 "Not Fitted" 2 "Panasonic 10 Inch Single View" 3 "Visteon 10 Inch Single View" 4 "Alpine 11.6 inch Single View" 5 "Alpine 13.3 inch Single View " 6 "FCD - 13 inch" 7 "FCD - 15 inch" 15 "Error" ;
VAL_ 1024 CcfFrontPassengerID 0 "Not Supported" 1 "Not Fitted" 2 "Manual" 3 "Automatic" 4 "Error" ;
VAL_ 1024 CcfNGICamBanStrat 0 "Not Supported" 1 "No Warning Banner Displayed by Infotainment" 2 "Warning Banner Displayed by Infotainment" 3 "Error" ;
VAL_ 1024 CcfNonDepIllumDoorHnd 0 "Not supported" 1 "Not Fitted" 2 "Fitted" 3 "Error" ;
VAL_ 1024 CcfPersonalisation 0 "Not Supported" 1 "Not Fitted" 2 "Driver Only" 3 "Front Row" 4 "Front Row + Row2" 5 "Front Row + Row2 + Row3" 7 "Error" ;
VAL_ 1024 CcfRow2PassengerID 0 "Not Supported" 1 "Not Fitted" 2 "Manual" 3 "Automatic" 7 "Error" ;
VAL_ 1024 CcfRow3PassengerID 0 "Not Supported" 1 "Not Fitted" 2 "Manual" 3 "Automatic" 7 "Error" ;
VAL_ 1024 CcfSmartExitFntDrvDr 0 "Not supported" 1 "Not Fitted" 2 "Fitted" 3 "Error" ;
VAL_ 1024 CcfSmartExitFntPassDoor 0 "Not supported" 1 "Not Fitted" 2 "Fitted" 3 "Error" ;
VAL_ 1024 CcfSmartExitRrDrvDoor 0 "Not supported" 1 "Not Fitted" 2 "Fitted" 3 "Error" ;
VAL_ 1024 CcfSmartExitRrPassDoor 0 "Not supported" 1 "Not Fitted" 2 "Fitted" 3 "Error" ;
VAL_ 1024 CcfTransCalIndex 0 "Not supported" 1 "Calibration Index #1" 2 "Calibration Index #2" 3 "Calibration Index #3" 4 "Calibration Index #4" 5 "Calibration Index #5" 6 "Calibration Index #6" 7 "Error" ;
VAL_ 1024 CcfChargingInlet1 0 "Not Supported" 1 "Inlet Not Fitted" 2 "AC Type 1" 3 "AC Type 2" 4 "AC GBT" 5 "AC+DC Type 1 Combo" 6 "AC+DC Type 2 Combo" 7 "DC GBT" 8 "DC Chademo" 9 "NACS" 15 "Error" ;
VAL_ 1024 CcfChargingInlet2 0 "Not Supported" 1 "Inlet Not Fitted" 2 "AC Type 1" 3 "AC Type 2" 4 "AC GBT" 5 "AC+DC Type 1 Combo" 6 "AC+DC Type 2 Combo" 7 "DC GBT" 8 "DC Chademo" 9 "NACS" 15 "Error" ;
VAL_ 1024 CcfEMMaxDurEngOff 0 "Not supported" 255 "Error" ;
VAL_ 1024 CcfFMMaxFuelAge 0 "Not supported" 255 "Error" ;
VAL_ 1024 CcfFntPassWdowSwtchPk 0 "Not Supported" 1 "Not Fitted" 2 "Hardwired" 3 "LIN switch" 15 "Error" ;
VAL_ 1024 CcfFrntDrvWdowSwtchpk 0 "Not Supported" 1 "Not Fitted" 2 "Non Capacitive switchpack" 3 "Capacitive switchpack" 15 "Error" ;
VAL_ 1024 CcfMicrophoneType 0 "Not Supported" 1 "Not Fitted" 2 "Microphone Type 1" 3 "Microphone Type 2" 4 "Microphone Type 3" 5 "Microphone Type 4" 6 "Microphone Type 5" 15 "Error" ;
VAL_ 1024 CcfRrDrWdowSwtchPk 0 "Not Supported" 1 "Not Fitted" 2 "Hardwired" 3 "LIN Dual Window Switch + Seat Away" 4 "LIN Single Window Switch + Multi-function" 5 "LIN Single Window Switch" 6 "LIN Dual Window Switch" 15 "Error" ;
VAL_ 1024 CcfRrPassWdowSwtchpk 0 "Not Supported" 1 "Not Fitted" 2 "Hardwired" 3 "LIN Dual Window Switch + Seat Away" 4 "LIN Single Window Switch + Multi-function" 5 "LIN Single Window Switch" 6 "LIN Dual Window Switch" 15 "Error" ;
VAL_ 1024 CcfSelectStateCharge 0 "Not supported" 1 "Not Fitted" 2 "Fitted" 3 "Error" ;
VAL_ 1024 CcfTelematicsSpkrType 0 "Not Supported" 1 "Not Fitted" 2 "TELEMATICS_MID_RANGE " 3 "PREMIUM_COAXIAL" 4 "SUPER_PREMIUM_COAXIAL " 5 "PREMIUM_MIDRANGE" 6 "SUPER_PREMIUM_MIDRANGE " 7 "TELEMATICS_80mm" 15 "Error" ;
VAL_ 1024 CcfTimedChrgFeature 0 "Not Supported" 1 "Timed Charging not fitted" 2 "Timed Charging fitted" 3 "Timed Charging with geofencing fitted" 4 "Timed Charging with fixed tariff window fitted" 5 "Timed Charging with geofencing fitted and fixed tariff window fitted" 6 "Preferred Window Charging with geofencing fitted and fixed tariff window fitted" 7 "Error" ;
VAL_ 1024 CcfWirelessCharger 0 "Not supported" 1 "Not Fitted" 2 "Fitted" 7 "Error" ;
VAL_ 1024 CcfActiveExhaustButtonType 0 "Not Supported" 1 "Not Fitted" 2 "Hard button Fitted" 3 "Soft button Fitted" 7 "Error" ;
VAL_ 1024 CcfAFS123 0 "Not Supported" 1 "AFS123 Disabled" 2 "AFS123 Enabled" 3 "Error" ;
VAL_ 1024 CcfBrakePadTypeFront 0 "Not Supported" 1 "Not NAO" 2 "NAO" 3 "Lo Cu NAO" 4 "0% Cu NAO" 5 "Lo Cu Low Met" 6 "0% Cu Low Met" 7 "High Performance" 8 "Carbon Ceramic CCM" 9 "Carbon Ceramic CCB" 31 "Error" ;
VAL_ 1024 CcfBrakePadTypeRear 0 "Not Supported" 1 "Not NAO" 2 "NAO" 3 "Lo Cu NAO" 4 "0% Cu NAO" 5 "Lo Cu Low Met" 6 "0% Cu Low Met" 7 "High Performance" 8 "Carbon Ceramic CCM" 9 "Carbon Ceramic CCB" 31 "Error" ;
VAL_ 1024 CcfElectricDrivePower 0 "Not Supported" 1 "235 kW" 2 "294 kW" 3 "368 kW" 4 "221 kW" 5 "257 kW" 6 "331 kW" 7 "405 kW" 8 "478 kW" 9 "552 kW" 10 "736 kW" 11 "772 kW" 14 "No Electric Motor fitted" 15 "Error" ;
VAL_ 1024 CcfEMSMktCal 0 "Not supported" 1 "Feature Disabled" 2 "EU6 Calibration" 3 "EU2 Calibration" 7 "Error" ;
VAL_ 1024 CcfHeadlightsVariant 0 "Not Supported" 1 "Headlamp_Variant_Low_A" 2 "Headlamp_Variant_Low_B" 3 "Headlamp_Variant_Low_C" 4 "Headlamp_Variant_Mid_A" 5 "Headlamp_Variant_Mid_B" 6 "Headlamp_Variant_Mid_C" 7 "Headlamp_Variant_Mid+_A" 8 "Headlamp_Variant_Mid+_B" 9 "Headlamp_Variant_Mid+_C" 10 "Headlamp_Variant_High_A" 11 "Headlamp_Variant_High_B" 12 "Headlamp_Variant_High_C" 13 "Headlamp_Variant_High+_A" 14 "Headlamp_Variant_High+_B" 15 "Headlamp_Variant_High+_C" 255 "Error" ;
VAL_ 1024 CcfHitchAssistTowbar 0 "Error" 1 "All other towbar configuration" 2 "7 Seat with Spare Detachable Towbar" 3 "7 Seat with Spare Flanged Towbar " 4 "7 Seat with Spare AUS Towbar " 5 "7 Seat with Spare NAS Towbar " 6 "5/7 Seat Flanged Towbar " 7 "5/7 Seat NAS Towbar " 8 "5/7 Seat AUS Towbar " 9 "5/7 Seat Detachable Towbar" 10 "5/7 Electrically Deployable Towbar" 11 "5/7 Seat Multi-Height Towbar" 12 "5/7 Seat SVX Detachable Towbar" 13 "5/7 Seat SVX NAS Towbar" 255 "Error" ;
VAL_ 1024 CcfMildHybridType 0 "Not Supported" 1 "MHEV1 OR MHEV system not implemented OR MHEV2 - 3kph" 2 "MHEV2 - 20kph" 3 "MHEV 3 System" 4 "MHEV 4 System" 5 "MHEV 5 System" 15 "Error" ;
VAL_ 1024 CcfSlcCallList 0 "Not Supported" 1 "Not Fitted" 2 "Available to the driver only" 3 "Available to the driver and front passenger only" 4 "Available to the driver, front passenger, and all passengers in row 2 only" 5 "Available to the driver, front passenger, all passengers in row 2 and all passengers in row 3" 7 "Error" ;
VAL_ 1024 CcfSlcDeviceReminder 0 "Not Supported" 1 "Not Fitted" 2 "Available to the driver only" 3 "Available to the driver and front passenger only" 4 "Available to the driver, front passenger, and all passengers in row 2 only" 5 "Available to the driver, front passenger, all passengers in row 2 and all passengers in row 3" 7 "Error" ;
VAL_ 1024 CcfSlcMediaSource 0 "Not Supported" 1 "Not Fitted" 2 "Available to the driver only" 3 "Available to the driver and front passenger only" 4 "Available to the driver, front passenger, and all passengers in row 2 only" 5 "Available to the driver, front passenger, all passengers in row 2 and all passengers in row 3" 7 "Error" ;
VAL_ 1024 CcfSurroundMode 0 "Not Supported" 1 "Without Surround Audio" 2 "With 2D Surround Audio" 3 "With 3D Surround Audio" 4 "Horizon" 5 "Ultra Premium 3D Surround Audio " 6 "Use legacy logic to determine Surround Audio fitment" 7 "Error" ;
VAL_ 1024 CcfTRUserInputMethod 0 "Not Supported" 1 "Input Method 1" 2 "Input Method 2" 3 "Error" ;
VAL_ 1024 CcfAskOnExit 0 "Not Supported" 1 "Disabled" 2 "Enabled" 3 "Error" ;
VAL_ 1024 CcfBacklightStratSel 0 "Not Supported" 1 "BacklightNight/DayControlStrategy" 2 "BacklightLinearControlStrategy (No Night/Day Switching)" 3 "Error" ;
VAL_ 1024 CcfBodyKitStyle 0 "Not Supported" 1 "Core body kit" 2 "Dynamic body kit" 15 "Error" ;
VAL_ 1024 CcfClearExitDetectionSystem 0 "Not supported" 1 "Not Fitted" 2 "Fitted" 3 "Error" ;
VAL_ 1024 CcfDriveAssist 0 "Not Supported" 1 "Drive Assist Not Avaliable" 2 "Drive Assist Avaliable" 3 "Error" ;
VAL_ 1024 CcfDriverHeatedCalfRest 0 "Not Supported" 1 "Not Fitted" 2 "Heated Calf Rest fitted on second row driver-side seat" 3 "Error" ;
VAL_ 1024 CcfDynamicLiteMode 0 "Not Supported" 1 "Not available for selection" 2 "Available for selection without timeout" 3 "Available for selection with timeout" 7 "Error" ;
VAL_ 1024 CcfEngineNoiseCancel 0 "Not Supported" 1 "Engine Noise Cancellation Not Fitted" 2 "Engine Noise Cancellation Fitted" 3 "Error" ;
VAL_ 1024 CcfFront23BuckSwitch 0 "Not supported" 1 "2 Seats in Row 1" 2 "3 Seats in Row 1" 3 "Error" ;
VAL_ 1024 CcfHeatedDoorArmrest 0 "Not Supported" 1 "Not Fitted" 2 "Front Only" 3 "Rear Only" 4 "Front and Rear" 7 "Error" ;
VAL_ 1024 CcfHeatedMapPocket 0 "Not Supported" 1 "Not Fitted" 2 "Fitted" 3 "Error" ;
VAL_ 1024 CcfHtdFrntCntreArmrst 0 "Not Supported" 1 "Not Fitted" 2 "Single Centre" 3 "Front Left and Right" 7 "Error" ;
VAL_ 1024 CcfHtdRearCntreArmrst 0 "Not Supported" 1 "Not Fitted" 2 "Single Centre" 3 "Rear Left and Right" 7 "Error" ;
VAL_ 1024 CcfIntelEmrgBrkingCAEB 0 "Not Supported" 1 "CAEB Not Fitted" 2 "CAEB Fitted" 3 "Error" ;
VAL_ 1024 CcfLowerGloveBox 0 "Not Supported" 1 "Not Fitted" 2 "Manual" 3 "Electric Low Power" 4 "Electric High Power" 7 "Error" ;
VAL_ 1024 CcfRow3BuckleSwitch 0 "Not Supported" 1 "2 Seats in Row 3" 2 "3 Seats in Row 3" 3 "Error" ;
VAL_ 1024 CcfSAPServerType 0 "Not Supported" 1 "No SAP Server" 2 "Actia SAP Server" 3 "LG SAP Server" 7 "Error" ;
VAL_ 1024 CcfSeatTherm2ndRowHMIControl 0 "Not Supported" 1 "Display 2nd row Seat Thermal page" 2 "Do not display 2nd row Seat Thermal page" 3 "Error" ;
VAL_ 1024 CcfSuspensionType 0 "Not supported" 1 "Coil-Coil" 2 "2 Corner Air" 3 "4 Corner Air" 15 "Error" ;
VAL_ 1024 CcfTaskLightingTLMA 0 "Not Supported" 1 "Not Fitted" 2 "Dimmable Task Light Fitted" 3 "Error" ;
VAL_ 1024 CcfUpperGloveBox 0 "Not Supported" 1 "Not Fitted" 2 "Manual" 3 "Electric Low Power" 4 "Electric High Power" 7 "Error" ;
VAL_ 1024 CcfUWBPEPSRANGEADJUSTUSEVSA 0 "Not Supported" 1 "3 Metres" 2 "4 Metres" 3 "5 Metres" 7 "Error" ;
VAL_ 1024 CcfATCMAirSusSwitches 0 "Not Supported" 1 "ATCM Air Suspension Switches not fitted or Blade display not fitted" 2 "ATCM Air Suspension Switches fitted and Blade display fitted" 3 "Error" ;
VAL_ 1024 CcfATCMATPCSwitch 0 "Not Supported" 1 "ATCM All Terrain Progress Control Switch not fitted or Blade display not fitted" 2 "ATCM All Terrain Progress Control Switch fitted and Blade display fitted" 3 "Error" ;
VAL_ 1024 CcfATCMAutoTRMdSwitch 0 "Not Supported" 1 "Auto Terrain Response Mode selection switch not fitted or Blade display not fitted" 2 "Auto Terrain Response Mode selection switch fitted and Blade display fitted" 3 "Error" ;
VAL_ 1024 CcfATCMDSCOffSwitch 0 "Not Supported" 1 "Dynamic Stability Control Off switch not fitted or Blade display not fitted" 2 "Dynamic Stability Control Off switch fitted and Blade display fitted" 3 "Error" ;
VAL_ 1024 CcfATCMEVSwitch 0 "Not Supported" 1 "ATCM Electric Vehicle Switch not fitted or Blade display not fitted" 2 "ATCM Electric Vehicle Switch fitted and Blade display fitted" 3 "Error" ;
VAL_ 1024 CcfATCMHDCSwitch 0 "Not Supported" 1 "ATCM Hill Descent Control Switch not fitted or Blade display not fitted" 2 "ATCM Hill Descent Control Switch fitted and Blade display fitted" 3 "Error" ;
VAL_ 1024 CcfATCMLoRangeSwitch 0 "Not Supported" 1 "ATCM Lo Range Switch not fitted or Blade display not fitted" 2 "ATCM Lo Range Switch fitted and Blade display fitted" 3 "Error" ;
VAL_ 1024 CcfATCMRotarySwitch 0 "Not Supported" 1 "ATCM Rotary Switch not fitted or Blade display not fitted" 2 "ATCM Rotary Switch and Blade display fitted" 3 "Error" ;
VAL_ 1024 CcfATCMTA2Switch 0 "Not Supported" 1 "Tow Assist 2 feature selection switch not fitted or Blade display not fitted" 2 "Tow Assist 2 feature selection switch fitted and Blade display fitted" 3 "Error" ;
VAL_ 1024 CcfCamForwardAlert 0 "Not Supported" 1 "Not Fitted" 2 "Fitted without sensitivities" 3 "Fitted with sensitivities" 7 "Error" ;
VAL_ 1024 CcfCDMDynamicHandling 0 "Not Supported" 1 "Dynamic handling not Fitted" 2 "Dynamic handling Fitted" 3 "Error" ;
VAL_ 1024 CcfChgPortFlpInhibit 0 "Not supported" 1 "Not Fitted" 2 "Fitted" 3 "Error" ;
VAL_ 1024 CcfClimateZonalControl 0 "Not Supported" 1 "Not Fitted" 2 "Fitted" 3 "Error" ;
VAL_ 1024 CcfDisplay2ndRowBlowerSpeed 0 "Not Supported" 1 "Do not display 2nd row blower speed" 2 "Display current 2nd row blower speed" 7 "Error" ;
VAL_ 1024 CcfDisplayFrontBlowerSpeed 0 "Not Supported" 1 "Display legacy HMI for this vehicle and model year" 2 "Do not display front blower speed" 3 "Display current front blower speed " 7 "Error" ;
VAL_ 1024 CcfEHznLongHznImpl 0 "Not Supported" 1 "E-Horizon Long Horizon Not Fitted" 2 "Ethernet Back Channel" 7 "Error" ;
VAL_ 1024 CcfELKARE 0 "Not Supported" 1 "Not Fitted" 2 "Fitted" 3 "Error" ;
VAL_ 1024 CcfGearRatioSpread 0 "Not Supported" 57 "5.7 Gear Ratio Spread (BG6 Manual Transmission)" 62 "6.2 Gear Ratio Spread (ZF-6S Manual Transmission)" 71 "7.1 Gear Ratio Spread" 75 "7.5 Gear Ratio Spread (AW Auto Transmission)" 78 "7.8 Gear Ratio Spread" 82 "8.2 Gear Ratio Spread" 86 "8.6 Gear Ratio Spread" 98 "9.8 Gear Ratio Spread (ZF9HP Auto Transmission)" 255 "Error" ;
VAL_ 1024 CcfRadarForwardAlert 0 "Not Supported" 1 "Not Fitted" 2 "Fitted without sensitivities" 3 "Fitted with sensitivities" 7 "Error" ;
VAL_ 1024 CcfRHSWSBusSelection 0 "Not Supported" 1 "BCM_LIN1" 2 "BCM_LIN9" 3 "Error" ;
VAL_ 1024 CcfSpoilerSpecialFunc 0 "Not Supported" 1 "No special mode" 2 "NAS Cleaning Mode" 7 "Error" ;
VAL_ 1024 CcfUWBPEPSENDISONLYUSEVSA 0 "Not Supported" 1 "UWB PEPS Not Enabled" 2 "UWB PEPS Enabled" 3 "Error" ;
VAL_ 1024 CcfACCAccelProfileSelect 0 "Not supported" 1 "Not Fitted" 2 "Fitted" 3 "Error" ;
VAL_ 1024 CcfACCLeadCarDistDisp 0 "Not supported" 1 "Not Fitted" 2 "Fitted" 3 "Error" ;
VAL_ 1024 CcfACCStopGapSelect 0 "Not supported" 1 "Not Fitted" 2 "Fitted" 3 "Error" ;
VAL_ 1024 CcfAdasDCR 0 "Not Supported" 1 "DCR not fitted" 2 "DCR fitted" 3 "Error" ;
VAL_ 1024 CcfAdasLongCRA 0 "Not Supported" 1 "Not Fitted" 2 "Fitted" 3 "Error" ;
VAL_ 1024 CcfAdasLongRPC 0 "Not Supported" 1 "Not Fitted" 2 "Fitted" 3 "Error" ;
VAL_ 1024 CcfAdasNCapCyclistAEB 0 "Not supported" 1 "Not Fitted" 2 "Fitted" 3 "Error" ;
VAL_ 1024 CcfAdasTJP 0 "Not Supported" 1 "Not Fitted" 2 "Fitted" 3 "Error" ;
VAL_ 1024 CcfAutoHold 0 "Not Supported" 1 "HVH Disabled" 2 "HVH Enabled" 3 "Error" ;
VAL_ 1024 CcfDSMFitment 0 "Not Supported" 1 "Not Fitted" 2 "Fitted" 3 "Error" ;
VAL_ 1024 CcfESSCalNo 0 "Not Supported" 1 "Not Fitted" 2 "Calibration 1" 3 "Calibration 2" 4 "Calibration 3" 5 "Calibration 4" 6 "Calibration 5" 7 "Calibration 6" 8 "Calibration 7" 9 "Calibration 8" 10 "Calibration 9" 11 "Calibration 10" 12 "Calibration 11" 13 "Calibration 12" 14 "Calibration 13" 15 "Calibration 14" 16 "Calibration 15" 17 "Calibration 16" 18 "Calibration 17" 19 "Calibration 18" 20 "Calibration 19" 21 "Calibration 20" 254 "Cal Number Not Applicable" 255 "Error" ;
VAL_ 1024 CcfIntMirrorVariant 0 "Not Supported" 1 "Not Fitted" 2 "IRVM" 3 "IRVM and Additional Bezel" 4 "IRVM and Homelink" 5 "IRVM and Additional Bezel and Homelink" 6 "SRVM" 7 "SRVM and Additional Bezel" 8 "SRVM and Homelink" 9 "SRVM and Additional Bezel and Homelink" 15 "Error" ;
